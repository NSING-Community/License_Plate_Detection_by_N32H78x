// yolo-plate (Yolo-FastestV2, 70-class license plate) TFLite-Micro INT8 inference
// Model : tflite/onnx2tf_int8_plate/plate-int8.tflite, real-calibrated
//         full-integer, layout A: 85ch = reg12|obj3|cls70, outputs
//         [1,20,20,85] + [1,10,10,85]
// MD5   : 82693BCE77C3D5A9099BF268B5D815F5
// MCU   : N32H78x (Cortex-M7), TFLM pack cortex_m_generic 1.26.x
//
// The identity that counts is not this comment but the first two lines of
// inc/model_data.h: that is the array this image actually links, generated from
// that .tflite by tflite/export_c_array.py, and it carries the same byte count
// and MD5.  (An older tflite/yolo-plate-int8.tflite - MD5 5193E19A..., the SAME
// 431,360 bytes - is what the 2026-10-12 NSING application note describes.  It
// is NOT in this image.  Two files, same size, different bytes: check the MD5.)
#include "yolo_inference.h"
#include "model_data.h"
// ② (the crop-stage glyph detector).  Generated by tflite/export_c_array.py like
// model_data.h is, but with section("model_ro") instead of section("data_area"):
// ①'s 431 KB is copied to AXI SRAM at startup and there is no room for a second
// copy, so ② is read in place over the XIP bus.  MDK-ARM/M7_TCM.sct has the
// ER_MODEL_RO region that places it; see the comment there.
#include "model_data_crop.h"
// ③ (the per-character classifier).  Same generated shape and the same section
// as ②, and the same treatment at init: copied into an SDRAM buffer with the
// D-cache off rather than parsed in place - see the charhead block in
// yolo_cascade_init().  90,144 bytes, and it must be included here or the array
// is simply not linked into the image (which is how it sat unused the first
// time round: nothing referenced it).
#include "model_data_charhead.h"

#include <math.h>
#include <stdio.h>

#include "Message.h"   // Message[192] + UART_SendString - the same sink DebugLog() uses

// core_cm7.h compiles SCB_EnableDCache() / SCB_DisableDCache() down to nothing
// unless __DCACHE_PRESENT is 1U - it defaults the macro to 0U with a #warning
// (core_cm7.h:202-205) - so it has to be defined BEFORE the device header,
// which is what pulls core_cm7.h in.  src/main.c:55-63 says the same pair for
// its own two calls, and the project's <Define> list carries neither, so every
// translation unit that touches the cache maintenance API has to say it here.
// yolo_cascade_init() below calls both: a silent no-op there would turn the
// cached/uncached comparison into "the cache changes nothing", which is exactly
// the wrong conclusion to hand back.
#define __ICACHE_PRESENT 1U
#define __DCACHE_PRESENT 1U

// DWT->CYCCNT, for the exact-operator probe at the bottom of this file.  The
// device header is what brings in core_cm7.h; gpu.c and camera.c both take it
// the same way.
#include "n32h7xx.h"

#include "tensorflow/lite/micro/micro_interpreter.h"
#include "tensorflow/lite/micro/micro_mutable_op_resolver.h"
// Declares Register_DEPTHWISE_CONV_2D(), which is what the GPU registration
// below is a copy of.  The resolver's own AddDepthwiseConv2D() calls it too, but
// this file needs the symbol by name to keep everything but invoke/prepare.
#include "tensorflow/lite/micro/kernels/depthwise_conv.h"
// The same thing for the pointwise operator: Register_CONV_2D() and the
// TfLiteConvParams the eligibility test reads.
#include "tensorflow/lite/micro/kernels/conv.h"
// GetMicroContext() + MicroContext: the only sanctioned way to read a
// TfLiteTensor from a kernel, and the reason it is not done with the context's
// GetTensor is in the comment on dw_temp_in() below.
#include "tensorflow/lite/micro/micro_context.h"
// (optional) add: #include "tensorflow/lite/micro/tflite_bridge/micro_error_reporter.h"

// ---------------------------------------------------------------------------
// Tensor arena. Put it in SDRAM (0xC0000000). M7_TCM.sct:
//   RW_SDRAM1 0xC0000000 UNINIT 0x00200000 { .ANY(.bss.tensor_arena_area) }
// ---------------------------------------------------------------------------
// 2 MB rather than the full 8 MB: the camera needs two 800x480 RGB565 frame
// buffers (768,000 bytes each) directly above the arena, because no on-chip SRAM
// can hold even one and the SDRAM is the only place big enough.  This size and
// the RW_SDRAM1 size in M7_TCM.sct are the same number - change them together,
// or the linker will happily place the arena over the frame buffers.
// The size is measured, not guessed: yolo_plate_init() prints it (see the arena
// trace below) and the board reports 1,303,080 bytes used, so 2 MB leaves ~790KB
// spare.  If a future model needs more, TFLM says by how much on the trace; if
// the arena grows past 2 MB, the frame buffers have to come down or move.
#ifndef TENSOR_ARENA_SIZE
#define TENSOR_ARENA_SIZE (0x200000)          // 2 MB
#endif
// NOTE: the section name MUST start with ".bss." (Arm Compiler 6).
// A plain name like "tensor_arena_area" makes armclang emit SHT_PROGBITS (RW
// initialised data), so the C library startup (__main) tries to copy 8 MB of
// zeros into SDRAM 0xC0000000 *before* main() runs.  SDRAM is not initialised
// at that point -> HardFault before main, with no UART output.
// With the ".bss." prefix armclang emits SHT_NOBITS (ZI), and because the
// scatter region is UNINIT nothing is copied/zeroed at startup.
// (AC5's 'zero_init' attribute is NOT supported by armclang and is ignored.)
static uint8_t tensor_arena[TENSOR_ARENA_SIZE]
    __attribute__((section(".bss.tensor_arena_area"), aligned(16)));

static tflite::MicroInterpreter* s_interp = nullptr;
static TfLiteTensor* s_in = nullptr;

// anchors per stride (training voc.data)
static const float ANCHORS[2][3][2] = {
    {{11.03f, 24.54f}, {14.40f, 36.74f}, {20.08f, 52.82f}}, // stride 16 (20x20)
    {{27.04f, 78.23f}, {144.02f, 96.56f}, {239.25f, 195.42f}} // stride 32 (10x10)
};
static const int   STRIDES[2]   = {16, 32};
static const int   GRID_W[2]    = {YOLO_GRID0, YOLO_GRID1};
static const int   GRID_H[2]    = {YOLO_GRID0, YOLO_GRID1};

// ---------------------------------------------------------------------------
static inline float dequant_i8(int8_t q) { return (float)(q + 128) * (1.0f / 255.0f); }

static float iou(const YoloBox& a, const YoloBox& b)
{
    float ix1 = a.x1 > b.x1 ? a.x1 : b.x1;
    float iy1 = a.y1 > b.y1 ? a.y1 : b.y1;
    float ix2 = a.x2 < b.x2 ? a.x2 : b.x2;
    float iy2 = a.y2 < b.y2 ? a.y2 : b.y2;
    if (ix1 >= ix2 || iy1 >= iy2) return 0.0f;
    float inter = (ix2 - ix1) * (iy2 - iy1);
    float u = (a.x2 - a.x1) * (a.y2 - a.y1) + (b.x2 - b.x1) * (b.y2 - b.y1) - inter;
    return u > 0 ? inter / u : 0.0f;
}

// decode one head (output tensor already layout-A [h,w,85]).
//
// `anchors` and `conf_thresh` became PARAMETERS when ② arrived, and that is the
// whole of the change: ① and ② share this layout but share neither of these two
// numbers.  The tables come from different voc.data files (data/ vs data_crop/),
// and ② runs at conf 0.10 against ①'s 0.25 - a glyph that is 2-3 px wide inside
// ②'s own 320x320 crop is exactly what 0.25 throws away.
// ①'s call site passes ANCHORS[sid] / YOLO_CONF_THRESH, i.e. the values that
// used to be spelled here, so ①'s output is unchanged down to the bit.
// `keep_top` 决定 max_box 满了以后怎么办 —— 这**不是**性能开关, 是两边链路对不对得上的问题:
//
//   keep_top = 0 (①): 光栅序直接截。 ① 在 conf 0.25 下一帧就几个候选, 永远
//                      到不了 max_box, 所以这条路与冻结基线**逐字节相同**。
//   keep_top = 1 (②): 按**分数**留最高的 max_box 个。 PC 上冻结出 78.99% 的那条
//                      链路就是"按分数取 16 -> cap 7"; 光栅序截断拿到的是完全
//                      另一批框 (图的上半部分先占满 64 个名额, 下半部分的真字
//                      一个都进不来), 这是板子和 PC 之间一个**静默**的分歧。
//
// 2026-10-20 现场: 161 轮里 109 轮候选数摸到了 64, 所以光栅序截断一直在生效,
// 不是理论风险。 同一份日志里 `why` 打出 1118525714 —— 也是这个位置溢出的:
// 老代码只在进格子时查 `cnt < max_box`, 而一个格子里 3 个 anchor 各写一次,
// 从 cnt = 63 的格子进来会越界写 2 个 YoloBox; 越界写的是第 65 个的 x1 (float),
// 而 s_cas_box 正下方 4 字节就是 s_cas_why。
//
// `seen` 累计**过 conf 的候选总数** (不截断, 纯诊断) —— 它大于 max_box 就说明
// 截断生效了, 用来判断是不是该把 max_box 调大。 ② 的日志里 n2 的第二个数就是它。
static void decode_head(const int8_t* feat, int sid, const float anchors[3][2],
                        float conf_thresh, YoloBox* boxes, int& cnt, int max_box,
                        int keep_top, int& seen)
{
    const int stride  = STRIDES[sid];
    const int gw      = GRID_W[sid];
    const int gh      = GRID_H[sid];
    if (max_box <= 0) return;          // keep_top 分支要读 boxes[max_box-1]

    for (int gy = 0; gy < gh && (keep_top || cnt < max_box); gy++) {
        for (int gx = 0; gx < gw && (keep_top || cnt < max_box); gx++) {
            const int8_t* c = feat + (size_t)(gy * gw + gx) * YOLO_CHAN;
            // best class over cls[15:85]
            int   cid = 0;
            float csc = -1.0f;
            for (int k = 0; k < YOLO_CLS_NUM; k++) {
                float s = dequant_i8(c[15 + k]);
                if (s > csc) { csc = s; cid = k; }
            }
            for (int a = 0; a < YOLO_OBJ_NUM; a++) {
                float obj = dequant_i8(c[12 + a]);         // already sigmoid in model
                float sc  = obj * csc;
                if (sc < conf_thresh) continue;
                seen++;

                float bx = dequant_i8(c[a * 4 + 0]);       // sigmoid(reg) already in model
                float by = dequant_i8(c[a * 4 + 1]);
                float bw = dequant_i8(c[a * 4 + 2]);
                float bh = dequant_i8(c[a * 4 + 3]);

                float cx = (bx * 2.0f - 0.5f + gx) * stride;
                float cy = (by * 2.0f - 0.5f + gy) * stride;
                float w  = (bw * 2.0f) * (bw * 2.0f) * anchors[a][0];
                float h  = (bh * 2.0f) * (bh * 2.0f) * anchors[a][1];

                YoloBox b;
                b.x1 = cx - w * 0.5f; b.y1 = cy - h * 0.5f;
                b.x2 = cx + w * 0.5f; b.y2 = cy + h * 0.5f;
                b.score = sc; b.class_id = cid;

                if (!keep_top) {
                    boxes[cnt++] = b;                      // ①: 老路径, 一位不动
                    continue;
                }
                // ②: 维持 boxes[] 按分数降序, 满了就只挤掉最差的那个
                int i;
                if (cnt < max_box)                           i = cnt++;
                else if (b.score > boxes[max_box - 1].score) i = max_box - 1;
                else                                         continue;
                while (i > 0 && boxes[i - 1].score < b.score) { boxes[i] = boxes[i - 1]; i--; }
                boxes[i] = b;
            }
        }
    }
}

// `nms_thresh` is a parameter for the same reason decode_head's threshold is:
// ② needs 0.30 where ① wants 0.45.  A plate's glyphs sit close enough together
// that a 0.45 threshold merges two neighbouring characters into one, and ① has
// nothing to merge (it finds one box).
static void nms(YoloBox* boxes, int& cnt, float nms_thresh)
{
    // insertion sort desc by score
    for (int i = 1; i < cnt; i++) {
        YoloBox key = boxes[i];
        int j = i - 1;
        while (j >= 0 && boxes[j].score < key.score) { boxes[j + 1] = boxes[j]; j--; }
        boxes[j + 1] = key;
    }
    int keep = 0;
    for (int i = 0; i < cnt; i++) {
        bool ok = true;
        for (int j = 0; j < keep; j++) {
            if (iou(boxes[i], boxes[j]) > nms_thresh) { ok = false; break; }
        }
        if (ok) boxes[keep++] = boxes[i];
    }
    cnt = keep;
}

// ---------------------------------------------------------------------------
// Plate string assembly (see yolo_plate_read in yolo_inference.h).
//
// boxes[] comes out of nms() sorted by SCORE, which is not the reading order -
// re-sort by x1 before concatenating, or the string is garbage.  Nothing here
// modifies boxes[]; the sort is done on an index array.
//
// 0 = the whole-plate box, skipped.  1..34 are single ASCII glyphs and live in
// CHARS[], indexed by class-1 ('A'-'Z' really is missing I and O, matching
// data/voc.names).  35..69 are province abbreviations, which have no ASCII
// form: they are stored as GBK byte pairs.  They are written as bare bytes
// rather than string literals so the table does not depend on how this source
// file itself is encoded - a serial terminal has to decode GBK for them to
// show up as Chinese.
// ---------------------------------------------------------------------------
static const char CHARS[] = "0123456789ABCDEFGHJKLMNPQRSTUVWXYZ";  // class 1..34

static const uint8_t PROV_GBK[35][2] = {          // class 35..69
    {0xB0, 0xC4}, /* 35 澳 */
    {0xB4, 0xA8}, /* 36 川 */
    {0xB6, 0xF5}, /* 37 鄂 */
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    {0xB2, 0xD8}, /* 69 藏 */
};

#define YOLO_PLATE_MAXBOX 16   // a plate has <= 8 glyphs; ignore boxes past this

// ---------------------------------------------------------------------------
// The plate-cluster filter.  Key 'v', yolo_plate_geo_set(); resets to 0.
//
// THE PROBLEM IT SOLVES.  yolo_plate_read() below concatenates EVERY box with
// class_id > 0, so anything the detector hallucinates anywhere in the frame
// becomes a character in the plate string.  On 11 frames of one scene
// (mcu_code/log/log.txt, key 'b', 2026-10-12) the firmware produced 8 DISTINCT
// strings for ONE plate, and a box spanning the whole frame - ~600x250 px in
// the camera's space, classified '8', score 0.49..0.75 - appeared in ELEVEN of
// ELEVEN of them and, being the leftmost, contributed a leading '8' each time.
//
// WHY A CONFIDENCE THRESHOLD IS NOT THE FIX, which is the reason this is
// geometric: the junk is not WEAK.  In that capture every box that reached the
// string scored 0.374..0.917 - the LOWEST score in the whole set belonged to
// the largest box, while a real 粤 sat below three others at 0.557.  No score
// separates them.  A size does.
//
// THE RULE, chosen by scoring five candidates on those 11 frames with
// tools/_plate_rule.py (which reads the log and can be re-run on any capture):
//
//   (a) SIZE.  A glyph is a glyph.  Drop a candidate whose height is outside
//       [0.6, 1.6] x the median candidate height, or whose width is outside
//       [0.5, 1.6] x the median candidate width.  Medians and not means,
//       because the outliers are exactly what is being measured.
//   (b) DUPLICATE.  Greedy in score order - which is the order boxes[] arrives
//       in, because nms() sorted it - drop a candidate whose x-interval
//       overlaps a KEPT candidate's by more than half of the shorter one, when
//       the two also share rows.  This is what removes the doubled 粤: two
//       detections of one glyph at 41% IoU survive YOLO_NMS_THRESH 0.45f, and
//       nms is class-agnostic so it will never merge them.  The 0.5 is
//       load-bearing and was measured: 0.3 over-merges and returns 6 glyphs
//       where the plate has 7.
//
// WHAT IT IS NOT ALLOWED TO DO.  A same-row gate was tested and DROPPED: every
// candidate already shared one row on all 11 frames, so it fired 0 times, and a
// clause that never fires is a knob that is not set.  The filter only runs at
// all with 4 or more candidates, and it falls back to the unfiltered set if the
// size gate would leave fewer than 2 - so a plate with two or three detections
// is assembled exactly as before rather than gutted.
//
// MEASURED EFFECT, the same 11 frames: 8 distinct strings -> 4; the plate's own
// 7 glyphs in 10 of 11 frames; 粤 first in 11 of 11.  What it does NOT fix is
// the model - R is read as A or 9 and G as 8 on every frame either way.  This
// removes characters.  It never adds one.
//
// IT ONLY EVER REMOVES, so with the switch off yolo_plate_read() is
// byte-for-byte what it was - which is also what keeps tools/chain_emulate.py
// honest, since it decodes through this function.
// ---------------------------------------------------------------------------
static int s_plate_geo_on = 0;     // key-gated, resets to 0

extern "C" void yolo_plate_geo_set(int on) { s_plate_geo_on = (on != 0) ? 1 : 0; }
extern "C" int  yolo_plate_geo_get(void)   { return s_plate_geo_on; }

// Sorts a scratch copy and returns the middle one.
static int plate_med(int* v, int n)
{
    for (int i = 1; i < n; i++) {
        const int key = v[i];
        int j = i - 1;
        while (j >= 0 && v[j] > key) { v[j + 1] = v[j]; j--; }
        v[j + 1] = key;
    }
    return v[n / 2];
}

// Rewrites idx[0..m-1] in place, returns the new count.  Ratios only, so it does
// not care which space the boxes are in - camera_map_box() is a pure per-axis
// scale, so the detector's square 320 and the camera's 800x480 agree.
static int plate_geo_filter(const YoloBox* boxes, int* idx, int m)
{
    if (m < 4) return m;                       // too few to measure: leave it

    int h[YOLO_PLATE_MAXBOX], w[YOLO_PLATE_MAXBOX];
    int hs[YOLO_PLATE_MAXBOX], ws[YOLO_PLATE_MAXBOX];
    for (int i = 0; i < m; i++) {
        h[i] = hs[i] = (int)(boxes[idx[i]].y2 - boxes[idx[i]].y1);
        w[i] = ws[i] = (int)(boxes[idx[i]].x2 - boxes[idx[i]].x1);
    }
    const int mh = plate_med(hs, m);           // scratch copies: h[]/w[] survive
    const int mw = plate_med(ws, m);
    if (mh <= 0 || mw <= 0) return m;

    int keep[YOLO_PLATE_MAXBOX];
    int k = 0;
    for (int i = 0; i < m; i++) {              // (a) size
        if (h[i] * 10 > mh * 16 || h[i] * 10 < mh * 6) continue;
        if (w[i] * 10 > mw * 16 || w[i] * 10 < mw * 5) continue;
        keep[k++] = idx[i];
    }
    if (k < 2) return m;                       // the gate emptied it: leave it

    int res[YOLO_PLATE_MAXBOX];
    int r = 0;
    for (int i = 0; i < k; i++) {              // (b) duplicates, in score order
        const YoloBox* b = &boxes[keep[i]];
        const float bw = b->x2 - b->x1;
        int dup = 0;
        for (int j = 0; j < r; j++) {
            const YoloBox* c = &boxes[res[j]];
            const float ox = (b->x2 < c->x2 ? b->x2 : c->x2) -
                             (b->x1 > c->x1 ? b->x1 : c->x1);
            const float oy = (b->y2 < c->y2 ? b->y2 : c->y2) -
                             (b->y1 > c->y1 ? b->y1 : c->y1);
            if (oy <= 0.0f) continue;          // different row: not a duplicate
            const float cw = c->x2 - c->x1;
            if (ox * 2.0f > (bw < cw ? bw : cw)) { dup = 1; break; }
        }
        if (dup == 0) res[r++] = keep[i];
    }

    for (int i = 0; i < r; i++) idx[i] = res[i];
    return r;
}

int yolo_plate_read(const YoloBox* boxes, int n, char* buf, int buf_size)
{
    int idx[YOLO_PLATE_MAXBOX];
    int m = 0;
    for (int i = 0; i < n && m < YOLO_PLATE_MAXBOX; i++) {
        if (boxes[i].class_id > 0) idx[m++] = i;   // 0 = the plate outline itself
    }

    // The plate-cluster filter, off by default - see the block above.  It runs
    // BEFORE the sort on purpose: the greedy duplicate rule needs the
    // score-descending order, which is what boxes[] arrives in.
    if (s_plate_geo_on != 0) m = plate_geo_filter(boxes, idx, m);

    // insertion sort the indices by x1 (ascending)
    for (int i = 1; i < m; i++) {
        const int key = idx[i];
        const float kx = boxes[key].x1;
        int j = i - 1;
        while (j >= 0 && boxes[idx[j]].x1 > kx) { idx[j + 1] = idx[j]; j--; }
        idx[j + 1] = key;
    }

    if (buf_size < 1) return 0;
    int len = 0;
    for (int i = 0; i < m; i++) {
        const int cid = boxes[idx[i]].class_id;
        uint8_t text[2];
        int tn = 0;
        if (cid >= 1 && cid <= 34) {
            text[tn++] = (uint8_t)CHARS[cid - 1];
        } else if (cid >= 35 && cid <= 69) {
            text[0] = PROV_GBK[cid - 35][0];
            text[1] = PROV_GBK[cid - 35][1];
            tn = 2;
        } else {
            continue;                              // class 0 was filtered above
        }
        if (len + tn > buf_size - 1) break;        // keep room for '\0'
        for (int k = 0; k < tn; k++) buf[len++] = (char)text[k];
    }
    buf[len] = '\0';
    return len;
}

// ---------------------------------------------------------------------------
// Init diagnostics.  TFLM's own error strings do reach the UART (DebugLog() in
// RTE/Machine_Learning/debug_log.cpp calls UART_SendString), so a failing
// AllocateTensors() explains itself.  The model/schema, resolver and
// tensor-attribute checks used to return false in complete silence - with an
// 8 MB arena, a wrong tensor layout and an exhausted arena look identical from
// the outside.  Print the step that tripped plus the values that were read.
//
// Floats go out as scale*1e6 (3921 for 1/255) because only %u/%X/%d are used
// with sprintf here - %f is not wired up in this printf variant.
// Message[] is 160 bytes (it was 64, which two shipped lines already overflowed -
// see Message.c), so keep each line shorter than that.
#define YOLO_TRACE0(msg)     do { UART_SendString(msg); UART_SendString("\r\n"); } while (0)
#define YOLO_TRACE(fmt, ...) do { sprintf(Message, fmt, __VA_ARGS__);            \
                                  UART_SendString(Message);                      \
                                  UART_SendString("\r\n"); } while (0)
// resolver.AddX() only fails if the resolver overflows, so one shared line is
// enough to identify it.
#define YOLO_ADD_OP(OP)      do { if (resolver.Add##OP() != kTfLiteOk) {         \
            YOLO_TRACE0("init FAIL: Add" #OP); return false; } } while (0)

// ---------------------------------------------------------------------------
// Depthwise convolution on the GPU.
//
// The operator itself is in gpu.c (gpu_dw_conv) and everything measured about
// what this silicon can express is in the long comment above it and in gpu.h.
// This file owns only the TFLM side: which nodes qualify, where the quantisation
// parameters come from, and what happens when the GPU disagrees with the CPU.
//
// THE RULE THIS IS BUILT ON: the GPU is an accelerator, not a prerequisite.  A
// node that does not qualify, a bias that would not fit the hardware's nine-bit
// field, a scale that would not encode, a GPU that never came up - all of them
// end in s_dw_stock.invoke() and the board carries on.  There is no path here
// that returns an error because the GPU had a problem.
//
// The design is deliberately a REPLACEMENT of one field of one struct:
// TFLMRegistration is a POD (micro_common.h:23), so s_dw_impl is s_dw_stock with
// invoke (and prepare, for the reason below) swapped.  init/free/prepare/reset
// keep running the stock implementation, which allocates its OpData in the arena
// exactly as before - so the stock invoke is always valid to fall back to.
// ---------------------------------------------------------------------------
extern "C" {
#include "gpu.h"
}

#define DW_MAX_CH     128
#define DW_MAX_LAYER  32
#define DW_CHK_PX     8192

// How far the GPU answer may drift from the CPU's on the same activations
// before this layer is handed back for good.
//
// Not 0, and not 1.  The activation is quantised to five bits on the way in -
// there is no wider entry into the kernel, measured - so an error of up to +-3.5
// per tap is expected against weights that reach 127, and a spread of several
// LSB is the design working, not a bug.  What is NOT acceptable is a systematic
// error, and that is what the count of pixels outside this bound catches: a
// wrong operator moves many pixels a long way, quantisation noise moves most of
// them a little.  `worst` is printed unconditionally whether or not this bound
// is met, because it is the number that says how much the 5-bit entry actually
// cost here.
#define DW_GAP_MAX    8

static TFLMRegistration s_dw_impl;
static TFLMRegistration s_dw_stock;

struct DwQ {
    int   filt;                 // node->inputs->data[1]: the layer's filter tensor
    int   fin;                  // node->inputs->data[0]: the layer's INPUT tensor
    int   c;
    int   ready;
    // Everything the GPU call needs that is only reachable from a TfLiteTensor.
    // Captured in prepare, because that is the only point at which TFLM
    // guarantees the TfLiteTensor form (and its quantization params) still
    // exists; see the note on dw_temp_in().
    float isc;                  // input activation scale  - per-tensor here
    float osc;                  // output activation scale - per-tensor here
    int   izp;                  // input zero point  - see dw_eligible()
    int   ozp;                  // output zero point
    float wsc[DW_MAX_CH];       // per-channel weight scales
};

static DwQ    s_dwq[DW_MAX_LAYER];
static int    s_dwq_n = 0;
static float  s_dw_inscale[DW_MAX_CH];
static int8_t s_dw_ref[DW_CHK_PX];

// 0 = the check below has not run yet for that class, 1 = it passed single
// pass, 2 = it passed ONLY with the hi/lo split, -1 = it failed at both and
// every layer of THAT CLASS is on the CPU for the rest of the session.
// Indexed by stride, and there is no index 0, so [1] is the stride-1 SAME
// layers and [2] the stride-2 VALID ones.
//
// Two verdicts rather than one, because the two classes are two different
// claims.  A stride-1 layer rests on the SAME padding rule and one UV origin; a
// stride-2 layer rests on a different UV origin and has no padding at all.  A
// single verdict would have had to choose one of them to trust blindly, and
// whichever it chose, the other class's first layer would run unverified for a
// whole session.  One failure now takes down one class and leaves the other
// running - which is the same conservatism, applied per geometry.
//
// The third outcome (2) is per class and not per layer: the split costs a
// second packing pass and a second draw per channel, so it is paid only by the
// geometry that needs it, and only after the cheap form has been measured to
// fail there.  Which class needs it is not a prediction - it is measured, on
// the first eligible layer of the class, at detection time.
static int s_dw_check[3] = { 0, 0, 0 };

// The same (filter, input) key as conv_q(), and for the same reason -- see the
// block comment there.  THIS MODEL has no depthwise collision (the tool that
// reads the .tflite, tools/conv_filter_index.py, checks both operators and
// reports none), so the change is bit-for-bit inert here: for a node whose
// filter index is unique it finds the same record it always did.  It is here
// because the two operators are the same design and the failure would be as
// silent as the conv one was, and because a .tflite re-export can introduce a
// collision without anyone touching this file.
static DwQ* dw_q(int filt, int fin)
{
    for (int i = 0; i < s_dwq_n; i++) {
        if (s_dwq[i].filt == filt && s_dwq[i].fin == fin) { return &s_dwq[i]; }
    }
    return nullptr;
}

// Reading a TfLiteTensor is NOT free, and this is the trap the first version of
// this glue fell into:
//
//   inline TfLiteTensor* MicroContextGetTensor(const TfLiteContext* context,
//                                              int tensor_idx) {
//     return GetMicroContext(context)->AllocateTempTfLiteTensor(tensor_idx);
//   }
//
// That is the function `ctx->GetTensor` points at, so every call takes a buffer
// out of the arena's temp pool and bumps a counter, and every one of them has to
// be handed back before the node's prepare returns.  Leaving even one alive makes
// FinishPrepareNodeAllocations() - which opens with
// TF_LITE_ENSURE_STATUS(ResetTempAllocations()) - return early for that node, and
// THAT node's scratch-buffer requests are then never given a node_idx.  The
// unassigned requests accumulate on a single counter across the whole graph, and
// once twelve of them are outstanding the allocator refuses a request that has
// nothing to do with any of this.  The depthwise change surfaced as
// `Node CONV_2D (number 64) failed to prepare with status 1' at init.
//
// So the arena is touched in exactly one place (prepare, where the release is
// mandatory anyway) and the two helpers below are the only things that touch it.
// In Eval nothing is allocated at all: a TfLiteEvalTensor is a fixed lookup, and
// whatever a node needs from the TfLiteTensor form - the quantization params in
// this case - was snapshotted into its DwQ entry at prepare time.
static TfLiteTensor* dw_temp_in(tflite::MicroContext* mc, const TfLiteNode* node,
                                int idx)
{
    if (node->inputs == nullptr || idx < 0 || idx >= node->inputs->size) {
        return nullptr;
    }
    if (node->inputs->data[idx] == kTfLiteOptionalTensor) { return nullptr; }
    return mc->AllocateTempTfLiteTensor(node->inputs->data[idx]);
}

static TfLiteTensor* dw_temp_out(tflite::MicroContext* mc, const TfLiteNode* node,
                                 int idx)
{
    if (node->outputs == nullptr || idx < 0 || idx >= node->outputs->size) {
        return nullptr;
    }
    if (node->outputs->data[idx] == kTfLiteOptionalTensor) { return nullptr; }
    return mc->AllocateTempTfLiteTensor(node->outputs->data[idx]);
}

// prepare, wrapped only to capture the per-channel weight scales.
//
// Every depthwise filter in this model is per-channel quantised - 27 of 27,
// measured offline with tools/dw_quant_check.py - so TfLiteTensor.params.scale,
// which is one float, is 0 for all of them and useless here.  The array lives in
// the tensor's TfLiteAffineQuantization, and TFLM micro is free to release that
// once AllocateTensors() has finished; whether this pack does is a pack-version
// detail rather than a promise.  So it is read here, in prepare, which runs
// before any release, and not in invoke where it may already be gone.
//
// Not being able to read it is not an error.  The layer is marked ineligible and
// the stock CPU invoke runs it, the same as for every other reason a layer might
// not qualify - read the fallback as "unknown", not as "the GPU is broken".
static TfLiteStatus dw_gpu_prepare(TfLiteContext* ctx, TfLiteNode* node)
{
    TfLiteStatus st = s_dw_stock.prepare(ctx, node);
    if (st != kTfLiteOk) { return st; }

    if (s_dwq_n >= DW_MAX_LAYER) { return kTfLiteOk; }

    tflite::MicroContext* mc = tflite::GetMicroContext(ctx);
    TfLiteTensor* fin  = dw_temp_in(mc, node, 0);
    TfLiteTensor* filt = dw_temp_in(mc, node, 1);
    TfLiteTensor* fout = dw_temp_out(mc, node, 0);

    // One exit, so the three releases below cannot be skipped by a `return` that
    // someone adds later.  Getting this wrong does not look like a depthwise bug
    // - it surfaces as an unrelated operator being refused at AllocateTensors.
    DwQ* taken = nullptr;

    if (fin != nullptr && filt != nullptr && fout != nullptr &&
        filt->dims != nullptr && filt->dims->size == 4) {
        const int C = filt->dims->data[3];
        if (C > 0 && C <= DW_MAX_CH &&
            fin->params.scale > 0.0f && fout->params.scale > 0.0f) {
            DwQ* q = &s_dwq[s_dwq_n];
            q->filt  = node->inputs->data[1];
            q->fin   = node->inputs->data[0];
            q->c     = C;
            q->ready = 0;
            q->isc   = fin->params.scale;
            q->osc   = fout->params.scale;
            q->izp   = fin->params.zero_point;
            q->ozp   = fout->params.zero_point;

            if (filt->quantization.type == kTfLiteAffineQuantization &&
                filt->quantization.params != nullptr) {
                const TfLiteAffineQuantization* aq =
                    (const TfLiteAffineQuantization*)filt->quantization.params;
                if (aq->scale != nullptr && aq->scale->size == C) {
                    for (int i = 0; i < C; i++) { q->wsc[i] = aq->scale->data[i]; }
                    q->ready = 1;
                }
            }
            if (!q->ready && filt->params.scale > 0.0f) {
                // A per-tensor filter lands here and is just as usable; this
                // model has none, but the branch is what makes the fallback a
                // fallback and not a guess about the model.
                for (int i = 0; i < C; i++) { q->wsc[i] = filt->params.scale; }
                q->ready = 1;
            }
            if (q->ready) { taken = q; }
        }
    }

    if (fin  != nullptr) { mc->DeallocateTempTfLiteTensor(fin); }
    if (filt != nullptr) { mc->DeallocateTempTfLiteTensor(filt); }
    if (fout != nullptr) { mc->DeallocateTempTfLiteTensor(fout); }

    // The slot is only consumed if it was actually filled, so a layer that could
    // not be read leaves s_dwq_n where it was rather than burning a slot on a
    // half-written entry.
    if (taken != nullptr) { s_dwq_n++; }
    return kTfLiteOk;
}

// The eligibility test.
//
// Written as "prove this is the shape I implement" rather than as a list of
// known-bad cases, because a layer this does not recognise is a layer it must
// not touch.  Everything rejected here runs on the CPU and produces the same
// answer it always did.
//
// "Ineligible" is the NORMAL answer for the 8 five-by-five layers of the
// model's 27 depthwise layers, so it is not a failure and it prints nothing.
// That distinction is what this function exists to make explicit.  An earlier
// version returned the same 0 for "not my shape" and "the GPU refused to draw",
// and because the FIRST depthwise node in execution order is op5 - a stride-2
// layer - the one-time check bailed on it and disabled the whole feature for the
// session.  All 13 eligible layers ran on the CPU and the log said only
// `L0 D0 R0`; the answers were in `gpu dw call q27 e1 s4 d1` all along, in the
// form of everything being right.
//
// Two shapes are eligible now, 3x3, depth_multiplier 1, no fused activation,
// and between them 19 of the model's 27 depthwise layers:
//
//     stride 1 + SAME   output == input                      13 layers
//     stride 2 + VALID  output == ((input - 3) / 2) + 1       6 layers
//
// The stride-2 layers are VALID over an input a preceding PAD op has already
// padded (op4 pads to 82x82 so op5 can take 82x82 to 40x40), so every tap of
// every output pixel is inside the plane.  They go through the same 9-tap
// kernel and the same four CLUT words as the stride-1 layers; the only
// difference is where the window is centred, which is the UV origin and the
// du/dx step - see gpu_dw_conv()'s stride branch for the measurement that
// settled that.
//
// Still out: the 8 five-by-five layers.  Their RELU turns out to be a no-op
// (their output zero point is -128, and TFLM's int8 RELU is max(y, out_zp),
// which at -128 is the identity), but their kernel needs nine CLUT words per
// channel instead of four, and 9 x 72 channels = 648 is past the 512 the part
// gives us.
//
// What this resolves, so the caller does not have to re-derive it: which layer,
// which tensors, and the geometry gpu_dw_conv() is about to be handed.  The
// check and the draw both use the same DwJob, so they cannot disagree about
// what "this layer" means.
struct DwJob {
    const TfLiteEvalTensor* fin;
    const TfLiteEvalTensor* filt;
    const TfLiteEvalTensor* bias;
    const TfLiteEvalTensor* fout;
    DwQ* q;
    int  h, w, c;      // input plane
    int  oh, ow;       // output plane
    int  stride;
};

// ===========================================================================
// THE CHAIN FINGERPRINT - where does one inference stop agreeing with the last?
// ===========================================================================
//
// WHY THIS EXISTS.  `gpu dw gpudiff` answered its own question on both stride
// classes (`worst 0 bad 0`): ONE DRAW IS REPRODUCIBLE.  A layer drawn twice,
// back to back, from the same source through the same CLUT into the same
// destination reads back byte-identical, which closes the whole of
// gpu_dw_conv() and dw_pass_bc() as the home of the instability.  But two runs
// of ONE frozen frame decode differently - four `i` presses gave four plates
// and four box sets - so the divergence is in the CHAIN: somewhere at or
// before some layer, two runs stop carrying the same activations.
//
// The instrument below localises that, and it is the cheapest one that can.
// For every ELIGIBLE depthwise layer, in execution order, it hashes the layer's
// INPUT and its OUTPUT.  One column per inference, indexed by position.  Two
// `i` presses therefore give two indexable columns, and the FIRST POSITION THAT
// DIFFERS is the first depthwise layer that is not reproducible.
//
// THE INPUT HASH IS THE CHANGE THIS VERSION MAKES, and the first version's
// reading is why.  That one hashed the input of the FIRST eligible layer only,
// and on 2026-10-10 it came back `inF06CD255` in all three inferences while all
// nineteen outputs differed.  So the chain's input is byte-identical and the
// first eligible layer's output is not, which says that layer is not a pure
// function of its input - and `gpu dw gpudiff` had already read
// `worst 0 bad 0` on the first eligible layer of each stride class, i.e. that a
// back-to-back redraw IS byte-identical.  Both cannot hold for a draw that is a
// function of its operands, so the difference between runs is in the STATE the
// draw reads or in one of the two scratch planes it sits between - and gpudiff,
// which redraws with no pack and no unpack in between, is structurally blind to
// both.
//
// Per position, then:
//
//   `i` differs -> this layer's operand moved, so whatever moved it is at or
//       before the previous position.  This layer is a bystander.
//   `i` matches and `o` differs -> this layer's own draw is not a function of
//       its operands.  That is the position that matters.
//
// WHAT IT IS NOT.  It does not compare against the CPU - the per-class check
// does that - and it does not say which of two disagreeing numbers is right.
// It says only WHERE two runs stop agreeing, which is the one thing missing.
//
// COST.  Two bounded samples per layer, on the CPU, once per inference.  No GPU
// work, no extra draw, nothing that can reach the arithmetic.  Inert unless `g`
// has been pressed, because a layer that is not eligible is never hashed.
#define DW_HASH_SAMP  4096

static uint32_t s_dw_hi[DW_MAX_LAYER];
static uint32_t s_dw_h[DW_MAX_LAYER];
static int      s_dw_hn       = 0;
static int      s_dw_ord_last = -1;

// FNV-1a over a spread sample rather than the first N bytes, because a
// depthwise output is NHWC: the first N bytes are the first few pixels of the
// first channel, so a divergence confined to a later channel - which is
// exactly what a per-channel CLUT or per-channel bias fault produces - would
// not be seen at all.  `step` is n / DW_HASH_SAMP, so the sample always spans
// the whole tensor however large it is.
static uint32_t dw_hash_tensor(const int8_t* p, const TfLiteEvalTensor* t)
{
    uint32_t h = 2166136261u;
    int      i, n = 1, step;

    if (p == nullptr || t == nullptr || t->dims == nullptr) { return 0u; }
    for (i = 0; i < t->dims->size; i++) { n *= t->dims->data[i]; }
    if (n <= 0) { return 0u; }

    step = (n > DW_HASH_SAMP) ? (n / DW_HASH_SAMP) : 1;
    for (i = 0; i < n; i += step) {
        h = (h ^ (uint32_t)(uint8_t)p[i]) * 16777619u;
    }
    return h;
}

static void dw_hash_rec(const DwJob* j)
{
    if (j == nullptr || j->fout == nullptr) { return; }
    if (s_dw_hn >= DW_MAX_LAYER)            { return; }
    s_dw_h[s_dw_hn] = dw_hash_tensor(j->fout->data.int8, j->fout);
    s_dw_hn++;
}

// One line per position and not four to a line: there are two hashes per
// position now, so four of them no longer fit in Message[]'s 160 bytes - and a
// line per position is what makes the first disagreement findable by eye
// without counting columns.
static void dw_hash_flush(void)
{
    int k;

    if (s_dw_hn <= 0) { return; }

    sprintf(Message, "gpu dw H n%d\r\n", s_dw_hn);
    UART_SendString(Message);

    for (k = 0; k < s_dw_hn; k++) {
        sprintf(Message, "gpu dw H %d i%08X o%08X\r\n",
                k, (unsigned)s_dw_hi[k], (unsigned)s_dw_h[k]);
        UART_SendString(Message);
    }

    s_dw_hn = 0;
}

// Called once per eligible layer, BEFORE it draws, and it does two jobs: it
// reports the inference that just finished, and it seeds the new one.
//
// A new inference begins when the layer ordinal stops increasing, and that
// test is exact here for the same reason the withdrawn auto-trace's boundary
// detection was exact: prepare filled s_dwq[] in model order, the layers are
// visited in model order within one inference, and j.q is always in s_dwq[]
// because dw_eligible() put it there.  Layer ordinals of the ineligible
// layers (the eight 5x5) are skipped rather than printed, so a divergence
// entering at one of those shows up as the next eligible layer disagreeing,
// which is still a localisation - just a one-layer-wide one.
//
// Printing the PREVIOUS inference's column here, rather than at the end of the
// inference it describes, is what makes the last inference of a run need one
// more keypress before it is reported.  There is no end-of-inference hook to
// use instead, and this costs nothing else.
static void dw_hash_wrap(const DwJob* j)
{
    const int ord = (int)(j->q - s_dwq);

    if (ord <= s_dw_ord_last) { dw_hash_flush(); }
    s_dw_ord_last = ord;

    if (s_dw_hn < DW_MAX_LAYER) {
        s_dw_hi[s_dw_hn] = dw_hash_tensor(j->fin->data.int8, j->fin);
    }

    // The first two eligible layers of an inference are the two gpudiff tested
    // (one per stride class, each checked once per boot), so they are the two
    // whose disagreement with gpudiff would mean something - and the plane
    // probe is a UART burst inside the draw sequence, so it is not free.  See
    // gpu_dw_plane_arm().
    if (s_dw_hn < 2) { gpu_dw_plane_arm(); }
}

static int dw_eligible(TfLiteContext* ctx, TfLiteNode* node, DwJob* j)
{
    const TfLiteDepthwiseConvParams* p =
        (const TfLiteDepthwiseConvParams*)node->builtin_data;

    // The master switch, and it is checked before anything else because
    // "switched off" has to mean the layer never touches the per-class state,
    // never runs the one-time check, and never counts as an eligible layer.
    // Read as a variable rather than compiled out - see gpu.h - so the same
    // binary can be measured both ways on the same still scene.  0 is the
    // reset value, so an un-flipped board runs the stock CPU kernel on every
    // layer, which is the pipeline the product had before the GPU work.
    if (g_gpu_dw_on == 0u)               { return 0; }

    if (p == nullptr)                    { return 0; }
    if (p->depth_multiplier != 1)        { return 0; }
    if (p->dilation_width_factor  != 1)  { return 0; }
    if (p->dilation_height_factor != 1)  { return 0; }
    if (p->activation != kTfLiteActNone) { return 0; }

    // The two shapes, and nothing in between.  Stride is checked as a pair with
    // padding because the padding is what makes each one correct: SAME at
    // stride 1 preserves the size, VALID at stride 2 halves it.  A layer that
    // is SAME at stride 2 or VALID at stride 1 is a third geometry that
    // gpu_dw_conv() does not draw, and drawing the wrong geometry is a wrong
    // answer rather than a refusal - so it is refused here.
    if (p->stride_width != p->stride_height) { return 0; }
    if (p->stride_width == 1)
    {
        if (p->padding != kTfLitePaddingSame) { return 0; }
    }
    else if (p->stride_width == 2)
    {
        if (p->padding != kTfLitePaddingValid) { return 0; }
    }
    else
    {
        return 0;
    }

    // Eval tensors, not TfLiteTensors: this runs during invoke, and nothing here
    // may allocate.  The TfLiteTensor form was only ever needed to reach the
    // quantization params, and prepare has already captured those into the DwQ
    // entry, so the invoker's own ResetTempAllocations() - which is called
    // WITHOUT TF_LITE_ENSURE_STATUS at micro_interpreter_graph.cpp and so fails
    // silently - always finds the temp pool clean and actually rewinds it.
    const TfLiteEvalTensor* fin  = ctx->GetEvalTensor(ctx, node->inputs->data[0]);
    const TfLiteEvalTensor* filt = ctx->GetEvalTensor(ctx, node->inputs->data[1]);
    const TfLiteEvalTensor* bias = ctx->GetEvalTensor(ctx, node->inputs->data[2]);
    const TfLiteEvalTensor* fout = ctx->GetEvalTensor(ctx, node->outputs->data[0]);
    if (fin == nullptr || filt == nullptr || bias == nullptr || fout == nullptr) {
        return 0;
    }

    if (fin->type  != kTfLiteInt8)  { return 0; }
    if (filt->type != kTfLiteInt8)  { return 0; }
    if (bias->type != kTfLiteInt32) { return 0; }
    if (fout->type != kTfLiteInt8)  { return 0; }
    if (fin->dims  == nullptr || fin->dims->size  != 4) { return 0; }
    if (filt->dims == nullptr || filt->dims->size != 4) { return 0; }
    if (fout->dims == nullptr || fout->dims->size != 4) { return 0; }
    // 3x3 only, and this is the last depthwise batch - the eight 5x5 layers are
    // NOT a matter of unfinished work.  They were emulated offline against this
    // model and this exact detection frame (tools/dw_gpu_emulate.py, which the
    // 3x3 class validates: it reproduces the measured stride-2 worst 25 as 26
    // and the measured split result worst 4 as 4, exactly), and they cannot be
    // drawn by gpu_dw_conv() for two independent reasons:
    //
    //   HALF OF THEM, in_zp != -128 (measured: -2, 10, 22 and 8 against -128 for
    //   all nineteen 3x3 layers).  Packing `in_q - in_zp` instead clips 44% of
    //   the input to 0 and measures 90 LSB of error on 3034 pixels; keeping
    //   +128 and moving (128 + in_zp)*sum(w) into the texture bias needs +-1523
    //   in a field nine bits wide, [-256, 255].  Both forms are measured, not
    //   estimated - the second one is what the first was derived to avoid.
    //
    //   THE OTHER HALF have ~67% of their output sitting at the BOTTOM of the
    //   byte range (their RELU floor: out_zp is -128, so the fused RELU is the
    //   byte clamp and the floor is byte 0).  Pass 1 clips there, and once it
    //   has, the split's correction is unrecoverable - it is added against a
    //   saturated byte.  Measured worst 18 with 79..115 pixels over the
    //   threshold, against the 3x3 class's 4.
    //
    // The split's arithmetic is NOT what fails: with the clamp removed from both
    // passes it is exact to 1 LSB on all 27 layers.  And lifting pass 1 with the
    // free half of the bias split was swept rather than argued - the best
    // constant lift is 0 for six of the eight, and where it is not it moves the
    // clip to the top where far more data lives.  There is no 16-bit destination
    // to escape into either; L_8 is the widest single-value one the driver has.
    //
    // WHAT ACTUALLY SEPARATES THE TWO CLASSES IS SATURATION, and that is the
    // thing to measure before believing the split on a layer: pass 1 never lands
    // on an end of 0..255 for ANY of the 19 3x3 layers, and does for every one
    // of the 5x5.  The bound in gpu_dw_bound() does not predict this - stride 1's
    // bound (9) exceeds DW_GAP_MAX (8), and the measured result went the OTHER
    // way from what that suggests: stride 1's single pass turned out to fail
    // once every channel was compared, so both 3x3 classes now run the split and
    // only the saturation count ever sorted them apart.
    if (filt->dims->data[1] != 3 || filt->dims->data[2] != 3) { return 0; }

    const int h = fin->dims->data[1];
    const int w = fin->dims->data[2];
    const int C = fin->dims->data[3];
    if (C <= 0 || C > DW_MAX_CH)      { return 0; }
    if (h <= 0 || w <= 0)             { return 0; }
    if (filt->dims->data[3] != C)     { return 0; }
    // The output shape the stride implies, derived here and then CHECKED
    // against the tensor rather than taken from it: reading oh/ow off fout and
    // handing them to gpu_dw_conv() would make the validation there a
    // tautology, and the point of it is to catch a layer whose declared output
    // does not match what the stride says.
    const int oh = (p->stride_width == 1) ? h : (((h - 3) / 2) + 1);
    const int ow = (p->stride_width == 1) ? w : (((w - 3) / 2) + 1);
    if (oh <= 0 || ow <= 0)           { return 0; }
    if (fout->dims->data[1] != oh)    { return 0; }
    if (fout->dims->data[2] != ow)    { return 0; }
    if (fout->dims->data[3] != C)     { return 0; }
    if (fin->data.int8 == nullptr)    { return 0; }
    if (filt->data.int8 == nullptr)   { return 0; }
    if (bias->data.i32 == nullptr)    { return 0; }
    if (fout->data.int8 == nullptr)   { return 0; }

    DwQ* q = dw_q(node->inputs->data[1], node->inputs->data[0]);
    if (q == nullptr || !q->ready || q->c != C) { return 0; }

    // The pack is `in_q + 128`, which is `in_q - in_zp` with in_zp assumed to be
    // -128, and that is the only shift the texel can carry: it is an UNSIGNED
    // five bits, so the code has to be non-negative.  All 19 3x3 layers in this
    // model do have in_zp = -128, but that is a property of how the converter
    // quantised them and not of any test above, so it is asserted here rather
    // than relied on.  A layer with any other zero point would be drawn WRONG -
    // not refused - and a wrong answer is the one outcome the fallback exists to
    // prevent.  See the 5x5 note above the kernel-size test for what it costs
    // when it is not -128.
    if (q->izp != -128) { return 0; }

    j->fin  = fin;
    j->filt = filt;
    j->bias = bias;
    j->fout = fout;
    j->q    = q;
    j->h    = h;
    j->w    = w;
    j->c    = C;
    j->oh    = oh;
    j->ow    = ow;
    j->stride = p->stride_width;
    return 1;
}

// The GPU pass itself, split out so the caller can tell the two answers apart:
// a 0 here is the GPU refusing to draw, and that is the only thing worth
// disabling the feature over.
static int dw_draw(const DwJob* j, int split)
{
    // Scales and the output zero point come from the snapshot taken in prepare,
    // which is the only place they were reachable.  gpu_dw_conv() takes the
    // input scale per channel; in this model they are all the same number.
    for (int i = 0; i < j->c; i++) { s_dw_inscale[i] = j->q->isc; }

    return (gpu_dw_conv(j->fin->data.int8, j->filt->data.int8, j->bias->data.i32,
                        s_dw_inscale, j->q->wsc, j->q->osc, j->q->ozp,
                        j->h, j->w, j->c, j->stride, j->oh, j->ow, split,
                        j->fout->data.int8) == 0) ? 1 : 0;
}

// The one-time real-activation check, run on the first depthwise node of each
// stride class that is ELIGIBLE, and never again for that class except to try
// the split.  The caller has already established eligibility and hands over the
// DwJob it resolved, so this function cannot run on a layer the GPU does not
// draw - which is exactly the mistake it used to make, on op5, the first
// depthwise node, whose stride is 2.
//
// Two classes and not one, because eligibility widened and the first eligible
// node changed with it: op5 is now eligible, so a single check would sample the
// stride-2 path and then vouch for the 13 stride-1 layers it never ran on.  The
// two paths differ in the UV they hand gpu_dw_conv(), so a reading from one is
// not evidence about the other.
//
// `split` is the mode being measured, and it is a PARAMETER rather than
// something read from s_dw_check, because the caller runs this twice on the
// same layer when the cheap mode fails and the second run has to be able to ask
// for the expensive one.  It sets s_dw_check to 1 or 2 according to what passed
// and leaves the escalation decision to the caller.
//
// Same discipline as gpu_selftest(): the CPU answer is the reference, and the
// comparison is on real activations rather than on synthetic data, because that
// is the only version of the question that matters.  It is a sample and not the
// whole tensor - the first min(np*C, DW_CHK_PX) entries of the contiguous NHWC
// tensor, i.e. every channel of the first few hundred pixels - because the
// reference has to be copied out of the tensor before the GPU pass overwrites
// it, and a window that fits a small static buffer is worth more than a whole
// tensor that does not.
//
// The sample used to be `src[i * C]` - channel 0 of the first 8192 PIXELS - and
// that was not a smaller version of this check, it was a different one: the cap
// never bound, channel 0 was compared in full, and channels 1..C-1 were never
// looked at.  On 2026-09-17 that turned out to hide a real failure.  Stride 1
// read `worst 4 bad 0` on channel 0 and reads `worst 9 bad 1` over all channels;
// it had been passing single-pass on a sample that could not see the pixel that
// fails it.  So the coverage is part of the answer here, not a detail of it.
//
// Note what this does NOT prove: it says the first eligible layer of each class
// matched, on the sample above.  The rest of the layers are trusted on the
// strength of it, which is why `worst` is printed rather than just a verdict - a
// reading of 1 across the board is evidence, and a reading of 1 that is really
// 1-because-we-clamped-it is what DW_GAP_MAX exists to expose.
// Every bail in dw_run_check names itself, and there are only two left: the
// stock CPU invoke failing ("cpu") and the GPU refusing to draw ("gpu").  Both
// are real.  An ineligible layer no longer reaches here at all - see the note on
// dw_eligible() for why that mattered.
//
// The first version of this function set s_dw_check to -1 and returned from four
// different places without printing anything, and the whole visible symptom was
// a detection coming back `L0 D0 R0` with not one line in the log to say which
// of the four had fired.  A guard that disables the feature for the session has
// to say so.
static void dw_chk_bail(int s, const char* why)
{
    s_dw_check[s] = -1;
    sprintf(Message, "gpu dw chk bail s%d %s\r\n", s, why);
    UART_SendString(Message);
}

static void dw_run_check(TfLiteContext* ctx, TfLiteNode* node, const DwJob* j,
                         int split)
{
    const int C  = j->c;
    const int s  = j->stride;
    // The OUTPUT plane, not the input one.  These were j->h * j->w while every
    // eligible layer was stride 1 and the two were the same number; at stride 2
    // the output is a quarter of the input, and walking h*w pixels of an oh*ow
    // tensor would read past the end of it.
    const int np = j->oh * j->ow;

    // CPU first: it is the reference, and the GPU pass that follows writes over
    // the tensor it lives in, which is why the sample is copied out first.
    if (s_dw_stock.invoke(ctx, node) != kTfLiteOk) { dw_chk_bail(s, "cpu"); return; }

    // Interior and border are counted separately, not averaged into one number.
    //
    // They are two different claims: TFLM pads SAME with the input zero point,
    // the GPU pads with the border colour, and whether those agree is worth
    // knowing but is not what DW_GAP_MAX is about.  Measured on op21, the first
    // version of this check reported `worst 42 bad 1560` where the three sample
    // pixels it printed were all in column 0 - one number with a border-shaped
    // error in it cannot say whether the arithmetic moved or the edge did.
    //
    // For a stride-2 VALID layer there is no border at all: every tap of every
    // output pixel is inside the plane.  The classification below is still
    // applied, so both numbers print - but out there "border" is just more
    // interior, and both are expected to read the same small number.
    //
    // The sample is CONTIGUOUS, and that is what puts every channel in the
    // evidence.  It used to be `src[i * C]` - pixel i, channel 0, for the first
    // 8192 pixels - and since the largest eligible plane is 40x40 = 1600, the cap
    // never bound and channel 0 was compared in full while channels 1..C-1 were
    // never looked at.  The arithmetic is per-channel-identical (the emulation
    // checks all 27 layers on all channels and finds the split exact to 1 LSB),
    // but the HARDWARE that differs between channels is the CLUT base this
    // operator steps by GPU_DW_QUAD words per channel.  An off-by-one there
    // gives a channel the wrong taps and channel 0 cannot see it.
    //
    // In NHWC the first min(np*C, DW_CHK_PX) entries are exactly (pixel, channel)
    // pairs already, so this is the same buffer with the stride removed: the
    // layers whose tensors fit inside the cap - every 48- and 96-channel one -
    // are now compared over the WHOLE tensor, all channels, and the 24-channel
    // 40x40 ones get their first 341 pixels of every channel instead of all 1600
    // of one.  Same 8 KB, far more of the operator in it.
    const int total = np * C;
    const int n     = (total < DW_CHK_PX) ? total : DW_CHK_PX;
    const int8_t* src = j->fout->data.int8;
    for (int i = 0; i < n; i++) { s_dw_ref[i] = src[i]; }

    // The UV sweep that used to run here is gone, and what it measured is why:
    // all eight candidate windows were drawn against this reference and every
    // one of them was worse than the derived UV (worst 25 against 28, 30, 32,
    // 32, 93 and 113 for the others; the derived one also had the fewest pixels
    // over the threshold).  The window was never the fault.  gpu_dw_uv_set()
    // and its friends stay in gpu.c because they are the instrument, and a
    // stride-2 layer that stops matching after some future change should be
    // swept with them again before anything else is believed.
    if (!dw_draw(j, split)) { dw_chk_bail(s, "gpu"); return; }

    const int W = j->ow;           // the OUTPUT width: the loop strides the output
    int bad = 0, worst = 0;        // interior: the arithmetic
    int ebad = 0, eworst = 0;      // border ring: the padding rule
    int nin = 0, ned = 0;

    for (int i = 0; i < n; i++) {
        const int p = i / C;       // the PIXEL, since the sample is contiguous
        const int y = p / W;
        const int x = p - (y * W);
        int d = (int)src[i] - (int)s_dw_ref[i];
        if (d < 0) { d = -d; }

        if (x < 2 || y < 2 || x >= W - 2 || y >= j->oh - 2) {
            ned++;
            if (d > eworst) { eworst = d; }
            if (d > DW_GAP_MAX) { ebad++; }
        } else {
            nin++;
            if (d > worst) { worst = d; }
            if (d > DW_GAP_MAX) { bad++; }
        }
    }

    // Which mode earned the verdict is part of the verdict: 1 means the cheap
    // single-pass draw met the tolerance for this class, 2 means it did not and
    // the split did.  The caller reads it back to decide how to draw from here
    // on, so it is not a label - it is the switch.
    // The WHOLE plane decides it now, ring included.  This used to be `bad`
    // alone - the ring was reported but did not turn the feature off, because it
    // was failing on the border colour and an operator that is right everywhere
    // but the edge is still worth having.  That is no longer the situation: the
    // ring was the ARGB8888 border colour, dw_pass_bc() fixed it, and both
    // classes now measure `ed worst 4 bad 0` - identical to their interior, as
    // they should be, since a SAME layer's border is the same arithmetic with a
    // zero tap.  Keeping the exemption after that would only mean a future
    // border regression is reported and not acted on, which is the one shape of
    // failure this check is supposed to make impossible.
    s_dw_check[s] = ((bad + ebad) == 0) ? (split ? 2 : 1) : -1;

    // What the five-bit texel alone can cost THIS layer, independent of any
    // window: max over channels of m*3.5*sum|w|, which is the bound on the
    // truncation residual that is not compensated by the bias.  Printed for
    // every run so that the split's two lines can be read against each other -
    // the bound does not change between them, only `worst` does, and that
    // difference is the whole evidence that the residual was the cause.
    sprintf(Message, "gpu dw uvb s%d sp %d m35sumw %d worst %d gapmax %d\r\n",
            s, split, (int)(gpu_dw_bound() + 0.5f), worst, (int)DW_GAP_MAX);
    UART_SendString(Message);

    // Both numbers always, pass or fail: a border that is wrong while the
    // arithmetic is right is a different finding from the reverse, and printing
    // only on failure hides the case where the interior is clean and the ring is
    // not - which is exactly the state this check was in until 2026-09-17.
    // Tagged with the stride class, because both classes print this line now and
    // two unlabelled pairs of numbers from two different geometries would be
    // unreadable in the log.
    sprintf(Message, "gpu dw chk s%d in n %d worst %d bad %d\r\n", s, nin, worst, bad);
    UART_SendString(Message);
    sprintf(Message, "gpu dw chk s%d ed n %d worst %d bad %d\r\n", s, ned, eworst, ebad);
    UART_SendString(Message);

    // The shape of the error, not just its size.  A constant offset shows as two
    // ranges of equal width, a scale error as a GPU range that is the CPU range
    // multiplied, and saturation as a GPU range pinned to -128/127 - and the
    // pairs tell the three apart in one line.
    //
    // The three samples are the first, middle and last PIXEL of whatever the
    // sample actually covers, not of the plane.  They used to be the plane's
    // centre and three rows below it, named by pixel index; with the sample now
    // contiguous and capped at DW_CHK_PX, a plane-indexed pixel can fall outside
    // it and read past the buffer, so the sampled range is what they name.  Both
    // sides are read through the SAME index, which the contiguous sample made
    // true: s_dw_ref[j] and src[j] are both (pixel j/C, channel j%C).
    if (s_dw_check[s] < 0) {
        const int npx  = n / C;
        const int last = (npx - 1) * C;
        const int mid  = (npx / 2) * C;
        const int ci3[3] = { 0, mid, last };

        int cl = s_dw_ref[0], ch = s_dw_ref[0];
        int gl = src[0],      gh = src[0];
        for (int i = 0; i < 3; i++) {
            const int k = ci3[i];
            if (s_dw_ref[k] < cl) { cl = s_dw_ref[k]; }
            if (s_dw_ref[k] > ch) { ch = s_dw_ref[k]; }
            if (src[k] < gl) { gl = src[k]; }
            if (src[k] > gh) { gh = src[k]; }
        }
        sprintf(Message, "gpu dw rng c %d..%d g %d..%d\r\n", cl, ch, gl, gh);
        UART_SendString(Message);

        sprintf(Message, "gpu dw d %d %d %d %d %d %d\r\n",
                (int)s_dw_ref[0], (int)src[0],
                (int)s_dw_ref[mid], (int)src[mid],
                (int)s_dw_ref[last], (int)src[last]);
        UART_SendString(Message);
    }

    // Printed at detection time, not at init: the boot trace before
    // `yolo init ERROR` is kept clean on purpose.  The verdict covers the whole
    // plane, ring included - see the note at the assignment.  `n`/`worst`/`bad`
    // on the line remain the INTERIOR's, because that is the arithmetic and the
    // number to compare against a previous run; the ring's pair is printed above.
    //
    // `sp` is in the verdict line as well as the bound line.  It reads 1 for
    // every class now that both are measured on the split form (see the note at
    // the call), so `OK sp 0` is no longer a line this code can produce - but the
    // field stays, because it is what made the old two-verdict log readable and
    // because a log from before that change still has to be read correctly.
    sprintf(Message, "gpu dw check s%d %s sp %d n %d worst %d bad %d\r\n",
            s, (s_dw_check[s] == 1) ? "OK" : ((s_dw_check[s] == 2) ? "OK2" : "FALLBACK"),
            split, nin, worst, bad);
    UART_SendString(Message);

    // ================= IS ONE DRAW DETERMINISTIC? =========================
    //
    // WHY. The product's depthwise output is unstable BETWEEN RUNS of one
    // frozen frame: `x` then `i` x4 on one retained rgb[] gave four different
    // plates and four different box sets, every box `cls 0`, with the drain
    // counters CLEAN (`strt0 nz0 bus001 to0`, only the one `keep ms0` IDLE
    // sighting) - so it is not a start, not the fetch gate and not a timeout.
    // The check above passes (`worst 6` / `worst 4`) on both classes and is
    // stable across boots, which means the ONE draw it measures is fine and
    // says nothing about the other seventeen layers.
    //
    // So the question this line answers is the one that splits the remaining
    // two candidates, and it needs a second draw of THIS layer and no new
    // instrument: draw the same layer twice, back to back, same source, same
    // CLUT, same destination, same uv, and compare the two GPU results.
    //
    //   `gpudiff worst 0`   -> one draw IS deterministic, so the instability
    //                          enters BETWEEN draws - between layers, i.e. in
    //                          state one layer leaves for the next.
    //   `gpudiff worst > 0` -> a single draw is not reproducible from the same
    //                          inputs. That is the race, and it is inside
    //                          gpu_dw_conv/dw_pass_bc, not in the chain.
    //
    // FREE, and it cannot change the product. dw_run_check()'s draws are
    // ALWAYS overwritten: the caller draws this layer again at its own call
    // site (the `s_dw_check < 0` test is followed by `dw_draw`), so the layer's
    // final output is the caller's draw either way. This is one extra draw on
    // ONE layer per stride class per boot, and only when the verdict passed -
    // a failed class is already going to the CPU and must not be drawn again.
    //
    // s_dw_ref is reused rather than dedicating another 8 KB: every reader of
    // it above (the CPU comparison, `rng`, `d`) has already run. A draw that
    // gives up here is reported, not acted on: the same give-up has already
    // latched s_dw_gpu_dead inside gpu.c, so every later layer is refused
    // whatever this line prints.
    if (s_dw_check[s] >= 0) {
        int gw = 0, gbad = 0;

        for (int i = 0; i < n; i++) { s_dw_ref[i] = src[i]; }

        if (dw_draw(j, split)) {
            for (int i = 0; i < n; i++) {
                int d = (int)src[i] - (int)s_dw_ref[i];
                if (d < 0) { d = -d; }
                if (d > gw) { gw = d; }
                if (d > DW_GAP_MAX) { gbad++; }
            }
            sprintf(Message, "gpu dw gpudiff s%d n %d worst %d bad %d\r\n",
                    s, n, gw, gbad);
        } else {
            sprintf(Message, "gpu dw gpudiff s%d refused\r\n", s);
        }
        UART_SendString(Message);
    }
}

static TfLiteStatus dw_gpu_invoke(TfLiteContext* ctx, TfLiteNode* node)
{
#if GPU_ENABLE
    // Once, on the first depthwise node of the first inference.  `q` is how many
    // layers prepare managed to capture (0 means prepare never ran or never got
    // past its guards); `e/s/d` are the eval-tensor access this whole path is
    // built on.  Without this line, "invoke is never reached" and "invoke runs
    // and bails" look identical in the log.
    {
        static int once = 0;
        if (once == 0) {
            /* 2026-10-12: the LATCH is outside the gate (once = 1 runs either way),
               only this one-shot report is behind BOOT_VERBOSE - it fires on the
               first inference, i.e. right after `boot ok`, so at 0 the delivered
               log goes straight from `boot ok` to `#1 plate: ...`. */
            once = 1;
#if BOOT_VERBOSE
            {
                const TfLiteEvalTensor* e = ctx->GetEvalTensor(ctx, node->outputs->data[0]);
                sprintf(Message, "gpu dw call q%u e%u s%u d%u\r\n",
                        (unsigned)s_dwq_n, (unsigned)(e != nullptr),
                        (unsigned)((e != nullptr && e->dims != nullptr) ? e->dims->size : 9u),
                        (unsigned)((e != nullptr && e->data.int8 != nullptr) ? 1u : 0u));
                UART_SendString(Message);
            }
#endif
        }
    }

    // Asked first because it is free and it is what decides whether anything
    // below matters: an ineligible layer never touches the per-class state.
    DwJob j;
    if (!dw_eligible(ctx, node, &j)) { return s_dw_stock.invoke(ctx, node); }

    // Reports the previous inference's fingerprint and seeds this one's - see
    // the block above.  Placed here, after eligibility, because it needs j.q,
    // and before every exit below so that a layer which falls back to the CPU
    // still occupies its column: a column that silently vanished would shift
    // every position after it and make two runs look different for a reason
    // that is not the operator's.
    dw_hash_wrap(&j);

    // The tail cut, and it is asked AFTER eligibility on purpose - see gpu.h on
    // g_gpu_dw_tail.  Two reasons it is not folded into dw_eligible(): a layer
    // refused here is refused for this reason alone and reads as such, and the
    // per-class one-time check below still runs on the first layer that is
    // ACTUALLY offloaded rather than on the first one that happens to be
    // eligible, which is what makes a high threshold a valid measurement of the
    // layers that remain.
    //
    // The ordinal is the layer's index into s_dwq[], which prepare filled in
    // model order - so it increases with depth, and `>=` takes a contiguous tail
    // of the network.  j.q is always in s_dwq[] here: dw_eligible() fills it
    // through dw_q() or returns 0.
    if ((g_gpu_dw_tail != 0u) &&
        ((uint32_t)(j.q - s_dwq) < g_gpu_dw_tail)) {
        dw_hash_rec(&j);
        return s_dw_stock.invoke(ctx, node);
    }

    // The verdict is per stride class, and so is the run.  s_dw_check[j.stride]
    // == 0 means that class's one-time real-activation comparison has not run
    // yet; it runs on the first layer of that class that is actually eligible -
    // which is op5 (stride 2) and op21 (stride 1) in this model - and never
    // again.  A class that has failed is on the CPU for the rest of the session
    // while the other class keeps running.
    if (s_dw_check[j.stride] == 0) {
        // The SPLIT form is measured, unconditionally, for both stride classes.
        // The single-pass form used to be tried first and kept wherever it
        // passed, on the reasoning that it is half the packing and half the
        // draws.  What killed that is not an opinion about the two forms: it is
        // that stride 1's residual bound (9) EXCEEDS DW_GAP_MAX (8), so the
        // class can only pass single-pass on a frame that does not reach its own
        // bound, and the verdict therefore depended on which frame happened to
        // be in front of the camera.  Same binary, two runs: `worst 8 bad 0` ->
        // OK -> 1368 draws / 3.26 s, and `worst 9 bad 1` -> FALLBACK -> escalate
        // -> 2208 draws / 4.57 s.  A number that changes between runs of one
        // binary is not a baseline, and this stage is counted in draws on the
        // GPU, so the form that always runs is measured.
        //
        // Nothing else about the check changes.  It is still the GPU-versus-CPU
        // byte comparison on real activations, still runs once per class on the
        // first eligible layer of that class, still decides the fallback, and a
        // class whose split fails it still goes to the CPU permanently - which
        // is the constraint that matters more than any of the above.
        dw_run_check(ctx, node, &j, 1);
    }
    if (s_dw_check[j.stride] < 0) { dw_hash_rec(&j); return s_dw_stock.invoke(ctx, node); }

    // The split is per class and sticky for the session - the check above is
    // what decided it, and its verdict is what is read back here.
    // Which layer this is, and on which geometry, in execution order - printed
    // BEFORE the draw so that the last line of a log names the layer a run died
    // in rather than the last one it survived.
    //
    // This is not a progress bar, and it is here because of a specific reading
    // mistake.  From `gpu dw call` (once per session) and the two class checks
    // (once per class) onward the log is SILENT for the rest of the inference,
    // so a run that dies in the third GPU layer prints the same last line as a
    // run that dies in the seventeenth.  Two logs of two different deaths were
    // read as one death at one place.  Nineteen extra lines per inference buys
    // the difference between "somewhere in the inference" and "layer N".
    //
    // SINCE 2026-09-24 THE PAIR IS A KEY (`y`, g_gpu_dw_trace) and not
    // automatic, because the automatic form could not be measured - which is
    // the only thing it had to do.
    //
    // It was automatic once per boot: print on the first inference after
    // g_gpu_dw_on goes to 1, with the frame boundary detected by the layer
    // ordinal going BACKWARDS (exact here - the layers are visited in model
    // order within one inference, prepare filled s_dwq[] in model order, and
    // j.q is always in s_dwq[] because dw_eligible() put it there).  The intent
    // was to keep 38 lines a frame out of the interval the `gpu dw L.. D.. R..`
    // summary reports.  The intent failed on its own terms: the only frame the
    // trace ever printed on is ALSO the frame that runs the two class checks,
    // which cost ~1.16 s by themselves (capture A: the check frame 4886 ms
    // against 3724 production), so the trace's cost came out anywhere between
    // 0.2 s and 1.1 s a frame depending on which cross-boot comparison was
    // used, and no comparison could settle it.  Re-arming cost a power cycle,
    // so it could not be A/B'd within a boot either.  Same defect as a guard
    // whose sample coverage is part of its answer.
    //
    // Now: while g_gpu_dw_trace is 1 EVERY frame prints its 19 pairs.  That is
    // what makes the cost measurable - `x` a few times, `y`, `x` a few more,
    // one boot, one scene, one operator set, class checks already latched out
    // of the way after the first frame.  The 38 lines are then paid knowingly.
    //
    // SETTLED 2026-09-24 BY THE FIRST BOOT THAT COULD BEAR IT, and the key to it
    // was pricing the give-up in gpu.c (`cy820422647` = 1.367 s, measured,
    // against the "about a third of a second" the estimate had implied).  The
    // frame that carried both the trace and the stall stopped being unpriceable
    // once the stall had a price.  One boot, one scene, three equations:
    //
    //     no trace, 19 layers on the GPU       4016.2 ms  (frames 2-4, all R0)
    //     trace, stall, 17 drawn / 2 refused   5345.4 ms  (frame 5)
    //     trace, latched, 19 layers on the CPU 1803.8 ms  (frames 6-7)
    //
    // -> the GPU costs 127.9 ms a layer, independently matching the 128.4 ms a
    // layer this file's own arm measurement recorded, which is what makes the
    // solution trustworthy rather than merely exact.  THE TRACE IS 217.6 ms A
    // FRAME, 5.7 ms a line.  So "~8 ms a line" was a 30% estimate after all and
    // the cross-boot 1.1 s was the artifact: that FALSIFIED verdict is WITHDRAWN.
    // The same paragraph's claim that UART_SendString() is not costing byte-time
    // goes with it - 217.6 ms over 38 lines of ~20 characters is ~0.29 ms a
    // character against 87 us of wire time at 115200, which is ordinary byte time
    // plus a constant per call and nothing more exotic than that.  The two class
    // checks cost 597.8 ms in the same boot (frame 1 at 4614.0 against those
    // 4016.2); use that rather than capture A's cross-boot 1.16 s.
    //
    // `gpu dw drn .. cy..` in gpu.c is the same question about the drain, and it
    // is answered the same way now: 38.06 cycles a poll, 0.43 ms an honest drain,
    // which is under 1% of what the offload costs a frame - so the depthwise
    // price is the DRAWING and not the waiting, measured rather than assumed.
    //
    // `L<n> cpu` is a REFUSAL, not part of the shape of a run, and it is
    // printed even when the trace is off: the aggregate `R` in the `gpu dw`
    // summary says the trace was off, never that nothing was refused.
    //
    // `ow x oh` is the OUTPUT width times height, which is also the geometry the
    // destination plane is addressed with - at stride 1 it equals the input's,
    // at stride 2 it is the quarter-size one.  The trailing fields are what the
    // refusal logic in gpu_dw_conv() is decided on.
    {
        static unsigned s_dw_run = 0u;
        unsigned        idx = s_dw_run;

        const unsigned trace = (g_gpu_dw_trace != 0u) ? 1u : 0u;

        s_dw_run++;
        if (trace != 0u) {
            sprintf(Message, "gpu dw L%u %ux%u c%u s%d\r\n", idx,
                    (unsigned)j.ow, (unsigned)j.oh, (unsigned)j.c, j.stride);
            UART_SendString(Message);
        }

        if (!dw_draw(&j, (s_dw_check[j.stride] == 2) ? 1 : 0)) {
            // Two words, and they are the difference between three different
            // deaths.  `L<n>` alone says the layer was ENTERED; a log that ends
            // there cannot say whether the draw ran, whether the GPU refused it
            // and the CPU took over, or whether the operator finished and the
            // eleven CPU operators that follow (CONV_2D, CONCATENATION,
            // TRANSPOSE, RESHAPE, GATHER - printed by tools/op_sequence.py) are
            // where it stopped.  Those three have different causes and only one
            // of them is in gpu_dw_conv().  Unconditional, unlike the pair
            // above: this is the branch that says the layer did NOT draw.
            //
            // `sy` is the hardware sync id, and on THIS line it is the one place
            // the wedge can be read.  The drain's own `drain dead` line prints
            // the register twice and both words are equal by construction (the
            // loop falls through only while it has NOT moved), so that line
            // cannot say whether the counter moved during its twenty million
            // polls - and that is the difference between a GPU that STOPPED and
            // one that was merely BEHIND a job.  These refusals are free: a
            // latched refusal touches no hardware, the line is printed anyway,
            // and it keeps being printed for every remaining layer of every
            // remaining frame.  A column of them across the rest of a boot is
            // therefore a sampled trace of the register, at no cost and with no
            // polling - if the counter ever moves again, the GPU was never dead.
            //
            // 2026-09-24, FIRST READING: `sy10454` on both refusals of frame 5
            // and on all 38 of frames 6-7 - identical across ~11 s of wall time.
            // So the answer is STOPPED, and the caveat is what makes the reading
            // work rather than a hole in it: after the latch NOTHING is
            // submitted, so the only thing that could have moved this register
            // is the PENDING job completing.  It did not, within 11 s of a
            // give-up that had itself already waited 1.367 s.  A GPU merely
            // twelve seconds behind a job is not a reading to build on.
            sprintf(Message, "gpu dw L%u cpu sy%u\r\n", idx, (unsigned)gpu_sync_id());
            UART_SendString(Message);
            dw_hash_rec(&j);
            return s_dw_stock.invoke(ctx, node);
        }

        if (trace != 0u) {
            sprintf(Message, "gpu dw L%u drew\r\n", idx);
            UART_SendString(Message);
        }
    }

    dw_hash_rec(&j);

    return kTfLiteOk;
#else
    // GPU_ENABLE 0: the body is a stub onto the STOCK CMSIS-NN kernel, which is
    // exactly the arm the GPU path falls back to on every ineligible layer.  The
    // registration in yolo_plate_init is deliberately left untouched (see gpu.h's
    // GPU_ENABLE block), so the depthwise impl still points here - and the point
    // of the stub is that nothing in this function refers to gpu.o, which is the
    // property the map check reads.  Do not "simplify" this away by removing the
    // registration instead: the registration is what keeps the two builds' op
    // ordering identical.
    return s_dw_stock.invoke(ctx, node);
#endif
}

// ===========================================================================
// CONV_2D (pointwise) GPU offload
// ===========================================================================
//
// The same shape as the depthwise block above, deliberately: ConvQ is a DwQ
// sibling, conv_gpu_prepare is dw_gpu_prepare, conv_eligible is dw_eligible,
// conv_run_check is dw_run_check, and conv_gpu_invoke replaces one field of one
// TFLMRegistration exactly the way dw_gpu_invoke does.  Anything here that
// differs from its depthwise counterpart differs for a reason that is written
// down at the difference; nothing differs because it was easier.
//
// The operator itself is in gpu.c (gpu_conv), which owns every dhd_* call and
// includes no TFLM header.  What this block owns is the TFLM side: which layers
// qualify, the quantization parameters, and the one-time byte comparison that
// decides whether a layer is ever allowed on the GPU again.
//
// THE PER-LAYER CHECK, AND WHY IT IS PER LAYER HERE
//
// The depthwise check is per stride CLASS - two runs vouch for 19 layers,
// because those 19 layers are one geometry drawn by one code path and a
// measurement of one of them is evidence about all of them.  That argument does
// NOT hold for these 52 layers.  They differ in cin (3..288, so 1 to 9 chunks),
// in cout (3..96), in their quantization scales, and in which of the two
// designs' failure modes they sit near.  Offline emulation of exactly this
// model on exactly this detection frame (tools/conv_gpu_emulate.py) says 38 of
// them are structurally clean at the chunk this operator draws, 4 are clean
// only after narrowing the chunk, and 10 are walls - so a per-class verdict
// would vouch for 52 layers on the strength of a number that is already known
// to be wrong for a fifth of them.  Hence: each layer is measured once, on real
// activations, and a layer that fails is on the CPU for the rest of the
// session while every other layer carries on.
//
// That is also why `n` - the ConvQ slot - is the check's key rather than a
// class index: the verdict has to be per layer, so it has to be indexed by
// something that names one layer.
//
// The cost of measuring every layer is one CPU convolution per layer on the
// FIRST inference only (the stock invoke runs first because it is the
// reference), i.e. that inference costs about twice a normal one.  Every
// inference after it is the GPU's, and there is no way to learn this per layer
// without paying it once.

// The chunk this operator draws with is FIXED at 32 (two texture units, 16 taps
// each) - it is not a parameter, unlike the depthwise split - so K is not a
// choice the glue makes and is only computed here to report it.
#define CV_MAX_CIN    320      // gpu.c's GPU_CV_MAXCIN; kept in step by CV_MAX_CIN_CHK
#define CV_MAX_COUT   128
#define CV_MAX_LAYER  64
#define CV_CHK_PX     8192

// The layer the three-way dump fires on, once per boot - see gpu_cv_dump().
//
// n47 HELD THIS SPOT AND IS NOW SPENT.  It was chosen as the model's smallest
// inspectable failure - op210, 72->3 at 10x10, 300 output bytes - and it did its
// job twice over: the dump proved the firmware's per-(co, chunk) constants agree
// with the offline model FIELD FOR FIELD, nine of nine sets, and at PLANE 128 it
// now passes (`chk n47 worst 9 bad 0 OK`).  A passing layer has no disagreement
// left for a dump to find, so the target moves to one that is still failing.
//
// n43 IS THE NEW TARGET - op201, 72->12 at 20x20 - and it is chosen for the
// SHAPE of its error, which is the opposite of n47's and easier to fit:
//
//   * 1043 bad of 4800 compared bytes, worst 17.  That is a fifth of the plane
//     over the lim12 line by only 5, so there are a thousand samples to fit a
//     line to.  Every other failing head layer is a handful of pixels off by
//     ~68, where the only fit available is one pixel's worth of evidence.
//   * `sat c0 g0` on its rng line - NOTHING clamps anywhere in this layer, and
//     its planes read at0 0 at255 0 with mx 130-140.  So the fault is not a
//     rail and not a clipped texture unit, which removes the two mechanisms
//     every previous head investigation was spent on.
//   * its per-unit bias pair is the most extreme in the model.  `bu -68 -17`
//     against every passing layer's `~64 ~64`, a NEGATIVE hi pair total
//     (`b -85 121` where a passing layer reads ~128 128), and `bsum 50600`
//     against everyone else's ~77000.  The window is being driven hardest here,
//     and the field is 9 bits: if the window algebra is wrong anywhere, this is
//     the layer that has to show it.
//
// The two knobs the offline model has were both tested before asking for a
// flash and BOTH ARE EXONERATED: CV_REP=0, CV_GAIN=0 and the shipped default
// leave all 14 cin-72 head layers at `fix_draw` worst 5 bad 0, so neither the
// 5-bit replication nor the declined `1/(1+g)` - which the census does catch
// happening, `g0 raw396 inv1000` on n38 - is what the board is failing on.  A
// model that cannot express the fault cannot be asked which change fixes it, so
// the next reading has to be the board's own bytes.
// -1: OFF, and for the first time in this round the reason is not that the
// target is spent but that the question moved off the byte plane.
//
// WHAT n47 AND n43 BETWEEN THEM SETTLED.  The dump is a spend of one layer per
// boot and ~8 KB of serial, so it has to be answered for:
//
//   * the fold is EXACT.  Recomputed from the board's own six dumped planes,
//     `rnd(net - bsum + SUM_k pl_k)` reproduces the board's own `gpu` blob 400
//     of 400 bytes, worst 0 - so `pstride 512`, `cw 6`, `bsum 505.00` and
//     `net -85.73` are all right and the planes ARE what the operator returned.
//   * the per-(co, chunk) constants agree with the offline model field for
//     field.  The reconciliation printed 411 MIRROR-RECON lines over 12
//     channels x 3 chunks once the print was made wall-safe.
//   * the fault is ONE PLANE and it is pl0.  Board vs mirror per plane: pl0
//     +7.35 mean with a +0.028 slope on the value and 0 of 400 bytes exact,
//     while pl1..pl5 are within 1-3 bytes with 100-253 exact.  pl0 is the only
//     plane in the layer whose bias pair total is negative (-85) and the only
//     one where neither unit comes near a rail (post-bias minima +59, +58), so
//     it is the one plane that reports the hi digit's scale with no clamp in
//     the way.  Its deficit is 3.16% / 3.01% of the plane's partial content for
//     k0/k1 against those chunks' own g of 3.06% / 2.84%.
//   * BOTH of the model's knobs are exonerated on the board's own K=3 rung.
//     Three-way sum deficit: shipped +11.408, CV_GAIN=0 +13.970, CV_REP=0
//     +12.213.  The shipped setting is the best of the three, so the hardware
//     DOES apply the 5-bit replication gain and the firmware's inv is right.
//
// WHAT IS OWED INSTEAD, and why it cannot be this dump.  The next question is
// not what a plane contains - it is whether the product still DETECTS with the
// conv path on, which no log in this round has ever confirmed.
//
// The expense is not the argument for turning it off, and saying it was would
// be wrong.  `gpu_cv_dump()` rides `conv_run_check`, and the `s_cv_check` latch
// runs that ONCE per layer per boot, so the dump fired once per boot and not
// once per frame: for n43 it is `in` 72*400 = 28800 B + six planes 2400 B +
// `out` 4800 B, plus the glue's `cpu` and `gpu` blobs 9600 B, so ~1.4k lines
// and ~4 s of UART, once.  The argument is that the READING is spent - the fold
// is proved exact from these very planes and the per-(co, chunk) constants are
// proved equal to the offline model - so the one plane still disagreeing has
// nothing left to say that its own byte trace has not already said, while the
// detection question has never been asked at all.  One boot, one question.
//
// WHEN TO ARM IT AGAIN.  The pl0 gap is still open and it is a real correctness
// defect on a layer the head depends on.  The next reading that would move it is
// not one layer's bytes but a per-(layer, channel) six-plane census across the
// whole shipped set, so that one boot names every layer carrying the anomaly
// instead of one layer per build - see the note on `CV_DUMP_N`'s replacement.
#define CV_DUMP_N     (-1)

// How far the GPU answer may sit from the CPU's on the same activations before
// the layer is handed back for good.
//
// Not a single number's worth of arithmetic - it is the sum of three things
// that are known and one that is not:
//   * the 5-bit entry.  Every activation is quantised to a 5-bit unsigned field
//     on the way in, so a tap is off by up to 3.5 against weights that reach
//     127.  This is the design working, not a bug.
//   * the truncation floor.  Each of the 2*K digits truncates instead of
//     rounding, and the floor that buys is measured per layer offline: 2..5 LSB
//     at chunk 32 across this model.
//   * two truncations per digit, not one.  Each texture unit truncates its OWN
//     partial sum before the colour ADD sums them, so where the emulator models
//     one truncation the hardware has two - always downward, worth up to 1 LSB
//     per unit, i.e. up to 2 per digit.  The emulator cannot see this and gpu.h
//     says so at the contract.
//   * the drift `corr` deliberately does not model: the mean of each digit's
//     fractional part.  Measuring it needs a full CPU convolution per layer,
//     which is the thing this whole path exists to avoid; what is known is that
//     every digit is CENTRED, so its fractional part straddles zero and its
//     mean is small by symmetry.
//
// 12 is the depthwise bound (8) with the last two terms priced in.  It is a
// single number for 52 layers with different floors rather than a table,
// because a table would have to be regenerated every time the model changes and
// a wrong table fails in the direction of trusting the GPU more.  A layer whose
// real floor is near the bound is refused, which costs draws, not correctness.
#define CV_GAP_MAX    12

static TFLMRegistration s_conv_impl;
static TFLMRegistration s_conv_stock;

struct ConvQ {
    int   filt;                 // node->inputs->data[1]: the layer's filter tensor
    int   fin;                  // node->inputs->data[0]: the layer's INPUT tensor
    int   n;                    // its own slot: the key s_cv_check is indexed by
    int   cin;
    int   cout;
    int   ready;
    // The same snapshot as DwQ, and for the same reason: the TfLiteTensor form
    // is only reachable in prepare, and reading one allocates.
    float isc;                  // input activation scale  - per-tensor here
    float osc;                  // output activation scale - per-tensor here
    int   izp;                  // input zero point  - NOT required to be -128
    int   ozp;                  // output zero point - decides whether RELU is free
    float wsc[CV_MAX_COUT];     // per-output-channel weight scales
};

static ConvQ  s_cvq[CV_MAX_LAYER];
static int    s_cvq_n = 0;
static int8_t s_cv_ref[CV_CHK_PX];

// 0 = this layer's one-time check has not run yet, 1 = it passed, -1 = it failed
// and the layer is on the CPU for the rest of the session.  Indexed by ConvQ
// slot; see the per-layer note above for why this is not indexed by class.
static signed char s_cv_check[CV_MAX_LAYER];

// The census budget lived here.  It is gone on purpose: the census now rides the
// production draw on channel 0 for every layer (see conv_run_check), so there is
// nothing to bound - it costs one byte walk per plane and no draw at all, and
// bounding it is what made only four of 51 layers comparable with the offline
// table.  tools/conv_gpu_emulate.py's row for a layer is what a census line is
// checked against; a census that skips layers throws away oracles.

// THE KEY IS (filter tensor, input tensor), AND `filt` ALONE IS NOT ENOUGH.
//
// This was `conv_q(filt)`, matching on `node->inputs->data[1]` alone.  It cost
// three layers of the model, and the way it cost them is worth stating exactly
// because nothing printed for them at all:
//
//   tools/conv_filter_index.py reads the shipped .tflite and finds three filter
//   tensor indices used by TWO CONV_2D ops each -- tensor 48 by op191 (72->3,
//   20x20) and op210 (72->3, 10x10), tensor 45 by op194/op213 (72->70), tensor
//   34 by op201/op220 (72->12).  Slot 39 and 47, 40 and 48, 43 and 51.  The
//   board's 20x20 half of every pair printed; the 10x10 half printed NOTHING,
//   in two consecutive boots, with an explicit `held` line added between them.
//
// Why the silence was total rather than loud: the later node resolves to the
// EARLIER node's record, so it inherits that record's verdict.  `s_cv_check[39]`
// is -1, so the later node took the `held` path, whose line is de-duped per
// layer -- and slot 39 had already printed its own.  `conv_run_check` was never
// called for slot 47, so no `chk` line; and `s_cv_check` has exactly two
// writers, both of which print, so a record holding garbage was impossible.
// The nodes were simply never reached under their own number.
//
// The one guard that could have caught it is the `quant C mismatch` test in
// conv_eligible(), and it passes here precisely because each colliding pair has
// the same (Cin, Cout) -- 72->3, 72->70, 72->12.  What DOES differ is the thing
// each node reads: the 20x20 head branch eats a 20x20 tensor and the 10x10 one a
// 10x10 tensor.  Hence `fin`.
//
// This is not a hypothetical hazard.  op210/op213/op220 are the detection head's
// 3-channel, 70-channel and 12-channel branches at the small scale, and the
// plan requires op210 on the GPU.  Had slot 39 passed its check instead of
// failing it, op210 would have been DRAWN with slot 39's per-channel weight
// scales -- `wsc` is the whole reason a per-channel quantised layer can be drawn
// at all -- and wrong power-of-two scales do not look like a crash.
//
// The key is strictly tighter, so a model with no collision behaves bit-for-bit
// as before, and tools/conv_filter_index.py confirms the pair is unique for all
// 52 of this model's conv layers.
static ConvQ* conv_q(int filt, int fin)
{
    for (int i = 0; i < s_cvq_n; i++) {
        if (s_cvq[i].filt == filt && s_cvq[i].fin == fin) { return &s_cvq[i]; }
    }
    return nullptr;
}

// WHY A LAYER IS SILENT, SAID OUT LOUD.
//
// conv_eligible() refuses a layer by returning 0 and conv_gpu_invoke() then runs
// the stock kernel - correctly, silently, by design.  That silence cost a whole
// flash round: the board printed nothing for its slots n47 and n48 (this file's
// op210 and op213, the detection head among them), the offline eligibility table
// said both SHOULD be taken, and there was no way to tell a refusal from a
// capture failure without guessing.  A refusal is a decision, so it gets a line.
//
// Once per layer per boot, so a 52-layer model with a permanently refused layer
// prints 52 lines at most and never repeats them on the next inference.  CV_MAX_
// LAYER is 64 and the mask is 64 bits, which is why this is one integer and not an
// array.  n < 0 means the filter tensor has no ConvQ slot at all - the layer was
// never captured - and that is one line, not one per layer.
static unsigned long long s_cv_skip_seen = 0u;
static int                s_cv_skip_anon = 0;

static void cv_skip(int n, const char* why)
{
    if (n < 0) {
        if (s_cv_skip_anon != 0) { return; }
        s_cv_skip_anon = 1;
        sprintf(Message, "gpu cv skip n? %s\r\n", why);
        UART_SendString(Message);
        return;
    }
    if (n >= CV_MAX_LAYER) { return; }
    if ((s_cv_skip_seen & (1ull << n)) != 0u) { return; }
    s_cv_skip_seen |= (1ull << n);
    sprintf(Message, "gpu cv skip n%d %s\r\n", n, why);
    UART_SendString(Message);
}

// The layer's own slot, for cv_skip().  Safe to call before anything has been
// validated: it checks the node shape and returns -1 rather than dereferencing.
static int conv_layer_no(const TfLiteNode* node)
{
    // `node->inputs->data` is TfLiteIntArray's own inline `int data[1]`, so
    // testing it against nullptr is always false and the compiler says so.  The
    // size check below is what actually guards the index.
    if (node->inputs == nullptr) { return -1; }
    if (node->inputs->size < 2) { return -1; }
    ConvQ* q = conv_q(node->inputs->data[1], node->inputs->data[0]);
    return (q != nullptr) ? q->n : -1;
}

// prepare, wrapped only to capture the per-output-channel weight scales.
//
// Every CONV_2D filter in this model is per-output-channel quantised - 52 of 52,
// measured offline - so TfLiteTensor.params.scale, which is one float, is 0 for
// all of them.  The array lives in the TfLiteAffineQuantization, and TFLM micro
// is free to release that once AllocateTensors() has finished, so it is read
// here and not in invoke.  The reasoning, and the eleven-line failure it avoids
// when a temp tensor is not handed back, are in the comment on dw_temp_in().
static TfLiteStatus conv_gpu_prepare(TfLiteContext* ctx, TfLiteNode* node)
{
    TfLiteStatus st = s_conv_stock.prepare(ctx, node);
    if (st != kTfLiteOk) { return st; }

    if (s_cvq_n >= CV_MAX_LAYER) { return kTfLiteOk; }
    if (node->inputs == nullptr || node->outputs == nullptr) { return kTfLiteOk; }
    if (node->inputs->size < 3) { return kTfLiteOk; }

    tflite::MicroContext* mc = tflite::GetMicroContext(ctx);
    TfLiteTensor* fin  = dw_temp_in(mc, node, 0);
    TfLiteTensor* filt = dw_temp_in(mc, node, 1);
    TfLiteTensor* fout = dw_temp_out(mc, node, 0);

    // One exit, for the same reason dw_gpu_prepare has one.
    ConvQ* taken = nullptr;

    if (fin != nullptr && filt != nullptr && fout != nullptr &&
        filt->dims != nullptr && filt->dims->size == 4) {
        const int CI = filt->dims->data[3];
        const int CO = filt->dims->data[0];
        if (CI > 0 && CI <= CV_MAX_CIN && CO > 0 && CO <= CV_MAX_COUT &&
            fin->params.scale > 0.0f && fout->params.scale > 0.0f) {
            ConvQ* q = &s_cvq[s_cvq_n];
            q->filt  = node->inputs->data[1];
            q->fin   = node->inputs->data[0];
            q->n     = s_cvq_n;
            q->cin   = CI;
            q->cout  = CO;
            q->ready = 0;
            q->isc   = fin->params.scale;
            q->osc   = fout->params.scale;
            q->izp   = fin->params.zero_point;
            q->ozp   = fout->params.zero_point;

            if (filt->quantization.type == kTfLiteAffineQuantization &&
                filt->quantization.params != nullptr) {
                const TfLiteAffineQuantization* aq =
                    (const TfLiteAffineQuantization*)filt->quantization.params;
                if (aq->scale != nullptr && aq->scale->size == CO) {
                    for (int i = 0; i < CO; i++) { q->wsc[i] = aq->scale->data[i]; }
                    q->ready = 1;
                }
            }
            if (!q->ready && filt->params.scale > 0.0f) {
                for (int i = 0; i < CO; i++) { q->wsc[i] = filt->params.scale; }
                q->ready = 1;
            }
            if (q->ready) { taken = q; }
        }
    }

    if (fin  != nullptr) { mc->DeallocateTempTfLiteTensor(fin); }
    if (filt != nullptr) { mc->DeallocateTempTfLiteTensor(filt); }
    if (fout != nullptr) { mc->DeallocateTempTfLiteTensor(fout); }

    if (taken != nullptr) { s_cvq_n++; }
    return kTfLiteOk;
}

// What this resolves, so the caller does not have to re-derive it: which layer,
// which tensors, and the geometry gpu_conv() is about to be handed.  The check
// and the draw both use the same ConvJob, so they cannot disagree about what
// "this layer" means.
struct ConvJob {
    const TfLiteEvalTensor* fin;
    const TfLiteEvalTensor* filt;
    const TfLiteEvalTensor* bias;
    const TfLiteEvalTensor* fout;
    ConvQ* q;
    int  h, w;         // input plane == output plane
    int  cin, cout;
};

// The eligibility test.  Same discipline as dw_eligible: it proves "this is the
// shape I implement" rather than listing known-bad cases, because a layer it
// does not recognise is a layer it must not touch.
//
// There is exactly ONE eligible shape:
//
//     1x1 SAME stride 1, output == input
//
// which is 51 of this model's 52 CONV_2D layers.  The 52nd is op1, 3x3 stride 2
// VALID 160x160 -> 80x80, refused by the filter-size test below and left to the
// CPU.  It is not a matter of unfinished work in the sense that matters: a 3x3
// kernel cannot be expressed by a row of taps that also walks the channels, so
// it needs a different decomposition, and the offline table says it is the
// single cheapest layer in the model (Cin 3, 48 draws).  It is Step 3's second
// item, not a defect here.
//
// What is deliberately NOT tested, and this is the one place this function is
// less restrictive than dw_eligible:
//
//   in_zp.  dw_eligible refuses any layer whose input zero point is not -128,
//   because the depthwise pack is `in_q - in_zp` written into an UNSIGNED 5-bit
//   texel, so a zero point above -128 clips the input.  The pointwise pack is
//   `in_q + 128`, which is non-negative for every int8 and clips nothing, and
//   the `in_zp` that TFLM's accumulator subtracts is given back by the fold
//   instead (see gpu_conv's `net` term).  So the restriction does not apply, and
//   imposing it anyway would refuse layers for no reason.
// `why` is set at every refusal and reported by the caller (see cv_skip).  It is
// never read when this returns 1, and the master-switch refusal is not reported
// at all - see the caller.
static int conv_eligible(TfLiteContext* ctx, TfLiteNode* node, ConvJob* j,
                         const char** why)
{
    const TfLiteConvParams* p = (const TfLiteConvParams*)node->builtin_data;

    if (p == nullptr)                    { *why = "no params";     return 0; }
    if (p->dilation_width_factor  != 1)  { *why = "dilated";       return 0; }
    if (p->dilation_height_factor != 1)  { *why = "dilated";       return 0; }
    if (p->stride_width  != 1)           { *why = "stride";        return 0; }
    if (p->stride_height != 1)           { *why = "stride";        return 0; }
    if (p->padding != kTfLitePaddingSame) { *why = "not SAME";     return 0; }

    if (node->inputs == nullptr || node->outputs == nullptr) { *why = "node shape"; return 0; }
    if (node->inputs->size < 3)          { *why = "node shape";    return 0; }

    // Eval tensors, not TfLiteTensors: this runs during invoke and nothing here
    // may allocate.  The quantization params were captured in prepare.
    const TfLiteEvalTensor* fin  = ctx->GetEvalTensor(ctx, node->inputs->data[0]);
    const TfLiteEvalTensor* filt = ctx->GetEvalTensor(ctx, node->inputs->data[1]);
    const TfLiteEvalTensor* bias = ctx->GetEvalTensor(ctx, node->inputs->data[2]);
    const TfLiteEvalTensor* fout = ctx->GetEvalTensor(ctx, node->outputs->data[0]);
    if (fin == nullptr || filt == nullptr || bias == nullptr || fout == nullptr) {
        *why = "no eval tensor";
        return 0;
    }

    if (fin->type  != kTfLiteInt8)  { *why = "tensor type";  return 0; }
    if (filt->type != kTfLiteInt8)  { *why = "tensor type";  return 0; }
    if (bias->type != kTfLiteInt32) { *why = "tensor type";  return 0; }
    if (fout->type != kTfLiteInt8)  { *why = "tensor type";  return 0; }
    if (fin->dims  == nullptr || fin->dims->size  != 4) { *why = "tensor rank"; return 0; }
    if (filt->dims == nullptr || filt->dims->size != 4) { *why = "tensor rank"; return 0; }
    if (fout->dims == nullptr || fout->dims->size != 4) { *why = "tensor rank"; return 0; }

    // 1x1 only.  TFLM stores a CONV_2D filter as [cout, kh, kw, cin].
    if (filt->dims->data[1] != 1 || filt->dims->data[2] != 1) {
        *why = "kernel not 1x1";
        return 0;
    }

    const int h = fin->dims->data[1];
    const int w = fin->dims->data[2];
    const int CI = fin->dims->data[3];
    const int CO = filt->dims->data[0];
    if (h <= 0 || w <= 0)             { *why = "bad H/W";        return 0; }
    if (CI <= 0 || CI > CV_MAX_CIN)   { *why = "Cin out of range"; return 0; }
    if (CO <= 0 || CO > CV_MAX_COUT)  { *why = "Cout out of range"; return 0; }
    if (filt->dims->data[3] != CI)    { *why = "filter Cin";     return 0; }

    // The output shape the stride and padding imply, derived here and then
    // CHECKED against the tensor rather than taken from it - reading oh/ow off
    // fout and handing them to gpu_conv() would make the validation there a
    // tautology, and the point of it is to catch a layer whose declared output
    // does not match what 1x1 SAME stride 1 says it must be.
    if (fout->dims->data[1] != h)     { *why = "output shape";   return 0; }
    if (fout->dims->data[2] != w)     { *why = "output shape";   return 0; }
    if (fout->dims->data[3] != CO)    { *why = "output shape";   return 0; }

    if (fin->data.int8  == nullptr)   { *why = "null data";      return 0; }
    if (filt->data.int8 == nullptr)   { *why = "null data";      return 0; }
    if (bias->data.i32  == nullptr)   { *why = "null data";      return 0; }
    if (fout->data.int8 == nullptr)   { *why = "null data";      return 0; }

    ConvQ* q = conv_q(node->inputs->data[1], node->inputs->data[0]);
    if (q == nullptr || !q->ready)    { *why = "no quant record"; return 0; }
    if (q->cin != CI || q->cout != CO) { *why = "quant C mismatch"; return 0; }
    if (q->n < 0 || q->n >= CV_MAX_LAYER) { *why = "slot out of range"; return 0; }

    // The fused activation, checked against the output zero point rather than on
    // its own - which is what makes it a real test instead of a formality.
    //
    // TFLM's int8 RELU is max(y, out_zp).  The fold in gpu_conv() ends with a
    // clamp to [0, 255] in the byte domain and subtracts 128, i.e. it produces
    // the full int8 range, so it does NOT apply a RELU.  At out_zp == -128 that
    // does not matter: max(y, -128) is the identity on an int8, and the RELU is
    // a no-op the two paths agree about.  At any other zero point it is not the
    // identity and a layer with RELU would be drawn WRONG - not refused - so it
    // is refused here.
    if (p->activation == kTfLiteActNone) {
        // nothing to do
    } else if (p->activation == kTfLiteActRelu) {
        if (q->ozp != -128) { *why = "relu at zp"; return 0; }
    } else {
        *why = "activation";
        return 0;
    }

    j->fin  = fin;
    j->filt = filt;
    j->bias = bias;
    j->fout = fout;
    j->q    = q;
    j->h    = h;
    j->w    = w;
    j->cin  = CI;
    j->cout = CO;
    return 1;
}

// The GPU pass itself, split out so the caller can tell the answers apart - and
// it returns gpu_conv()'s OWN CODE now rather than a boolean:
//
//    0  the layer was drawn
//   -1  refused, and the refusal is about THIS DRAW: too many chunks for the
//       scratch plane, a scale outside its field, a drain that ran out of time
//   -2  refused, and the refusal is about THE LAYER: the 9-bit bias field cannot
//       hold this layer's centring at all, whatever chunk is chosen.  Found in
//       pass 2 before anything is drawn, so `out` is untouched by a -2
//
// The two refusals used to collapse into one 0, which made a layer the offline
// mirror REJECTS look in the log exactly like one that merely did not fit this
// draw.  The caller still treats both as "put the layer back on the CPU" - that
// is unchanged - but `cv_chk_bail()` can now name which one it was, and `wall`
// is a checkable prediction: the mirror's `bias field WALL` list says which
// layers it must appear on.
//
// `in_scale` is passed as the address of the ConvQ field because gpu_conv() reads
// only in_scale[0] - this model's conv inputs are quantised per tensor, so one
// float is the whole array and a separate staging array would be a second copy
// of the same number.
static int conv_draw(const ConvJob* j)
{
    return gpu_conv(j->fin->data.int8, j->filt->data.int8, j->bias->data.i32,
                    &j->q->isc, j->q->wsc, j->q->osc,
                    j->q->izp, j->q->ozp,
                    j->h, j->w, j->cin, j->cout,
                    j->fout->data.int8);
}

// Every bail names itself.  There are now three, and the third is new: the stock
// CPU invoke failing ("cpu"), the GPU refusing to draw ("gpu"), and the LAYER
// being undrawable at any chunk ("wall", the offline table's `bwall`).  A guard
// that takes a layer off the GPU for the session has to say so, and it has to
// say WHY, or the visible symptom is a layer that is silently on the CPU forever
// and a log that cannot tell "this layer's centring cannot be written down from
// "this layer did not fit" - which are different answers about the hardware.
static void cv_chk_bail(int n, const char* why)
{
    s_cv_check[n] = -1;
    sprintf(Message, "gpu cv chk bail n%d %s\r\n", n, why);
    UART_SendString(Message);
}

// The one-time real-activation check for ONE layer, run the first time that
// layer is reached and never again.  See the block comment above for why this
// is per layer where the depthwise one is per class.
//
// Same discipline as dw_run_check: the CPU answer is the reference, the
// comparison is on real activations rather than synthetic data, and the sample
// is CONTIGUOUS from the start of the NHWC output so that every channel is in
// the evidence.  For this operator that coverage is not a detail: the thing
// that differs between output channels here is the per-channel weight scale and
// the CLUT offset, so a sample that could not see channels other than 0 would be
// measuring a different operator.
//
// Note what this does NOT prove: it says THIS layer matched on the sample above.
// The other layers are measured too - that is the point of the design - and
// `worst` is printed for each rather than just a verdict, because a reading of 0
// that is really 0-because-we-clamped-it is what CV_GAP_MAX exists to expose.
static void conv_run_check(TfLiteContext* ctx, TfLiteNode* node, const ConvJob* j)
{
    const int n    = j->q->n;
    const int np   = j->h * j->w;
    const int total = np * j->cout;

    // CPU first: it is the reference, and the GPU pass that follows writes over
    // the tensor it lives in, which is why the sample is copied out first.
    if (s_conv_stock.invoke(ctx, node) != kTfLiteOk) { cv_chk_bail(n, "cpu"); return; }

    const int cnt = (total < CV_CHK_PX) ? total : CV_CHK_PX;
    const int8_t* ref = j->fout->data.int8;
    for (int i = 0; i < cnt; i++) { s_cv_ref[i] = ref[i]; }

    // THE CENSUS GOES AROUND THE PRODUCTION DRAW, on CHANNEL 0, for EVERY
    // layer.  Two changes from the bounded form it replaces, and both are about
    // making the offline model usable as an oracle rather than about this run:
    //
    //   * channel 0, not the channel the first bad pixel landed in, because
    //     tools/conv_gpu_emulate.py's census table is channel 0 for all 52
    //     layers.  Naming the failing channel bought one interesting channel per
    //     failing layer and cost the ability to compare ANY of them: of the four
    //     layers the last build censused, three had `fch` != 0, so three of the
    //     four rows had nothing to be compared against - and the one that did
    //     (n5, ch 0) matched the model's `bsum`, `net` and lo plane to 1-2 LSB
    //     while its hi plane did not, which is the most specific fault this
    //     operator has ever had pointed at it.
    //
    //   * no re-draw.  The planes are written by the draw that was going to
    //     happen anyway, so reading them here costs one byte walk and no GPU
    //     work at all - where the old form spent a whole second draw per
    //     censused layer and, worse, left plane 0 holding the DIG's output for
    //     every layer censused after the dig had run, which is why the `pl0`
    //     line never once described the production hi plane.
    //
    // The cost is 2K lines per layer instead of 2K lines per failing layer: on
    // this model ~200 lines per boot, which is 1.6 s of UART at 115200 and no
    // GPU time.  Turn it off by deleting the one call.
    gpu_cv_census(1, 0, n);
    // Armed for one layer and one draw: gpu_conv() has no layer number of its
    // own, so the dump rides the same variable the census travels in, and it
    // disarms itself the moment it has taken the input.  Print only, and it
    // changes no arithmetic - a refused layer still falls back to s_conv_stock.
    if (n == CV_DUMP_N) { gpu_cv_dump(n); }
    const int draw_rc = conv_draw(j);
    if (draw_rc < 0) {
        gpu_cv_census(0, 0, -1);
        cv_chk_bail(n, (draw_rc == -2) ? "wall" : "gpu");
        return;
    }
    gpu_cv_census(0, 0, -1);

    // THE FOLD'S OWN CLAMP COUNTS, read here because this is the call whose
    // planes they describe and the verdict below is what consumes them.  They
    // are about the PLANE the colour pass wrote and NOT about a texture unit:
    // the two units are clamped individually INSIDE that pass and only their SUM
    // reaches the plane, so a unit leaving the byte range is invisible from here
    // - and from every other place the board can look.  That one is the offline
    // table's `sat`; this is its `rail`/`at255`.  See s_cv_rail in gpu.c.
    uint32_t rail = 0u, at0 = 0u;
    gpu_cv_fold_stat(&rail, &at0);

    int worst = 0, bad = 0;
    // `n8` is the offline table's OWN column of the same name
    // (tools/conv_gpu_emulate.py:1448, `count_nonzero(err > 8)`), so the board's
    // row and the mirror's row can be held against each other column by column.
    // What differs is the COVERAGE, not the definition: the mirror counts over
    // the whole plane and this counts over the sample below, so a layer whose
    // only over-8 pixels sit past the sample reads n8 0 here and n8 > 0 there
    // without either being wrong.
    //
    // REPORTED AND NOT JUDGED, on the mirror's own evidence: a flat 8 is exactly
    // what put op186 and op205 in ITS wall list, for exceeding a threshold by 1
    // and by 0, when their error IS their floor and no chunk or a_scale recovers
    // it (conv_gpu_emulate.py:1464-1468).  The board has no `floor` to compare
    // against, so gating on `n8 == 0` would be STRICTER than the mirror and
    // would refuse layers the mirror keeps - so it stays a column.
    int n8 = 0;
    // The three error shapes the rng line below names - a constant offset, a
    // scale error, saturation - were only ever inferred from a THREE-SAMPLE min
    // and max, which cannot tell "one pixel pinned at -128" from "half the layer
    // pinned there".  These three counts can, and they cost a comparison each:
    //
    //   csat  the CPU's own byte is pinned at -128 or 127 (the reference is
    //         clipping, so any GPU error there is not the GPU's to explain)
    //   gsat  the GPU's byte is pinned
    //   bsat  a pixel over the bound AND the CPU pinned at an end - the signature
    //         of the 5-bit hi plane clipping, where the two-plane identity
    //         byte1+byte2-128 == m*Sigma(w*code) STOPS HOLDING
    //
    // bsat near bad means the layer is outside the split's safe set, which is a
    // verdict and not a bug; bsat near zero with a large bad means something
    // else is wrong and the search continues.
    int csat = 0, gsat = 0, bsat = 0;
    // WHERE the bad pixels are, because the counts above cannot say.  A fault
    // that is per-channel (a CLUT offset, a weight row, a per-channel scale)
    // puts every bad pixel in a few channels, so `same` - how many bad pixels
    // share the first bad one's channel - equals `bad`.  A fault in the source
    // layout puts them in a contiguous run, which `first`/`last` bracket.  And
    // a handful of isolated pixels, which is what the cin72 K3 layers show, is
    // neither, and that is itself the answer.
    int fb = -1, lb = -1, same = 0;
    for (int i = 0; i < cnt; i++) {
        const int cv = (int)s_cv_ref[i], gv = (int)ref[i];
        int d = gv - cv;
        if (d < 0) { d = -d; }
        if (d > worst) { worst = d; }
        if (d > 8) { n8++; }
        if (d > CV_GAP_MAX) {
            bad++;
            if (fb < 0) { fb = i; }
            lb = i;
        }
        const bool cend = (cv == -128) || (cv == 127);
        if (cend)                              { csat++; }
        if ((gv == -128) || (gv == 127))       { gsat++; }
        if (cend && (d > CV_GAP_MAX))          { bsat++; }
    }
    // The channel the first bad pixel is in, and how many of the bad pixels are
    // in it.  Walked with the sample's own stride so it stays NHWC-correct
    // whatever the sample's length is.
    int fch = 0;
    if (fb >= 0) {
        fch = fb % j->cout;
        for (int i = fch; i < cnt; i += j->cout) {
            int d = (int)ref[i] - (int)s_cv_ref[i];
            if (d < 0) { d = -d; }
            if (d > CV_GAP_MAX) { same++; }
        }
    }
    // THE MIRROR'S `rail` GATE, which the board was not applying.  A plane byte
    // the hardware wrote as 255 means the two units - each already clamped on
    // its own - summed to at least 255, i.e. the colour overflowed the byte it
    // is added into.  What the write cuts off at the top is not in the byte the
    // fold reads back, so it is an error the sample's own |gpu-cpu| can only
    // sometimes see; it is a property of the LAYER.
    //
    // It is a SUPERSET of the mirror's own test and that is deliberate: the
    // mirror asks for sum > 255, a byte can only report sum >= 255.  So a digit
    // plane landing exactly on 255 is refused here and kept there - the same
    // trade CV_GAP_MAX already makes ("a layer whose real floor is near the
    // bound is refused, which costs draws, not correctness"), and it errs
    // towards the CPU.  The mirror's own direction of evidence agrees: in the
    // 2026-09-22 capture, all 11 layers with at255 > 0 read FALLBACK and no
    // layer with at255 == 0 reached a worst of 255.
    //
    // The gate costs drawn layers, which is a real cost against the aim of this
    // stage - they are the layers the mirror refuses too, so it is a correctness
    // trade and not a regression, but it is a trade.
    //
    // A `bu_min > CV_GAP_MAX` CLAUSE WAS TRIED HERE ON 2026-10-09 AND REVERTED
    // THE SAME DAY, ON THE FIELD CAPTURE THAT FIRST EXERCISED IT.  The claim was
    // that an annihilated texture unit costs the plane that unit's own `b_u`, so
    // a layer whose smallest |b_u| does not clear CV_GAP_MAX could ship a
    // corrupted plane with `bad 0` and `rail 0`.  It reads well and it is wrong:
    // cv_digit() sets `b_u` so that the unit's post-bias mean is ALWAYS 64
    // (`mean(p_u) = cen_u + b_u = cen_u + 64 - cen_u`), so what a lost unit costs
    // does not depend on `b_u` at all - it is that mean, ~PLANE/2.  The two
    // readings coincide only where `b_u` happens to be ~64, which is every unit
    // of the 2026-09-29 capture that the claim was generalised from.
    //
    // The cost was NOT zero, which is what the offline estimate said: on the
    // first capture (f off, c on, g on) `bad 0 rail 0` held on 13 of 51 layers
    // and min|b_u| was 0..6 on ten of them - so the clause cut the conv offload
    // from 13 layers to the 3 the log's own `gpu cv l3` shows.  The offline
    // estimate had read ONE (channel 0, chunk 0) `bu` row per layer; the board's
    // minimum is over every channel, and small |b_u| turns out to be common
    // rather than rare.
    //
    // `bu` SURVIVES AS A COLUMN on the chk line (see gpu_cv_bias_min) because it
    // costs nothing and is the reading the mechanism question still needs.  What
    // must not come back without a measurement is the VERDICT.
    int32_t bu_min = -1;
    gpu_cv_bias_min(&bu_min);
    s_cv_check[n] = (bad == 0 && rail == 0u) ? 1 : -1;

    // K is sizeof the chunk this layer's layer actually needs, and it is the
    // number that explains most of the cost, so it is on the line.
    //
    // `n8`, `rail` and `at0` GO AFTER THE VERDICT ON PURPOSE, and not because
    // the verdict reads better in the middle.  tools/conv_dump_diff.py parses
    // this line with `... bad (\d+) (\w+)` and is not anchored, so a column
    // inserted before the verdict does not fail the parse - it makes that `\w+`
    // capture "n8" and the tool then reports a verdict of `n8` with no error
    // anywhere.  Appending keeps the old tool reading the same line it always
    // did.  `n8` is |gpu-cpu| > 8 over this sample, `rail` and `at0` are the
    // fold's counts of plane bytes written as 255 and as 0 over the whole layer
    // (see gpu_cv_fold_stat) - they are the mirror's columns of the same names.
    // `bu` is the layer's smallest per-unit |b_u| (see gpu_cv_bias_min).  It is
    // a COLUMN and not part of the verdict; -1 means nothing was drawn.
    const unsigned K = ((unsigned)j->cin + 31u) / 32u;
    sprintf(Message, "gpu cv chk n%d cin%u cout%u K%u %ux%u px%u lim%d worst %d bad %d %s n8 %d rail %u at0 %u bu %d\r\n",
            n, (unsigned)j->cin, (unsigned)j->cout, K,
            (unsigned)(j->h), (unsigned)(j->w), (unsigned)cnt, (int)CV_GAP_MAX,
            worst, bad, (s_cv_check[n] == 1) ? "OK" : "FALLBACK",
            n8, (unsigned)rail, (unsigned)at0, (int)bu_min);
    UART_SendString(Message);

    // The other two thirds of the three-way dump, in the same `D <tag> +<off>
    // <hex>` format the operator's own halves use, so one script can diff the
    // four.  `cpu` is the stock operator's answer on THIS frame's real
    // activations - a reference the offline oracle cannot supply, because the
    // oracle runs on a jpg - and `gpu` is the very buffer the comparison above
    // read.  Printed after `chk` on purpose: the verdict comes first and the
    // bytes that have to justify it follow.
    if (n == CV_DUMP_N)
    {
        gpu_cv_hex("cpu", s_cv_ref, cnt);
        gpu_cv_hex("gpu", ref, cnt);
    }

    // The shape of the error, not just its size, and only when it failed - a
    // constant offset shows as a range of equal width shifted, a scale error as
    // a GPU range that is the CPU range multiplied, and saturation as a GPU
    // range pinned to -128/127.  Three samples of the same index on both sides,
    // which the contiguous sample makes meaningful.
    if (s_cv_check[n] < 0) {
        // THE CHANNEL THE FAULT IS IN, CENSUSED.
        //
        // Channel 0's numbers above are the offline table's oracle, and they are
        // why the per-layer constants are known to be right: `bsum` and `net` are
        // built from the weights and the calibration alone, so they do not depend
        // on the image, and 44 of 44 of them matched the offline model to the
        // printed digit.  The PLANES are image-dependent and cannot be compared
        // that way, so what is still unanswered is whether a failing layer's
        // fault is in its per-channel state - the weight scale, the CLUT offset,
        // the centring - or in the shared arithmetic.  `loc` already says which
        // channel the first bad pixel was in; this puts THAT channel's `b`,
        // `mult`, `sw`, `bsum` and `net` on the wire, and the offline model
        // prints a row for every channel of every layer to hold them against.
        //
        // Skipped when the bad channel IS channel 0, because the census above
        // already was that.  Costs one extra draw per failing layer, once per
        // boot, on the check path only.
        if (fch != 0) {
            gpu_cv_census(1, fch, n);
            (void)conv_draw(j);
            gpu_cv_census(0, 0, -1);
        }

        const int last = (cnt > 1) ? (cnt - 1) : 0;
        const int mid  = cnt / 2;
        int cl = s_cv_ref[0], ch = s_cv_ref[0];
        int gl = ref[0],      gh = ref[0];
        for (int i = 0; i < 3; i++) {
            const int k = (i == 0) ? 0 : ((i == 1) ? mid : last);
            if (s_cv_ref[k] < cl) { cl = s_cv_ref[k]; }
            if (s_cv_ref[k] > ch) { ch = s_cv_ref[k]; }
            if (ref[k] < gl)      { gl = ref[k]; }
            if (ref[k] > gh)      { gh = ref[k]; }
        }
        sprintf(Message, "gpu cv rng n%d c %d..%d g %d..%d sat c%d g%d bad%d\r\n",
                n, cl, ch, gl, gh, csat, gsat, bsat);
        UART_SendString(Message);

        // The `rng` range above is THREE samples - index 0, cnt/2, cnt-1 - and
        // so is nearly worthless on its own; these three are over the whole
        // sample.  (`same == bad` is a per-channel fault; `first`..`last` a
        // contiguous run; a few isolated indices neither.)
        sprintf(Message, "gpu cv loc n%d ch%d same%d/%d first%d last%d of %d\r\n",
                n, fch, same, bad, fb, lb, cnt);
        UART_SendString(Message);

        // WHERE IN THE PLANE, which a byte index cannot say.  The output is
        // NHWC, so byte i is pixel i/cout and that pixel is row y = px/w,
        // column x = px%w.  Three verdicts separate this way:
        //
        //   * a fault in the 16-tap window's geometry can only touch the first
        //     or last row and column, because that is where the window overruns
        //     the texture and the border colour is read instead;
        //   * a fault in the pack, or in a weight row, is interior;
        //   * a fault that follows the source's own edge lands on the column
        //     each row starts at, and nowhere else.
        //
        // Counted PER BYTE, exactly like `bad`, so the four edges plus `in` add
        // up to `bad` and a reader can check that.
        //
        // `npx` is how many whole pixels the 8192-byte sample reaches, and
        // `rows` how much of the plane that is.  This is the number that stops
        // "no bad pixel in the interior" from being read as "the interior is
        // clean": for n1 the sample covers 8 rows of a 40-row plane, so the
        // interior it reports on is partial.  Printed for that reason, not as
        // decoration.
        {
            const int npx    = (j->cout > 0) ? (cnt / j->cout) : 0;
            const int rowspan = (j->w > 0) ? ((npx + j->w - 1) / j->w) : 0;
            int e0 = 0, eL = 0, eT = 0, eB = 0, ein = 0;
            int fx = -1, fy = -1;
            for (int i = 0; i < cnt; i++) {
                int d = (int)ref[i] - (int)s_cv_ref[i];
                if (d < 0) { d = -d; }
                if (d <= CV_GAP_MAX) { continue; }
                const int px = (j->cout > 0) ? (i / j->cout) : 0;
                const int x  = (j->w > 0) ? (px % j->w) : 0;
                const int y  = (j->w > 0) ? (px / j->w) : 0;
                int onedge = 0;
                if (fx < 0)          { fx = x; fy = y; }
                if (x == 0)          { e0++; onedge = 1; }
                if (x == j->w - 1)   { eL++; onedge = 1; }
                if (y == 0)          { eT++; onedge = 1; }
                if (y == j->h - 1)   { eB++; onedge = 1; }
                if (!onedge)         { ein++; }
            }
            sprintf(Message,
                    "gpu cv edge n%d npx%d rows%d/%d x0 %d x%d %d y0 %d y%d %d in %d\r\n",
                    n, npx, rowspan, (int)j->h,
                    e0, (int)j->w - 1, eL, eT, (int)j->h - 1, eB, ein);
            UART_SendString(Message);
            sprintf(Message, "gpu cv fbad n%d x%d y%d\r\n", n, fx, fy);
            UART_SendString(Message);
        }

        // ONE CHANNEL'S DIGIT PLANES, for a bounded number of failing layers.
        // The offline model of this operator cannot name this fault - it already
        // says this shape of layer is clean, at worst 4 - so the board has to
        // hand over the four numbers the model prints for the same channel: the
        // plane's min, its max, and how many bytes sit at exactly 0 and at
        // exactly 255.
        //
        // THE CENSUS NO LONGER HAPPENS HERE.  It used to, as a second draw of
        // this layer with the census armed on `fch`.  The draw is gone: the
        // census now rides the production draw (see conv_run_check) on channel
        // 0, for every layer, so nothing needs re-drawing and every layer has
        // the model's own channel-0 row to be compared against.  `fch` is still
        // printed on the `loc` line above, which is where it belongs - it names
        // the channel the first bad pixel was in, and now that is all it is for.
    }
}

// How many layers this inference put on the GPU and how many draws they cost.
// Reset before Invoke and read after it by yolo_plate_detect(), which prints one
// line - so the evidence for "the operator really ran on the GPU" is per
// inference and costs one line, not 52.
static unsigned s_cv_turn_layers = 0u;
static unsigned s_cv_turn_draws  = 0u;

// ...but that line does NOT print on every inference, and this is the latch that
// makes it so.  It printed on EVERY inference until the conv switch became a
// default rather than something a key turns on.  A line per frame on the healthy
// path is the thing this product does not do - the DVP heartbeat was deleted for
// exactly that - and the reading cannot change between two inferences of one boot
// anyway, because the per-layer verdicts are latched for the whole boot, so the
// set and its draw count are fixed from the first inference on.  The first
// inference is also the only one that runs the per-layer checks, so its numbers
// are the only ones with anything new in them.
//
// ONE EXCEPTION, and it is the `tail` knob: changing it changes WHICH layers are
// eligible, so it changes l/d - the one input that can move this line's numbers
// within a boot.  Without the second condition a `t` sweep would print the cut
// (in the key echo) and never the count it produced, which is the number this
// whole stage is judged by, so the same log would carry one stale l/d and 13
// cuts beside it.  s_cv_sum_tail holds the tail the line was last printed under,
// so the sweep gets exactly one line per cut and no more.
static int s_cv_sum_done = 0;
static uint32_t s_cv_sum_tail = 0xFFFFFFFFu;   // not a legal cut (wraps at 60)

static TfLiteStatus conv_gpu_invoke(TfLiteContext* ctx, TfLiteNode* node)
{
#if GPU_ENABLE
    // Once per session, on the first conv node of the first inference.  Without
    // this line "prepare never captured anything" and "invoke is never reached"
    // look identical in the log - the same reading mistake the depthwise
    // `gpu dw call` line exists to prevent.
    {
        static int once = 0;
        if (once == 0) {
            /* Same split as the depthwise one (2026-10-12): the latch stays
               unconditional, only the report is gated. */
            once = 1;
#if BOOT_VERBOSE
            sprintf(Message, "gpu cv call q%u\r\n", (unsigned)s_cvq_n);
            UART_SendString(Message);
#endif
        }
    }

    // Asked first because it is free and it is what decides whether anything
    // below matters: an ineligible layer never touches the per-layer state.
    //
    // The master switch is tested HERE and not inside conv_eligible(), so that
    // "off" means exactly what it says: no per-layer state, no one-time check,
    // and no cv_skip line for any of the 52 layers.  An un-flipped board is
    // byte-for-byte the firmware without this operator in it.
    if (g_gpu_conv_on == 0u) { return s_conv_stock.invoke(ctx, node); }

    ConvJob j;
    const char* why = nullptr;
    if (!conv_eligible(ctx, node, &j, &why)) {
        cv_skip(conv_layer_no(node), (why != nullptr) ? why : "?");
        return s_conv_stock.invoke(ctx, node);
    }

    // The tail cut, asked AFTER eligibility and BEFORE the one-time check, so
    // that a layer this refuses (a) is refused for this reason alone, and (b) is
    // never measured or recorded - the check below runs on the first layer that
    // is ACTUALLY offloaded, which is what makes a high threshold a measurement
    // of the layers that remain rather than of the layers that were eligible.
    // See gpu.h on g_gpu_conv_tail for why a tail and not a subset.
    if ((g_gpu_conv_tail != 0u) && (j.q->n < g_gpu_conv_tail)) {
        return s_conv_stock.invoke(ctx, node);
    }

    // The one-time measurement of THIS layer, and its verdict is what is read
    // back below.  A layer that fails is on the CPU for the rest of the session
    // while every other layer keeps running - which is the constraint that
    // matters more than any of the above.
    if (s_cv_check[j.q->n] == 0) { conv_run_check(ctx, node, &j); }
    // NAMED, because the only way to read a negative here is that a verdict was
    // recorded earlier - and every verdict records itself with a `chk` or a
    // `chk bail` line.  So this line can only ever be VISIBLE in the anomalous
    // case, which is exactly the case that cost a flash round: three slots
    // (n47, n48, n51) printed nothing at all, and a silent return here cannot be
    // told from a layer that was never reached, a lost UART line, or a
    // duplicate ConvQ slot colliding on `n`.  cv_skip() de-dups per layer, so a
    // normal run still prints nothing here.
    if (s_cv_check[j.q->n] < 0)  { cv_skip(j.q->n, "held"); return s_conv_stock.invoke(ctx, node); }

    if (conv_draw(&j) < 0) {
        // The GPU refused to draw this layer.  `gpu_conv()` has already latched
        // its own dead flag if the refusal was a drain timeout, so this is the
        // ordinary "this layer cannot be drawn" case - too many chunks for the
        // scratch plane, a scale outside the field, a bias that will not fit.
        // The stock kernel rewrites every byte of `out`, which is what makes a
        // partial fold safe to fall back from (see the contract in gpu.h).
        //
        // -2 lands here too, and it is the one refusal that is NOT about this
        // draw: the layer's centring cannot be written into the bias field at
        // any chunk, so it will refuse identically for the rest of the session.
        // Same handling, different meaning - which is why conv_run_check()
        // examines the code where it can afford to.
        return s_conv_stock.invoke(ctx, node);
    }

    s_cv_turn_layers++;
    // Per OUTPUT CHANNEL, because one draw is one (co, chunk) pair: `gpu_conv()`
    // sets its own scale, CLUT offset and bias per co, so the two units of a
    // draw can only ever carry one channel's weights.  The first version counted
    // `2*K` - the draws of one channel - which read 48 where the GPU really made
    // 1152, and understated the operator by a factor of Cout, i.e. by everything
    // that makes this stage worth measuring.  It is the one number in the log
    // that is direct evidence for "the convolution ran on the GPU".
    s_cv_turn_draws += (unsigned)j.cout * 2u * (((unsigned)j.cin + 31u) / 32u);
    return kTfLiteOk;
#else
    // GPU_ENABLE 0: the conv stub, the twin of the depthwise one above and for
    // the same reason - the registration stays, the body becomes the stock
    // CMSIS-NN kernel, and no gpu.o symbol is reachable from here.
    return s_conv_stock.invoke(ctx, node);
#endif
}

// ---------------------------------------------------------------------------
// Exact-operator timing probe (measurement only - it changes no result).
//
// WHY.  tools/_exact_ops.py says 133 of this model's 224 operators do no
// arithmetic at all (RESHAPE / TRANSPOSE / GATHER / CONCATENATION / PAD /
// MAX_POOL_2D / RESIZE_NEAREST_NEIGHBOR), and tools/_exact_detail.py says 117
// of those are ONE channel-permutation block repeated 13 times - verified NOT
// identity by tools/_shuffle_id.py.  That set is the only offload class in this
// project that CANNOT change the output: a permutation has no requantisation to
// lose, so the accuracy objection to it does not exist.
//
// What is NOT settled is the PRICE, and that is the live objection.  The
// board's only measured marginal draw cost is ~0.88 ms (2026-10-09 tail sweep:
// `gate n` +2083 drains against `infer` +1 818 523 us), the front end's 320x320
// blit is ~0.2 us/px, and a channel permutation is NOT a rectangular blit - the
// block's core would need ~26 draws per instance.  The GPU may well LOSE here.
// The number that decides it has never been printed on this board: how much of
// `infer` do these operators actually spend on the CPU?
//
// HOW.  The same shape as the dw/conv hooks above, and safe for the same
// reason: TFLMRegistration is a POD (micro_common.h:23), so each of these nine
// is the STOCK registration with only `invoke` swapped for a wrapper that
// brackets the stock call in two DWT->CYCCNT reads.  The stock function still
// does all the work, so no result can move; with the gate OFF the wrapper is
// one predictable branch and one tail call.
//
// It also re-reads the census off the silicon: the nine call counts of one
// inference must come back 1 / 8 / 19 / 52 / 26 / 26 / - / 4 / 2 / 6, i.e. 143
// of the 224 operators.  (RESIZE_NEAREST_NEIGHBOR, the one the dash stands for,
// is left stock - see its registration in yolo_plate_init().)  The offline tool
// and the board agreeing is a check neither can do alone.
//
// 600 MHz core, /600 = microseconds - the same divisor main.c uses for
// `grab`/`infer`, so the ten numbers add up against the `infer` line.  Gate:
// key `e`, OFF at boot, so a board that never asks for it is the pre-probe
// board byte for byte.
// ---------------------------------------------------------------------------

#define EX_CLASSES 10

static TFLMRegistration s_ex_stock[EX_CLASSES];
static TFLMRegistration s_ex_impl[EX_CLASSES];

static int      s_ex_on = 0;
static unsigned s_ex_n[EX_CLASSES];    // calls, THIS inference
static uint64_t s_ex_cy[EX_CLASSES];   // cycles inside them, THIS inference

// The one body all ten wrappers share.  `k` is the class index, and it is the
// order the arrays are printed in - keep it the order of the registration list
// in yolo_plate_init().
static TfLiteStatus ex_time_call(int k, TfLiteContext* ctx, TfLiteNode* node)
{
    if (s_ex_on == 0) {
        return s_ex_stock[k].invoke(ctx, node);
    }
    const uint32_t t0 = DWT->CYCCNT;
    const TfLiteStatus st = s_ex_stock[k].invoke(ctx, node);
    // 32-bit delta, and it wraps correctly: no single operator here is remotely
    // near the 7.158 s the counter needs for a rollover.
    const uint32_t d = DWT->CYCCNT - t0;
    s_ex_n[k]  += 1u;
    s_ex_cy[k] += (uint64_t)d;
    return st;
}

#define EX_WRAP(NM, K)                                                      \
    static TfLiteStatus ex_invoke_##NM(TfLiteContext* c, TfLiteNode* n) {   \
        return ex_time_call(K, c, n);                                       \
    }

EX_WRAP(mp, 0)   // MAX_POOL_2D               1
EX_WRAP(pd, 1)   // PAD                       8
EX_WRAP(cc, 2)   // CONCATENATION            19
// TRANSPOSE is NOT wrapped by the macro above, because it has a second arm.
// ---------------------------------------------------------------------------
// TRANSPOSE [0,2,3,1] ON THE GPU - the first exact-operator offload
//
// WHY THIS ONE.  52 of the model's 224 operators are TRANSPOSE and 26 of those
// are the perm `[0,2,3,1]`, which on a 4-D tensor is a PLAIN 2D TRANSPOSE - one
// transposed read, no intermediate plane.  A permutation contains no
// arithmetic, so unlike every conv layer in this project there is no
// requantisation to lose: the operator is either byte-exact or it is wrong, and
// `bad 0` on a real activation is the entire proof.  That is what makes it worth
// a round when a per-layer conv gate is worth nothing.
//
// WHAT IS DIFFERENT UNDERNEATH.  The GPU's CLUT kernel path - the one depthwise
// and conv are built on - takes the top FIVE BITS of its multiplicand: one
// centre tap of one over an RGB_888 blue byte reads 0x40 as 8 and 0xFF as 31,
// measured, and no texel format changes it.  A kernel draw therefore cannot
// carry an int8 at all.  The transpose does not use a kernel: it uses the CLUT
// as an ordinary 256-entry identity PALETTE (E_DHD_CLUT_INDEXED_COLOR), so the
// texel is an index and the value that reaches the framebuffer is the whole
// byte.  See the long note above gpu_transpose_s8() in gpu.c.
//
// THE SHAPE CHECK IS PART OF THE ANSWER.  Only `[0,2,3,1]` on a 4-D int8 tensor
// whose element count fits the scratch buffer is sent to the GPU.  Every other
// TRANSPOSE in the model keeps the stock kernel and is counted by the timing
// arm exactly as before, so `ex n ... 52 ...` still adds up while this is on.
//
// WHAT THIS ROUND DOES: IT OFFLOADS THE CLASS, AND IT IS SAFE BY CONSTRUCTION.
// All 26 eligible instances, every inference, run on the GPU and THE GPU'S BYTES
// ARE WHAT THE MODEL GOES ON TO READ.  The CPU kernel still runs FIRST, as the
// reference, and the two are compared byte for byte; the GPU answer replaces the
// CPU one ONLY when every byte matched.  The CPU result is already in the output
// tensor at that point, so the worst case of a wrong draw - or of a refusal - is
// that this instance keeps the CPU answer and `bad` counts it: THE PRODUCT
// CANNOT BE WORSE THAN THE CPU PATH, and no gate has to be trusted to make that
// true.  A permutation has no requantisation to lose, so `bad 0` is not a
// tolerance being met, it is a set of bytes being the same bytes - and it is
// re-earned on every activation of every inference rather than argued once.
//
// THE PRICE IS PAID ON THE GPU SIDE.  The CPU reference is ~120 ms of the 1.70 s
// inference (`e`: 52 TRANSPOSEs, 242.3 ms) - cheap enough to keep, and it is
// what makes the guarantee above structural instead of provisional.  The GPU
// side is priced per OUTPUT byte and board-measured at ~2.4 us/byte on the two
// shapes the model actually has: 97.5 ms for a 38400-element instance, 45.0 ms
// for a 19200-element one, ~+1.3 s for all 26.  Nothing is hidden about this:
// `gpu us` on the `tr` line is the measured total and it lands in `infer %u us`
// on the same frame.  The switch stays OFF by default; nothing here runs on a
// board that has not had `j` pressed.
//
// FIELD RESULT, 2026-10-10: ONE BOOT, ONE FROZEN FRAME, THREE ARMS
// (`mcu_code\log\log.txt`).  `x` on the CPU - `grab 90949 us, infer 1702832 us` -
// reads plate `粤8粤A898888` with boxes `202,139 269,250 c11` / `467,143 552,256 c9`
// / `315,140 386,251 c9`.  `i` with the switch OFF runs the SAME retained frame
// (`grab 0 us`) and reads the same string and the same three boxes.  `j` then `i`
// on that same frame reads them a THIRD time - identical - with
// `tr n 26 bad 0 worst 0 gpu 1411511 us` and `gpu drn n20 -> n72` (2 draws per
// instance), `strt0 nz0 bus001 ms0/0/72 kp0`, no wedge.  So 26 of 26 were adopted
// and the class cost 1.355 s of wall clock (`infer` 1693099 -> 3048126 us; the
// operator's own stopwatch 1411511 us = 2.535 us per output byte, which is the
// probe's D-case rate to three digits).  3.048 s is under the 7.158 s stamp
// rollover, so that `infer` is quotable.
//
// READ THE PICTURE FOR WHAT IT IS.  The identical plate and boxes prove the
// ADOPTION PATH is clean - a misaligned or stale copy would have corrupted the
// output - and NOT that the hardware was needed, because the two answers are the
// same bytes by construction.  "The GPU's bytes are the product's bytes" rests
// on `tr n 26 bad 0` plus the `if (bad == 0u)` copy above.
//
// THIS IS THE SHIPPED STAGE CONFIGURATION.  The switch resets to 0, so a fresh
// board runs the stock kernel exactly as it did before any of this existed, and
// the 26 operators reach the hardware only when someone presses `j`.  The price
// of that press is the paragraph above and nothing else moves with it.
// ---------------------------------------------------------------------------

// The ceiling is the model's LARGEST [0,2,3,1] instance, not its commonest one.
// The three shapes are (1,48,20,20) = 19200, (1,24,40,40) = 38400 and
// (1,96,10,10) = 9600 elements, so 19200 covered only the 20 smaller ones - the
// six 38400 instances would have been turned away by the bound even after the
// perm read above was fixed.  tools/_transpose_shapes.py is where the three
// numbers come from, and gpu.c's GPU_TR_MAX_PX carries the same value.
#define TR_MAX_PX 38400

// HOW MANY INSTANCES PER INFERENCE, and this is the line that turns a one-layer
// probe into an offload.  26 IS THE MODEL'S OWN COUNT of [0,2,3,1] instances
// (tools/_transpose_shapes.py), so it is a CEILING and not a target: an inference
// that somehow held more eligible instances would send the first 26 and leave
// the rest to the stock kernel, exactly as an ineligible shape does.  Lowering
// it is the coarse dial for how much GPU time this deploys - the instances come
// in three sizes (9600 / 19200 / 38400 output bytes) and cost ~20 / ~45 / ~98 ms
// each, so a smaller N buys a smaller bill, not a different kind of bill.
#define TR_MAX_ARM 26u

static int      s_tr_on    = 0;      // key-gated, resets to 0
static int      s_tr_left  = 0;      // eligible instances left THIS inference
static unsigned s_tr_n     = 0u;     // GPU runs
static unsigned s_tr_bad   = 0u;     // bytes that disagreed, summed
static unsigned s_tr_worst = 0u;     // worst single byte difference
static unsigned s_tr_us    = 0u;     // GPU wall time, microseconds, summed
// Only ex_invoke_tr's GPU half reads this, so with GPU_ENABLE 0 it is 38400 bytes
// of ZI nobody touches - gate it, unlike the counters above, which the accessors
// and the `j` key still report on.
#if GPU_ENABLE
static int8_t   s_tr_gpu[TR_MAX_PX];
#endif

// The whole class, this inference, every inference.  Called from
// yolo_plate_detect(), which is also where the timing probe's per-inference
// counters are cleared and for the same reason: invoke cannot know which call is
// the first of a turn.
extern "C" void yolo_tr_arm(void)
{
    if (s_tr_on != 0) { s_tr_left = (int)TR_MAX_ARM; }
}

extern "C" void yolo_tr_set(int on)
{
    s_tr_on    = (on != 0) ? 1 : 0;
    s_tr_left  = (s_tr_on != 0) ? (int)TR_MAX_ARM : 0;
    s_tr_n     = 0u;
    s_tr_bad   = 0u;
    s_tr_worst = 0u;
    s_tr_us    = 0u;
}

extern "C" int yolo_tr_get(void)
{
    return s_tr_on;
}

extern "C" void yolo_tr_stat(uint32_t* n, uint32_t* bad, uint32_t* worst,
                             uint32_t* us)
{
    if (n     != nullptr) { *n     = s_tr_n;     }
    if (bad   != nullptr) { *bad   = s_tr_bad;   }
    if (worst != nullptr) { *worst = s_tr_worst; }
    if (us    != nullptr) { *us    = s_tr_us;    }
}

// The hook.  The gate off, an ineligible shape, and no instance left this
// inference all fall through to ex_time_call(), which IS the stock kernel - so
// with the switch off this function is one predictable branch and the product
// path is byte-for-byte what it was before any of this existed.
static TfLiteStatus ex_invoke_tr(TfLiteContext* ctx, TfLiteNode* node)
{
    if ((s_tr_on == 0) || (s_tr_left <= 0)) {
        return ex_time_call(3, ctx, node);
    }

    const TfLiteEvalTensor* tin  = ctx->GetEvalTensor(ctx, node->inputs->data[0]);
    const TfLiteEvalTensor* tprm = ctx->GetEvalTensor(ctx, node->inputs->data[1]);
    const TfLiteEvalTensor* tout = ctx->GetEvalTensor(ctx, node->outputs->data[0]);

    // A `[0,2,3,1]` TRANSPOSE of a (1,a1,a2,a3) tensor is the a1 x (a2*a3)
    // matrix transposed, stored row-major in (1,a2,a3,a1) - which is what
    // gpu_transpose_s8() draws, with tw = a2*a3 and th = a1.  Nothing else in
    // the model has that shape under this perm, and the other two perms are a
    // 3-cycle and a block transpose that each need an intermediate plane, so
    // they are not this round's.
    // THE PERM TENSOR IS int32, and reading it as int8 is what the first round
    // got wrong.  `[0,2,3,1]` is four int32s, so its bytes are
    // 00 00 00 00 | 02 00 00 00 | 03 00 00 00 | 01 00 00 00 -, and a `data.int8`
    // read sees p[0..3] = 0,0,0,0: only the first element, whose bytes are all
    // zero.  Every one of the 26 instances failed `p[1] != 2` and fell back to
    // the stock kernel, which is exactly what `tr n 0` was on the board - the
    // hook was reached on every inference and the perm was never read correctly
    // once.  tools/_transpose_shapes.py prints the values AND the raw bytes.
    if ((tin == nullptr) || (tprm == nullptr) || (tout == nullptr) ||
        (tin->dims == nullptr) || (tprm->dims == nullptr) ||
        (tin->dims->size != 4) || (tprm->dims->size != 1) ||
        (tprm->dims->data[0] != 4) || (tin->type != kTfLiteInt8) ||
        (tprm->type != kTfLiteInt32)) {
        return ex_time_call(3, ctx, node);
    }
    const int32_t* p = tprm->data.i32;
    if ((p == nullptr) || (p[0] != 0) || (p[1] != 2) || (p[2] != 3) ||
        (p[3] != 1)) {
        return ex_time_call(3, ctx, node);
    }
    const int tw = tin->dims->data[2] * tin->dims->data[3];
    const int th = tin->dims->data[1];
    if ((tw <= 0) || (th <= 0) || ((tw * th) > TR_MAX_PX) ||
        (tin->data.int8 == nullptr) || (tout->data.int8 == nullptr)) {
        return ex_time_call(3, ctx, node);
    }

    // CPU first, ALWAYS: it is the reference, it is what the output tensor holds
    // while the comparison runs, and it is what the product keeps whenever the
    // GPU's bytes did not all match.  The GPU answer goes to our own buffer and
    // is adopted only on a clean comparison - see the block note.
    const TfLiteStatus st = ex_time_call(3, ctx, node);
    if (st != kTfLiteOk) { return st; }

#if GPU_ENABLE
    // Spent for this inference.  A shape that did not qualify above did not
    // spend it, so the budget is only consumed by instances that went to the
    // GPU, and `tr n 26` is what a full inference of this class reports.
    s_tr_left -= 1;

    const uint32_t g0   = DWT->CYCCNT;
    const bool     drew = gpu_transpose_s8(tin->data.int8, s_tr_gpu,
                                           (uint32_t)tw, (uint32_t)th);
    const uint32_t gus  = (DWT->CYCCNT - g0) / 600u;

    s_tr_n  += 1u;
    s_tr_us += gus;

    if (!drew) {
        // A refusal is counted, not dropped: an offload that silently does
        // nothing when it is switched on is the worst of the three outcomes.
        s_tr_bad += 1u;
    } else {
        const int8_t* cpu = tout->data.int8;
        const int     n   = tw * th;
        unsigned      bad = 0u, worst = 0u;
        for (int i = 0; i < n; i++) {
            int d = (int)s_tr_gpu[i] - (int)cpu[i];
            if (d < 0) { d = -d; }
            if (d != 0) {
                bad++;
                if ((unsigned)d > worst) { worst = (unsigned)d; }
            }
        }
        s_tr_bad += bad;
        if (worst > s_tr_worst) { s_tr_worst = worst; }

        // THE ADOPTION RULE - the whole reason this switch is safe to press.
        // The GPU's bytes replace the CPU's ONLY when all n of them matched.
        // `tout` already holds the CPU answer and the CPU answer is the one the
        // rest of the graph has always used, so a draw that got a byte wrong (or
        // refused, above) leaves the product exactly on the CPU path for this
        // instance and says so in `bad`.  The per-instance comparison IS the
        // gate - there is no margin to choose and no layer gate to trust, and it
        // is re-earned on every activation of every inference.  Two passes over
        // n <= 38400 bytes cost well under 1 % of the draw they follow.
        if (bad == 0u) {
            int8_t*       dst = tout->data.int8;
            const int8_t* src = s_tr_gpu;
            for (int i = 0; i < n; i++) { dst[i] = src[i]; }
        }
    }
#else
    // GPU_ENABLE 0: no GPU part at all.  The stock transpose has ALREADY run -
    // `st` above is ex_time_call()'s result and `tout` already holds the CPU
    // answer - so the correct fall-through is to return it untouched, which is
    // exactly what the adoption rule below does when the comparison fails.  The
    // registration (YOLO_ADD_OP_TIME(3, Transpose, ...)) is deliberately left
    // alone: key `e` is a CPU timing probe and must keep working in this build.
#endif
    return st;
}
EX_WRAP(rs, 4)   // RESHAPE                  26
EX_WRAP(ga, 5)   // GATHER                   26
                 // slot 6 (RESIZE_NEAREST_NEIGHBOR) is deliberately unused -
                 // see the note at its registration in yolo_plate_init().
EX_WRAP(lg, 7)   // LOGISTIC                  4
EX_WRAP(sm, 8)   // SOFTMAX                   2
EX_WRAP(qz, 9)   // QUANTIZE                  6

// Stock registration, invoke swapped.  init/free/prepare stay stock, so each
// operator's own OpData is allocated in the arena exactly as it was before.
// The Add-name and the Register-name differ (AddMaxPool2D vs
// Register_MAX_POOL_2D), so both are passed.
#define YOLO_ADD_OP_TIME(SLOT, ADDNAME, REGNAME, FN) do {                   \
        s_ex_stock[SLOT] = tflite::Register_##REGNAME();                    \
        s_ex_impl[SLOT]  = s_ex_stock[SLOT];                                \
        s_ex_impl[SLOT].invoke = FN;                                        \
        if (resolver.Add##ADDNAME(s_ex_impl[SLOT]) != kTfLiteOk) {          \
            YOLO_TRACE0("init FAIL: Add" #ADDNAME); return false; }         \
    } while (0)

extern "C" void yolo_ex_timing_set(int on)
{
    s_ex_on = (on != 0) ? 1 : 0;
    if (s_ex_on != 0) {
        for (int k = 0; k < EX_CLASSES; k++) {
            s_ex_n[k]  = 0u;
            s_ex_cy[k] = 0ull;
        }
    }
}

extern "C" int yolo_ex_timing_get(void)
{
    return s_ex_on;
}

// Both arrays are EX_CLASSES long, in the class order above.  `us` is already
// divided by 600, i.e. it is directly comparable with main.c's `infer %u us`.
extern "C" void yolo_ex_stat(uint32_t* n, uint32_t* us)
{
    for (int k = 0; k < EX_CLASSES; k++) {
        if (n != nullptr)  { n[k]  = (uint32_t)s_ex_n[k]; }
        if (us != nullptr) { us[k] = (uint32_t)(s_ex_cy[k] / 600ull); }
    }
}

bool yolo_plate_init(void)
{
    const tflite::Model* model = tflite::GetModel(g_model_data);
    if (model == nullptr) {
        YOLO_TRACE0("init FAIL: GetModel() null - g_model_data bad");
        return false;
    }
    if (model->version() != TFLITE_SCHEMA_VERSION) {
        YOLO_TRACE("init FAIL: schema %u, pack wants %u",
                   (unsigned)model->version(), (unsigned)TFLITE_SCHEMA_VERSION);
        return false;
    }

    // model has exactly these 12 builtin op types
    // (CONV_2D 52 / DEPTHWISE 27 / TRANSPOSE 52 / RESHAPE 26 / GATHER 26 /
    //  CONCATENATION 19 / PAD 8 / QUANTIZE 6 / LOGISTIC 4 / SOFTMAX 2 /
    //  MAX_POOL_2D 1 / RESIZE_NEAREST_NEIGHBOR 1)
    static tflite::MicroMutableOpResolver<16> resolver;
    // CONV_2D goes on the same way DEPTHWISE_CONV_2D does just below: the stock
    // registration with invoke and prepare swapped.  If this fails, init fails,
    // which is correct - a resolver without CONV_2D cannot run the model at all.
    s_conv_stock = tflite::Register_CONV_2D();
    s_conv_impl  = s_conv_stock;
    s_conv_impl.prepare = conv_gpu_prepare;
    s_conv_impl.invoke  = conv_gpu_invoke;
    if (resolver.AddConv2D(s_conv_impl) != kTfLiteOk) {
        YOLO_TRACE0("init FAIL: AddConv2D");
        return false;
    }
    // DEPTHWISE_CONV_2D goes on with a registration that is the stock one except
    // for invoke and prepare - see the block above.  If this ever fails, the
    // whole init fails, which is correct: a resolver without this op cannot run
    // the model at all, GPU or no GPU.
    s_dw_stock = tflite::Register_DEPTHWISE_CONV_2D();
    s_dw_impl  = s_dw_stock;
    s_dw_impl.prepare = dw_gpu_prepare;
    s_dw_impl.invoke  = dw_gpu_invoke;
    if (resolver.AddDepthwiseConv2D(s_dw_impl) != kTfLiteOk) {
        YOLO_TRACE0("init FAIL: AddDepthwiseConv2D");
        return false;
    }
    // These ten go on with the exact-operator timing wrappers.  They are the
    // same stock registrations the plain YOLO_ADD_OP would have added - the
    // probe block above says why, and it is measurement-only.  The order here
    // IS the class order of s_ex_n[]/s_ex_cy[].
    YOLO_ADD_OP_TIME(0, MaxPool2D,             MAX_POOL_2D,              ex_invoke_mp);
    YOLO_ADD_OP_TIME(1, Pad,                   PAD,                      ex_invoke_pd);
    YOLO_ADD_OP_TIME(2, Concatenation,         CONCATENATION,            ex_invoke_cc);
    YOLO_ADD_OP_TIME(3, Transpose,             TRANSPOSE,                ex_invoke_tr);
    YOLO_ADD_OP_TIME(4, Reshape,               RESHAPE,                  ex_invoke_rs);
    YOLO_ADD_OP_TIME(5, Gather,                GATHER,                   ex_invoke_ga);
    // RESIZE_NEAREST_NEIGHBOR is NOT wrapped: this pack's
    // AddResizeNearestNeighbor() takes no registration argument (line 569 of
    // micro_mutable_op_resolver.h), and going around it needs a Parse* symbol
    // that this pack declares outside the micro tree.  It is ONE operator of
    // the 224 (10x10 -> 20x20), so it is left stock and its column stays 0 -
    // the census check below therefore covers 143 operators, not 144.  (The
    // 132 exact ones minus this one, plus the 12 nonlinear ones.)
    YOLO_ADD_OP(ResizeNearestNeighbor);
    YOLO_ADD_OP_TIME(7, Logistic,              LOGISTIC,                 ex_invoke_lg);
    YOLO_ADD_OP_TIME(8, Softmax,               SOFTMAX,                  ex_invoke_sm);
    YOLO_ADD_OP_TIME(9, Quantize,              QUANTIZE,                 ex_invoke_qz);

    static tflite::MicroInterpreter static_interp(model, resolver, tensor_arena,
                                                  TENSOR_ARENA_SIZE);
    s_interp = &static_interp;

    if (s_interp->AllocateTensors() != kTfLiteOk) {
        YOLO_TRACE0("init FAIL: AllocateTensors (reason above)");
        return false;
    }
    // Reports how much of the 2 MB the model actually keeps, so the arena and
    // the camera frame buffers can be rebalanced against a measurement.
    // 2026-10-12: gated on BOOT_VERBOSE - a delivered board should boot quiet.
    // The `init FAIL ...` lines around it are NOT gated: those are failures.
#if BOOT_VERBOSE
    YOLO_TRACE("init: arena %u of %u bytes, %u in %u out",(unsigned)s_interp->arena_used_bytes(),(unsigned)TENSOR_ARENA_SIZE,(unsigned)s_interp->inputs_size(),(unsigned)s_interp->outputs_size());
#endif

    s_in = s_interp->input(0);
    if (s_in == nullptr) {
        YOLO_TRACE0("init FAIL: input(0) null");
        return false;
    }
    // check [1,320,320,3] int8, quant scale=1/255 zero=-128
    if (s_in->dims->size == 4) {
        //YOLO_TRACE("init: in %d %d %d %d type %d zp %d sc %u",(int)s_in->dims->data[0], (int)s_in->dims->data[1],(int)s_in->dims->data[2], (int)s_in->dims->data[3],(int)s_in->type, (int)s_in->params.zero_point,(unsigned)(s_in->params.scale * 1000000.0f));
    } else {
        //YOLO_TRACE("init: in dims_size %u (want 4)", (unsigned)s_in->dims->size);
    }
    // NHWC: data[0]=batch, data[1]=H, data[2]=W, data[3]=channels.
    // (This used to read data[1]==1 / data[2]==H / data[3]==W, i.e. it demanded
    //  [N,1,H,W]; the real [1,320,320,3] then failed the check and returned
    //  false silently - the "yolo init ERROR" with no TFLM message at all.)
    if (s_in->dims->size != 4 ||
        s_in->dims->data[0] != 1 ||
        s_in->dims->data[1] != YOLO_IN_H ||
        s_in->dims->data[2] != YOLO_IN_W ||
        s_in->dims->data[3] != 3 ||
        s_in->type != kTfLiteInt8 ||
        fabsf(s_in->params.scale - (1.0f / 255.0f)) > 1e-6f ||
        s_in->params.zero_point != -128) {
        YOLO_TRACE("init FAIL: in check, want 1 %d %d 3 i8 zp-128 sc3921",
                   YOLO_IN_H, YOLO_IN_W);
        return false;
    }
    // outputs: [1,20,20,85] + [1,10,10,85], int8, scale 1/255, zp -128
    for (int o = 0; o < (int)s_interp->outputs_size(); o++) {
        TfLiteTensor* t = s_interp->output(o);
        if (t->dims->size >= 4) {
            //YOLO_TRACE("init: out%d %d %d %d %d type %d zp %d sc %u", o,(int)t->dims->data[0], (int)t->dims->data[1],(int)t->dims->data[2], (int)t->dims->data[3],(int)t->type, (int)t->params.zero_point,(unsigned)(t->params.scale * 1000000.0f));
        } else {
            //YOLO_TRACE("init: out%d dims_size %u", o, (unsigned)t->dims->size);
        }
        int h = t->dims->size >= 4 ? (int)t->dims->data[1] : 0;
        int w = t->dims->size >= 4 ? (int)t->dims->data[2] : 0;
        int c = t->dims->size >= 4 ? (int)t->dims->data[3] : 0;
        bool ok_hw = (h == YOLO_GRID0 && w == YOLO_GRID0) ||
                     (h == YOLO_GRID1 && w == YOLO_GRID1);
        if (t->type != kTfLiteInt8 || c != YOLO_CHAN || !ok_hw ||
            fabsf(t->params.scale - (1.0f / 255.0f)) > 1e-6f ||
            t->params.zero_point != -128) {
            YOLO_TRACE("init FAIL: output %d check (want h w %d or %d, c %d)", o, YOLO_GRID0, YOLO_GRID1, YOLO_CHAN);
            return false;
        }
    }
#if BOOT_VERBOSE
    YOLO_TRACE0("init OK");
#endif
    return true;
}

int yolo_plate_detect(const uint8_t* rgb, YoloBox* boxes, int max_box)
{
    if (s_interp == nullptr || s_in == nullptr) return -1;

    // int8 quant: q = round(v/255 / (1/255)) - 128 = v - 128
    if (s_in->type != kTfLiteInt8) return -1;
    int8_t* dst = s_in->data.int8;
    const int n = YOLO_IN_W * YOLO_IN_H * 3;

    for (int i = 0; i < n; i++) {
        dst[i] = (int8_t)((int)rgb[i] - 128);
    }

    // The conv counters are per inference, so they are cleared here rather than
    // in invoke - invoke cannot know which call is the first of a turn.
    s_cv_turn_layers = 0u;
    s_cv_turn_draws  = 0u;

    // The exact-operator probe's counters are per inference for the same
    // reason, and the loop is inside the gate so a board that never pressed
    // 'e' pays nothing here.
    if (s_ex_on != 0) {
        for (int k = 0; k < EX_CLASSES; k++) {
            s_ex_n[k]  = 0u;
            s_ex_cy[k] = 0ull;
        }
    }

    // The TRANSPOSE GPU arm is per inference for the same reason, and it is ONE
    // instance per turn: pressing 'x' (or 'i') five or six times samples the
    // operator five or six times on real activations rather than once per boot.
    // Arms nothing while the switch is off.  See ex_invoke_tr().
    yolo_tr_arm();

    if (s_interp->Invoke() != kTfLiteOk) return -2;

#if GPU_ENABLE
    // ONE line per BOOT, and only while the switch is on: this is the direct
    // evidence that the operator ran on the GPU - how many of the 52 conv layers
    // the GPU took, how many draws they cost, and how many the per-layer check
    // removed for good.  A run with the switch off prints nothing here, which is
    // what keeps a board that has switched it off identical to the pre-GPU one.
    // The latch is set only when it prints, so switching conv on later in a boot
    // still gets its line.  See the note on s_cv_sum_done for why not once a turn
    // - and for the `tail` exception that this second condition exists for.  The
    // latch is NOT set on the tail path, so the sweep keeps printing and a return
    // to an earlier cut prints again.
    if ((g_gpu_conv_on != 0u) &&
        ((s_cv_sum_done == 0) || (s_cv_sum_tail != (uint32_t)g_gpu_conv_tail))) {
        s_cv_sum_done = 1;
        s_cv_sum_tail = (uint32_t)g_gpu_conv_tail;
        uint32_t cr = 0, cp = 0, cu = 0;
        gpu_conv_stat(nullptr, nullptr, &cr, &cp, &cu);
        // `l`/`d` are THIS inference's; `r`/`pack`/`fold` are since boot, because
        // the per-layer refusals and the CPU-side bytes moved are the things
        // that accumulate and that the cost note in gpu.h is about.  The label
        // says which is which so a reader does not add two lines of different
        // kinds together.
        // `tail` is APPENDED as its own field rather than inserted, so the shape
        // of this line does not move under _gate.py (which reads it with a
        // regex) or under anything else already parsing it.  It is a STATE and
        // not a count: the same `l`/`d` mean different things under a different
        // cut, and a state that appears only in the key echo scrolls away from
        // the counts it qualifies.  0 = no limit = every eligible layer.
        sprintf(Message, "gpu cv l%u d%u | r%u pack%u fold%u | tail %u\r\n",
                s_cv_turn_layers, s_cv_turn_draws,
                (unsigned)cr, (unsigned)cp, (unsigned)cu,
                (unsigned)g_gpu_conv_tail);
        UART_SendString(Message);
    }
#endif  /* GPU_ENABLE - the conv census is the GPU's, so with the macro at 0 there
           is nothing to census.  No `#else`: the line it prints is the ONLY thing
           in this region, and the pure-CPU build must stay silent here. */


    // locate the two heads by spatial shape
    const int n_out = s_interp->outputs_size();
    if (n_out < 2) return -3;

    int cnt = 0;
    int unused_seen = 0;   // ① 不报这个数, 但 decode_head 要写它
    for (int o = 0; o < n_out; o++) {
        TfLiteTensor* t = s_interp->output(o);
        if (t->type != kTfLiteInt8) continue;
        int h = (int)t->dims->data[1];
        int w = (int)t->dims->data[2];
        int ch = (int)t->dims->data[3];
        if (ch != YOLO_CHAN) continue;
        int sid = -1;
        if (h == YOLO_GRID0 && w == YOLO_GRID0) sid = 0;
        else if (h == YOLO_GRID1 && w == YOLO_GRID1) sid = 1;
        if (sid < 0) continue;
        // keep_top = 0: ① 走老路径 (光栅序). 它在 conf 0.25 下永远到不了
        // max_box, 所以这个参数对它是纯空操作 —— 冻结基线的逐位一致靠这一条。
        decode_head(t->data.int8, sid, ANCHORS[sid], YOLO_CONF_THRESH,
                    boxes, cnt, max_box, 0, unused_seen);
    }

    nms(boxes, cnt, YOLO_NMS_THRESH);

    return cnt;
}

// ===========================================================================
// ② 裁剪找字 + 级联装配  (RELEASE_v1.0_2stage.md 的两个网络部分)
//
// 头文件 inc/yolo_inference.h 的级联那一段写了这套东西**为什么**存在、
// 三套坐标空间各是什么、以及两个必须知道的坑 (同帧、geo 开关)。 这里只写
// 实现上的取舍。 反复读一遍那段再动这个文件。
//
// ② 与 ① **逐字节同架构** —— 同样的 [1,320,320,3] 输入, 同样两个头
// [1,20,20,85] + [1,10,10,85], 同样布局 A。 所以 decode_head() / nms() 直接
// 复用, 只是参数不同。 不同的是权重、anchors, 和下面这三件事:
//
//   1. **算子必须原生注册**。 ① 把 CONV_2D / DEPTHWISE_CONV_2D 换成了 GPU
//      包装 (conv_gpu_invoke / dw_gpu_invoke), 而那一套是按**层张量下标**
//      索引的 (s_dwq[] / s_convq[])。 ② 的层下标和 ① 一模一样, 共用一套
//      scale 表就是把 ① 的量化参数用在 ② 的权重上; 而且 ② 自己还有 27 个
//      深度可分离层, 27+27 = 54 会冲爆 32 项的 s_dwq[]。 这是**正确性**
//      问题, 不是"要不要用 GPU"的取舍。 所以这里一律 tflite::Register_*()。
//
//   2. **独立的 arena**。 tensor_arena2 在 SDRAM 0xC0600000, 因为 ① 和 ② 的
//      张量要同时活着 (① 的 arena 实测用掉 1,303,080 字节, 塞不下第二个)。
//
//   3. **裁剪是把图拉成方的, 不是等比缩放**。 ② 训练时看到的裁剪图是
//      cv2.resize((cc), (320,320)) 出来的, 也就是一块 3:1 的牌被拉成 1:1。
//      板子上照做, 加 letterbox 反而与训练不一致 —— 这是静默掉点的那一类错。
//
// ③ (逐字分类 charhead) 已经接上, 上面第 1 条对它更加致命: 它一共只有 4 个
// 算子, 一个深度可分离层都没有, 而 ① 那套 GPU 胶水是按层张量下标索引的,
// 对它不但没用, 还会串到 ① 的 scale 表上。 注册的就是它真正用到的四类:
//
//     CONV_2D x6 / MAX_POOL_2D x3 / MEAN x1 / FULLY_CONNECTED x1
//
// 这张清单是从 tflite/onnx2tf_int8_charhead/charhead-int8.tflite 里
// _get_ops_details() 读出来的, **关掉 XNNPACK 委托**读的 —— 委托在板子上不存在,
// 开着读会把一部分算子报成 DELEGATE、而 ③ 又恰好没有 Reshape/Pad/AveragePool
// (MEAN 出来的 [1,1,1,64] 由 FC 自己展平), 所以四个注册就够, 一个都不能少。
//
// 接上 ③ 之后整串率 -> 78.99% (RELEASE_v1.0_2stage.md §0), 这正是当初做
// 两级结构的全部理由。 ③ 的输入是 32x64 = **32 宽 64 高**(竖长条), 和 ①/② 的
// 320x320 方图不是一个东西; patch 怎么抠见 charhead_cut_patch() 那段注释。
// ===========================================================================

// camera_map_box() 是 camera.c 里的 C 函数, 而本文件是 C++。 camera.h 只被
// main.c / camera.c 用, 直接 include 进来会把整个相机的接口拖进这个文件
// (而它本身还有个 extern "C" 的闭合, 依赖方向也别扭)。 级联真正需要的只有
// 这一个映射 —— 320x320 检测坐标 -> 800x480 相机坐标, 与 Python 的
// sx=W/320, sy=H/320 是同一个式子 —— 所以只声明它。
// 注意它内部用的是 camera.c 的 CAM_W/CAM_H (= DVP_IMAGE_WIDTH/HEIGHT), 所以
// 传进 yolo_cascade_run() 的 fw/fh 必须是同一对宏, 否则裁剪矩形会和这个映射
// 对不上。
extern "C" void camera_map_box(const YoloBox* in, YoloBox* out);

// ---- ② 的张量 arena (SDRAM 0xC0600000, UNINIT) ----
// 段名以 ".bss." 开头这条规则和 tensor_arena 完全一样, 理由也一样: 名字
// 决定 armclang 出 SHT_NOBITS 还是 SHT_PROGBITS, 而这里要是变成 RW,
// __main 会在 SDRAM 初始化之前去拷贝它 -> main() 之前的 HardFault, 串口
// 一个字都没有。
#ifndef TENSOR_ARENA2_SIZE
#define TENSOR_ARENA2_SIZE (0x200000)          // 2 MB, 与 RW_SDRAM2 同数
#endif
static uint8_t tensor_arena2[TENSOR_ARENA2_SIZE]
    __attribute__((section(".bss.tensor_arena2_area"), aligned(16)));

static tflite::MicroInterpreter* s_interp2 = nullptr;
static TfLiteTensor* s_in2 = nullptr;

// ---- ③ 的张量 arena + 模型副本 (都在 SDRAM 0xC0A00000 的 RW_SDRAM4 里) ----
// arena 只要 256 KB: ③ 的张量最大是第一个卷积的 64x32x16 = 32 KB, 剩下的都比它
// 小, 而 RW_SDRAM4 那 512 KB 还要让出 96 KB 给模型副本 (见下面)。
#ifndef TENSOR_ARENA3_SIZE
#define TENSOR_ARENA3_SIZE (0x40000)          // 256 KB
#endif
static uint8_t tensor_arena3[TENSOR_ARENA3_SIZE]
    __attribute__((section(".bss.tensor_arena3_area"), aligned(16)));

// ③ 的 90,144 字节 SDRAM 副本。 和 ② 那份一样: 大小写成 g_model_charhead_size 本身
// (不取整、不打余量), 让下面那条 static_assert 真能拦住不一致; .sct 里给整段
// 0x18000 已经有富余, 那一侧的检查是下面第二条。
static uint8_t s_charhead_model_ram[90144]
    __attribute__((section(".bss.charhead_model_ram_area"), aligned(16)));
static_assert(sizeof(g_model_charhead) == sizeof(s_charhead_model_ram),
              "s_charhead_model_ram must match g_model_charhead exactly");
static_assert(sizeof(s_charhead_model_ram) + TENSOR_ARENA3_SIZE <= 0x00080000u,
              "RW_SDRAM4 in M7_TCM.sct is too small for the model copy + ③ arena");

static tflite::MicroInterpreter* s_interp3 = nullptr;
static TfLiteTensor* s_in3  = nullptr;   // [1, 64, 32, 3] int8
static TfLiteTensor* s_out3 = nullptr;   // [1, 70] int8

// ③ 的初始化单独一个函数, 定义在 yolo_cascade_init() 后面。 它返回 false 只表示
// "③ 不可用", **不是**整个级联不可用 —— 见 yolo_cascade_init() 末尾那段。
static bool charhead_init(void);

// 一张 patch 的暂存 (3 x 32 x 64 = 6144 字节)。 放静态而不是栈上: 每帧最多用
// 七次, 但 6 KB 的栈上大数组在这颗核上没必要冒险。
static int8_t s_ch3_patch[YOLO_CHAR_IN_W * YOLO_CHAR_IN_H * 3];

// ③ 每一张的 top1-top2 差距 (int8 单位, scale 0.138 => 乘 0.138 得到 logit 差)。
// 它回答的是"串为什么每轮不一样"的最后一问: 如果翻的那个字差距只有 0..3,
// 那就是模型在这块牌上正踩在判决边界上 (换帧就翻), 不是链路有随机性;
// 如果差距很大却还在翻, 那才是别的地方错了。
static int s_ch3_margin[YOLO_CHAR_MAX] = {0};
static int s_ch3_last_margin = 0;

// ② 的 anchors, 来自 training/data_crop/voc.data, **按文件里的顺序**。
// 不是按面积排, 也不是 ① 的表换个尺度: 训练代码是按头对齐消费这六个数的
// (utils/utils.py 的 reshape), 所以前三个 stride 16 / 20x20, 后三个
// stride 32 / 10x10。 顺序错了**不会崩**, 只会让框变差 —— 这类错必须靠固定
// 图对拍才发现, 所以这里把来源写在旁边。
static const float ANCHORS_CROP[2][3][2] = {
    {{14.51f, 118.69f}, {21.80f, 80.17f}, {23.06f, 70.64f}}, // stride 16 (20x20)
    {{25.46f, 80.22f}, {26.10f, 110.15f}, {27.70f, 133.91f}} // stride 32 (10x10)
};

// ---- ① 的帧间复用状态 ----
// s_pl_box 存的是**相机空间**的框 (已经过 camera_map_box), 这样复用时不必
// 再映射一次, 也保证复用与重跑走的是同一条下游。
static YoloBox s_pl_box;
static int     s_pl_valid = 0;                    // 缓存里有没有可复用的框
static int     s_pl_age   = 0;                    // 已经复用了几轮
static int     s_reuse_age = YOLO_PLATE_REUSE_AGE; // 0/1 = 不复用

// ---- 上一轮的读数, 给 main.c 打日志 ----
// 没用 DWT? 用了, main.c 在扫描循环之前就 CoreDebug->DEMCR |= TRCENA /
// DWT->CTRL |= CYCCNTENA (src/main.c:479-481), 所以这里读 CYCCNT 是有效的。
// 600 MHz 下 CYCCNT 7.158 秒翻一圈, 而单次推理实测 1.7~4.6 秒 —— 无符号相减
// 在单个区间小于一圈时是绕回安全的, 这正是 main.c 自己也在用的算法。
static uint32_t s_cas_t_plate    = 0u;   // ① (复用那一轮是 0)
static uint32_t s_cas_t_crop     = 0u;   // 算裁剪矩形 + clip
static uint32_t s_cas_t_resample = 0u;   // 双线性重采样整块裁剪图
static uint32_t s_cas_t_cropinf  = 0u;   // ② 的 Invoke()
static uint32_t s_cas_t_char3    = 0u;   // ③: 抠 patch + 每次 Invoke + argmax, 全部合起来
static int      s_cas_n_cls      = 0;    // ③ 真的给出类别的个数 (<=nchar)
static int      s_cas_round      = 0;    // 第几轮 (诊断用: 判断某个读数是不是本轮的)
// 这一轮为什么没出串。 以前 ① 没框到牌和"框到了但形状不像牌"打出来一模一样
// (都是 box 0,0 0,0 n 0), 而这两件事的处置完全不同 —— 前者是检测器的事,
// 后者是 ②③ 在错的地方编串。 2026-10-20 那份日志有 58 轮 (no char),
// 分不清是哪一种, 只能猜。
static int      s_cas_why        = 0;    // 0 正常 | 1 ① 一个牌框都没有 | 2 形状闸拒了
// ② 的**原始**输出框数 (select_chars_7 截到 7 之前)。 它比 nchar 大就说明
// 这一轮框多了 —— 而 select_chars_7 是按**分数**截断的, 多出来的那个不一定
// 是噪声框, 可能是被挤掉的真字。
static int      s_cas_n2         = 0;
// ② 里**过 conf 的候选总数** (两个头加起来, NMS 之前, 不截断)。
// 2026-10-20: 这个数在 161 轮里 109 轮超过了 64, 说明当时的"光栅序截到 64"
// 一直在生效 —— 而且截掉的是图下半部分的格子, 不是分数最差的。 现在解码改成
// 按分数留最高的 64 个 (decode_head 的 keep_top=1), 这个数就退化成诊断:
// 它还是很大, 但丢掉的是最低分的, 不再有"整片区域进不来"的问题。
static int      s_cas_nraw       = 0;
static int      s_cas_rect[4]    = {0, 0, 0, 0};
static YoloBox  s_cas_box[YOLO_CROP_MAXBOX];

// ---- 取景自适应: ② 的输入尺度 --------------------------------------------
//
// ② 只在**一种取景**下训练过。 在 training/data_crop 上量 (见 _crop_stats.py):
//   pitch (字中心间距, 320 空间)  p50 25.8  p99 31.5
//   裁剪宽高比                    p50 1.78
//   anchors 最大也只是 27.7 x 133.9 (stride 32)
// 而板上 ① 的框比训练标签紧 (训练 GT 框 ≈ 1.25 x 车牌宽, 板上 ≈ 1.0),
// 于是同一个"框 + 10%"在板上把字放大了: 实测 pitch 29..36, 字框 32x140 ——
// 比最大的 anchor 还大, ② 的回归只能往外推, 框宽/框高顶在上限上。
//
// 修法: 用**上一轮 ② 自己量到的 pitch** 反过来定这一轮的裁剪宽, 每轮修正一次。
// ② 本来就每轮都跑, 所以这**不增加任何推理**, 相当于自动变焦。
// 只动**外扩比例** (两个轴同比例), 不动宽高比: 板上 ② 的框本身就是被尺度
// 带歪的 (原生宽高比 0.70, 训练标签 0.555), 这时硬把裁剪拧到训练的 1.78
// 会二次失真 —— 先修尺度, 框的形状会自己跟着回来。
#define YOLO_VIEW_ADAPT   1
#define YOLO_VIEW_PITCH   25.8f   // 目标: 训练 p50 (320 空间)
// 下限 0.02 = 裁剪比 ① 框宽 4%。它**不是**训练契约 (那是 10%), 只是一个
// 别裁进 ① 框里面的保险。 为什么不守在 0.10:
//   2026-10-19 第四次上板, 远牌 (① 框 293~313 px) 的 pitch 只有 18.7~22.7,
//   而这一轮算出来的**需要的**外扩比例是 0.028~0.058 —— 全被 0.10 夹掉,
//   于是 pitch 永远够不到目标, 末两位粘连 (n=6)、省字位每轮翻。
// 注意这里量的是 pitch (≈字的实际大小), 不是"裁得多紧": 夹在 0.10 的时候
// 字**比训练小 27%**, 并不是"守住了训练取景"。 让它落到 pitch=25.8, 字的
// 大小才和训练对齐; 那时裁剪宽 = 框宽 x 1.06, 与训练 1.20 相差 12%, 而
// 字框宽仍在 anchor 上限 27.7 之内 (pitch 25.8 对应字宽 ≈24, 训练 p50)。
#define YOLO_VIEW_MINM    0.02f
#define YOLO_VIEW_MAXM    0.70f   // 上限: 再大就把背景/另一块牌拉进来了
#define YOLO_VIEW_MIX     0.50f   // 一阶滤波, 防止某一轮 ② 抽风把尺度带飞

// 隔离点带来的额外间隔 / pitch。 这个数是**训练标签**上量出来的, 不是板上估的:
// data_crop 的 4363 张 7 字单行裁剪图, 6 个相邻间隔各除以本行中位间隔 ——
//   档 0 (位0->1) 0.984 | **档 1 (位1->2) 1.357 (p10 1.282 / p90 1.433)** |
//   档 2..5      1.000 / 1.000 / 1.000 / 0.986
// 即多出来的是 0.357*pitch。 之前取 0.30 (从板上单行估的, 那行有 ±3 px 噪声),
// 用 0.30 拟合出来的格点会把首末位各推偏 0.03*pitch ≈ 1 px。
//
// 定义在这里而不是格点那一段, 是因为**这里更早用**: 由 7 个框中心跨度量 pitch
// 时除的就是 6+F。 格点、补位、取景三处共用这一个数, 不能有第二份。
#define YOLO_LATTICE_F     0.357f

static float s_cas_view_margin = 0.0f;  // 自适应外扩比例; 0 = 还没量到, 用默认值
static float s_cas_pitch_meas  = 0.0f;  // 上一轮量到的 pitch (320 空间), 只给日志
static float s_cas_slope_meas  = 0.0f;  // 字行倾斜 dy/dx (320 空间), 只给日志; 正 = 右边低
static float s_view_m_target   = -1.0f; // 最近一次量到的**目标**外扩比例; <0 = 还没量到

// 由 7 个字符框的中心跨度和 ① 框宽反推外扩比例。
//
// 这里**只更新目标, 不动当前值** —— 真正的滤波在 view_adapt_tick(), 每轮都调。
// 拆开是有原因的: 量 pitch 需要恰好 7 个框, 而 ② 掉框 (n=6/5) 恰恰是尺度不对
// 的症状。 旧写法把两者绑在一起, 于是"因为尺度不对所以掉框, 因为掉框所以不
// 更新尺度"—— 2026-10-19 第三次上板 #17..#23 连续 7 轮 `vp` 一字不差、
// 第四次上板 #17..#21 又是 5 轮 16 不动, 都是这个死循环。
// 现在: 没量到就沿用上一次的目标, 每轮都往目标收敛半步。
static void view_adapt_update(const YoloBox* ch, float bw, int cw)
{
    const float c0 = (ch[0].x1 + ch[0].x2) * 0.5f;
    const float c6 = (ch[6].x1 + ch[6].x2) * 0.5f;
    const float span = c6 - c0;
    if (span <= 8.0f || bw <= 1.0f) return;

    const float pitch = span / (6.0f + YOLO_LATTICE_F);
    // pitch ∝ 1/裁剪宽, 所以想让 pitch 落到目标, 裁剪宽就按比例反着改。
    float m = (((float)cw * pitch / YOLO_VIEW_PITCH) / bw - 1.0f) * 0.5f;
    if (m < YOLO_VIEW_MINM) m = YOLO_VIEW_MINM;
    if (m > YOLO_VIEW_MAXM) m = YOLO_VIEW_MAXM;
    s_view_m_target = m;
    s_cas_pitch_meas = pitch;
}

// 每轮一次: 把当前外扩比例朝最近的目标推半步。 没量到过目标就什么都不做
// (裁剪走训练契约 10%)。 第一次量到目标直接跳过去, 不从 0 慢慢爬。
static void view_adapt_tick(void)
{
    if (s_view_m_target < 0.0f) return;
    s_cas_view_margin = (s_cas_view_margin > 0.0f)
                      ? (s_cas_view_margin * (1.0f - YOLO_VIEW_MIX)
                         + s_view_m_target * YOLO_VIEW_MIX)
                      : s_view_m_target;
}

// ---- 横滚自适应: ② 的输入角度 --------------------------------------------
//
// 先分清两个角度, 这是这一节存在的全部理由:
//
//   ② 的输入是把裁剪矩形 (cw x ch) **硬拉**成 320x320, 两个轴的缩放不一样。
//   所以一条在帧里 dy/dx 是 s 的字行, 在 320 空间里是 s*cw/ch; 反过来,
//   320 空间里的倾斜 s720 折回帧里只有 s720*ch/cw。
//
//   2026-10-19 第四次上板 #27..#30 (黑B45678 / 粤A56TA9 / 津BA5618):
//   日志 `vp` 的 slope 是 -411 / -371 / -336 / -345 (x1000), 字行在 320 空间
//   里斜了 19~22 度, 看着像转过一大截; 而裁剪大约 280x95, 帧里的真实横滚
//   只有 6.5~7.9 度 —— 就是"手稍微转一下"的量级。 同一份日志里能读对的
//   那些轮次 slope <= 0.05 (3 度以内)。
//
//   击中模型的是**320 空间**那个 20 度: ② 的 anchors 是按竖着的字标定的
//   (ANCHORS_CROP 最大 27.7 x 133.9), 一行斜 20 度的字, 每个框的轴对齐
//   外接矩形从 26 宽涨到 ~54, 远超 anchor 上限, 于是整行框一起崩。
//
// 做法: 沿**牌面自己的两个轴**重采样 (resample_aff_to_i8), 把字行转正。
// 角度从 ② 自己的输出量 —— 7 个字框中心对 x 做最小二乘, 与尺度自适应同一个
// 套路: 不增加任何推理, 每轮修正一次。
//
// 两个必须记住的点:
//   (1) 校正之后量到的是**残差**, 不是总角度。 所以新角度 = 本轮已用的角度
//       + 残差。 直接拿残差当角度会来回摆 (转正 -> 残差 0 -> 转回去)。
//   (2) 角度小于 MIN 时**不启用**仿射通路, 仍然走 resample_rect_to_i8 ——
//       竖直的车牌逐像素等于冻结基线, 这一改对它零影响。
#define YOLO_ROLL_MIN      0.008f  // 0.46 度: 以下不动
#define YOLO_ROLL_MAX      0.30f   // 17 度: 再多就不是横滚了, 是框错了
#define YOLO_ROLL_MIX      0.65f   // 每轮朝新目标走 65% (增益 < 1, 不会过冲)
// ---- 两道合理性闸 (2026-10-20) -------------------------------------------
// 2026-10-20 那份"转牌"采集把这条反馈环的毛病暴露出来了: 只要 ② 的整行框
// 崩一次, 中心最小二乘就给出 slope = -0.509 (320 空间 27 度) 这种数; 它被
// 原样累加进 roll (权重 0.65), 一轮把角度推了 8 度 —— 下一轮的取样轴跟着
// 歪, 框更崩, slope 继续大。 日志上是:
//
//     vp ... -509,-54    ->  roll -144 -> -177 -> -186 -> -194 -> -203 -> -206
//     撞上 ±17 度的硬顶, 然后在 -201 和 +94 之间来回横跳
//
// 所以累加器必须能被拒绝, 而不只是被夹住: YOLO_ROLL_MAX 夹的是**总角度**,
// 挡不住"每轮 +8 度"这种错误输入。
//
//   (1) |slope| 比 0.35 (320 空间 19 度) 大 = 框错了, 这一轮不量, 沿用上一次
//       的目标。 手转牌到不了这个量级。
//   (2) 单轮改动封顶 2 度: 就算残差是真的, 一帧也转不了 5 度。
//
// 两道都是"宁可不修": 不修的代价是继续歪着, 修错的代价是把 ② 的整行框带崩。
#define YOLO_ROLL_SLOPE_MAX  0.35f   // 320 空间 slope 上限 (19 度)
#define YOLO_ROLL_STEP_MAX   0.035f  // 单轮最多改 2 度

static float s_cas_roll      = 0.0f;  // **本轮生效**的横滚 (rad, 帧空间; 正 = 右边低)
static float s_cas_roll_used = 0.0f;  // 只给日志: 本轮真正用上的角度
static float s_cas_roll_tgt  = 0.0f;  // 最近一次量到的**目标**角度

// 用 7 个字框的中心量字行横滚, 折回帧空间后累加到已用角度上。
// 只在 n == 7 时调用 (6 字/8 字的位次对不上, 斜率没有意义)。
static void roll_update(const YoloBox* ch, int cw, int chh)
{
    if (cw <= 0 || chh <= 0) return;

    float sx = 0.0f, sy = 0.0f, sxx = 0.0f, sxy = 0.0f;
    for (int i = 0; i < 7; i++) {
        const float x = (ch[i].x1 + ch[i].x2) * 0.5f;
        const float y = (ch[i].y1 + ch[i].y2) * 0.5f;
        sx += x; sy += y; sxx += x * x; sxy += x * y;
    }
    const float d = 7.0f * sxx - sx * sx;
    if (d <= 1e-3f) return;

    const float s320 = (7.0f * sxy - sx * sy) / d;
    s_cas_slope_meas = s320;                                  // 日志照旧打 320 空间的数
    if (s320 != s320) return;                                 // NaN 兜底
    if (fabsf(s320) > YOLO_ROLL_SLOPE_MAX) return;            // 框错了, 这一轮不量

    // 320 空间 -> 帧空间: x 方向按 cw/320 缩放、y 方向按 ch/320, 比值就是 ch/cw。
    // 这一行的视觉重要性高于它的长度: 少了它, 6.5 度会被当成 20 度去转。
    const float s_frame = s320 * (float)chh / (float)cw;

    // 累加的一定是**这一轮真正用上的**角度, 不能是 s_cas_roll: 当 |角度| 还
    // 没到 MIN、走的是轴对齐通路时, 实际转的是 0, 若拿 s_cas_roll 去加, 每轮
    // 都多算一次残差 —— 一块本来只有 0.2 度的牌会把角度越推越大。
    float r = s_cas_roll_used + atanf(s_frame);               // 已用的 + 残余
    // 单轮封顶 2 度 (见 YOLO_ROLL_STEP_MAX): 这一条挡的是"残差本身离谱"。
    // 夹在**增量**上而不是总角度上, 所以角度大是真的转过来了也照样跟得上,
    // 只是每轮最多追 2 度。
    if (r > s_cas_roll_used + YOLO_ROLL_STEP_MAX) r = s_cas_roll_used + YOLO_ROLL_STEP_MAX;
    if (r < s_cas_roll_used - YOLO_ROLL_STEP_MAX) r = s_cas_roll_used - YOLO_ROLL_STEP_MAX;
    if (r >  YOLO_ROLL_MAX) r =  YOLO_ROLL_MAX;
    if (r < -YOLO_ROLL_MAX) r = -YOLO_ROLL_MAX;
    s_cas_roll_tgt = r;
}

// 每轮一次: 把当前角度朝最近的目标推一步。 没量到过目标就什么都不做。
static void roll_tick(void)
{
    s_cas_roll = s_cas_roll * (1.0f - YOLO_ROLL_MIX)
               + s_cas_roll_tgt * YOLO_ROLL_MIX;
    if (fabsf(s_cas_roll) < 1e-5f) s_cas_roll = 0.0f;
}

// ---- 复用轮的画面变化量 (只量, 不参与判断) --------------------------------
// 复用的判据现在只有时间 (s_pl_age < age), 而时间不是"画面变没变"的代理。
// 这里在 ① 的框内取 64x48 个点存一份参考 (9,216 字节), 之后每个复用轮在
// 同一框内再取同一批点求平均绝对差。 换牌/移牌会让这个数跳起来 —— 那就是
// 将来把判据换成内容之前需要的阈值分布。
//
// 采样而不是整块: 框在 320x320 里约 107x67, 64x48 已经是每格 1~2 像素,
// 而整块 7,169 点 x3 的差也只是 0.1 ms 量级, 两者都够 —— 采样省的是
// 9,216 字节 vs 21,507 字节的静态缓冲, 不是时间。
#define CHG_GX   64
#define CHG_GY   48
static uint8_t  s_chg_ref[CHG_GX * CHG_GY * 3];
static int      s_chg_valid = 0;              // 参考是不是这个缓存的框取的那一份
static uint32_t s_chg_last  = 0xFFFFFFFFu;    // 上一轮的读数, 0xFFFFFFFF = 无参考

// ---- ① 的原始候选框 (pick 之前), 给 main.c 的按键轮 dump -------------------
static YoloBox  s_plate_raw[YOLO_CROP_MAXBOX];
static int      s_plate_raw_n = 0;

static inline uint32_t cas_us(uint32_t t0)
{
    return (uint32_t)((DWT->CYCCNT - t0) / 600u);
}

// ---------------------------------------------------------------------------
// 选牌框: 复刻 training/full_pipeline_e2e.py 的 pick_plate(rule="area_conf",
// conf_margin=0.20)。
//
// 先在所有 class_id==0 (整牌框) 里找出最高分 smax, 只留下分数 >= smax-0.20
// 的那几个, 再取面积最大的。 为什么不直接取面积最大: 横跨整幅画面的幻觉框
// 面积最大, 分数却往往不高; 这一条把"分数掉队太多"的先排除掉, 面积才只在
// 势均力敌的几个之间做决定。
//
// 顺序也必须照抄: 先按分数筛, 再按面积取 —— 反过来的结果不一样。
// ---------------------------------------------------------------------------
static bool pick_plate_area_conf(const YoloBox* boxes, int n, YoloBox* out)
{
    float smax = -1.0f;
    for (int i = 0; i < n; i++) {
        if (boxes[i].class_id == 0 && boxes[i].score > smax) smax = boxes[i].score;
    }
    if (smax < 0.0f) return false;                 // 一个整牌框都没有

    const float lo = smax - YOLO_PLATE_PICK_MARGIN;
    int   best      = -1;
    float best_area = -1.0f;
    for (int i = 0; i < n; i++) {
        if (boxes[i].class_id != 0 || boxes[i].score < lo) continue;
        const float a = (boxes[i].x2 - boxes[i].x1) * (boxes[i].y2 - boxes[i].y1);
        if (a > best_area) { best_area = a; best = i; }   // > 而不是 >=: 平局取先出现的, 与 Python 的 max() 一致
    }
    if (best < 0) {
        // Python 那一行写的是 `c0 = keep_in or c0`。 理论上进不来 (smax 自己
        // 必然在区间里), 但照抄下来, 免得以后有人把 margin 调大到边界上时
        // 两边分叉而没人发现。
        for (int i = 0; i < n; i++) {
            if (boxes[i].class_id != 0) continue;
            const float a = (boxes[i].x2 - boxes[i].x1) * (boxes[i].y2 - boxes[i].y1);
            if (a > best_area) { best_area = a; best = i; }
        }
    }
    if (best < 0) return false;
    *out = boxes[best];
    return true;
}

// ---- 形状闸 (2026-10-19 重启后那次日志) ----
// 那次前 9 轮 ① 把画面正中的 88x109 竖框当成了车牌 (宽高比 0.81), 每轮复用
// 同一个位置, ②③ 在那一小块上编出 15 / 170 / 616 / 1T7 / 51学 —— 不是"读得
// 差", 是根本没框到牌。 中国车牌**全部宽大于高** (蓝/黄 440x140、双层绿
// 440x220、摩托 220x140), 所以高大于宽的框不可能是车牌。
//
// **必须在 camera_map_box() 之后判**: 检测帧是相机画面硬拉成 320x320 的
// (kx=800/320, ky=480/320), 两轴比例不同 —— 320 空间里的宽高比是相机空间的
// 0.6 倍, 一块 2.5 的正经车牌在 320 空间只有 1.5。 拿 320 空间套阈值会误杀。
// 极端转角下框会被压扁, 但那种牌本来也读不出来 —— 宁可打 (no char)。
#define YOLO_PLATE_MIN_ASPECT  1.0f

static bool plate_shaped_cam(const YoloBox& b)
{
    const float w = b.x2 - b.x1;
    const float h = b.y2 - b.y1;
    return (w > 0.0f) && (h > 0.0f) && (w >= YOLO_PLATE_MIN_ASPECT * h);
}

// ---------------------------------------------------------------------------
// 裁剪矩形: 复刻 full_pipeline_e2e.py 的 crop_by_plate()。
//
// 左上 floor、右下 ceil、各自 clip 到图内 —— 这四个取整方向不是风格问题:
// 用 int() 截断代替 floor 会让矩形在负坐标那一侧差一个像素, 而 10% 外扩本来
// 就常常把左上角推到图外。 外扩 10% 本身是**模型契约**: 裁紧掉 16.5 个点
// (字符更大反而更差), 板子上照抄, 别自作聪明裁紧。
//
// 注意右下是开区间 [x1, y1), 与 numpy 切片一致。
// ---------------------------------------------------------------------------
static void crop_rect_from_plate(const YoloBox& b, int fw, int fh, float margin,
                                 int* x0, int* y0, int* x1, int* y1)
{
    const float mx = (b.x2 - b.x1) * margin;
    const float my = (b.y2 - b.y1) * margin;

    int ax0 = (int)floorf(b.x1 - mx);
    int ay0 = (int)floorf(b.y1 - my);
    if (ax0 < 0)    ax0 = 0;
    if (ax0 > fw - 1) ax0 = fw - 1;
    if (ay0 < 0)    ay0 = 0;
    if (ay0 > fh - 1) ay0 = fh - 1;

    int ax1 = (int)ceilf(b.x2 + mx);
    int ay1 = (int)ceilf(b.y2 + my);
    if (ax1 < ax0 + 1) ax1 = ax0 + 1;
    if (ax1 > fw)      ax1 = fw;
    if (ay1 < ay0 + 1) ay1 = ay0 + 1;
    if (ay1 > fh)      ay1 = fh;

    *x0 = ax0; *y0 = ay0; *x1 = ax1; *y1 = ay1;
}

// ---------------------------------------------------------------------------
// 双线性重采样: 任意矩形 -> dw x dh, 直接写进 int8 输入张量 (每通道 -128)。
//
// 两个静默掉分的地方, 都在这里:
//
//   (a) **半像素约定**。 OpenCV 的 dst(x) 对应 src 上的 (x+0.5)*scale-0.5,
//       不是 x*scale。 在 320x320 这种大图上差半像素只是糊一点; ③ 那边要
//       缩到 32x64, 半像素就足够翻转 argmax 了 —— 所以从一开始就用对。
//   (b) **通道序**。 训练用的是 cv2 读的 BGR 还是 PIL 的 RGB, 取决于造
//       data_crop 的脚本; 这里固定按 RGB 取 (与 ① 的相机通路一致)。 要是有
//       一天发现红蓝反了, 症状是"字全认错但框很准", 改的是这里。
//
// 与 OpenCV 的差别: OpenCV 是定点权重 (INTER_BITS=5), 这里是浮点。 逐通道
// 差 <= 1 个灰阶, 对 ② 这种检测头无影响; ③ 上要盯的是 argmax 有没有翻。
//
// 缩小时**不做抗锯齿** —— 这不是偷懒: cv2.resize(INTER_LINEAR) 同样不做
// (做抗锯齿的是 INTER_AREA), 而 ② 训练时用的就是 INTER_LINEAR。
// ---------------------------------------------------------------------------
static void resample_rect_to_i8(const uint8_t* src, int fw, int fh,
                                int rx0, int ry0, int rx1, int ry1,
                                int8_t* dst, int dw, int dh)
{
    const int   rw = rx1 - rx0;
    const int   rh = ry1 - ry0;
    const float sx = (float)rw / (float)dw;
    const float sy = (float)rh / (float)dh;
    const int   max_x = rw - 1;
    const int   max_y = rh - 1;

    for (int dy = 0; dy < dh; dy++) {
        float fy = ((float)dy + 0.5f) * sy - 0.5f;
        if (fy < 0.0f)       fy = 0.0f;
        if (fy > (float)max_y) fy = (float)max_y;
        const int   ya = (int)fy;
        const int   yb = (ya < max_y) ? (ya + 1) : ya;
        const float wy = fy - (float)ya;
        const uint8_t* ra = src + ((size_t)(ry0 + ya) * (size_t)fw + (size_t)rx0) * 3u;
        const uint8_t* rb = src + ((size_t)(ry0 + yb) * (size_t)fw + (size_t)rx0) * 3u;
        int8_t* out = dst + (size_t)dy * (size_t)dw * 3u;

        for (int dx = 0; dx < dw; dx++) {
            float fx = ((float)dx + 0.5f) * sx - 0.5f;
            if (fx < 0.0f)        fx = 0.0f;
            if (fx > (float)max_x) fx = (float)max_x;
            const int   xa = (int)fx;
            const int   xb = (xa < max_x) ? (xa + 1) : xa;
            const float wx = fx - (float)xa;
            const uint8_t* pa = ra + (size_t)xa * 3u;
            const uint8_t* pb = ra + (size_t)xb * 3u;
            const uint8_t* qa = rb + (size_t)xa * 3u;
            const uint8_t* qb = rb + (size_t)xb * 3u;

            for (int ch = 0; ch < 3; ch++) {
                const float ta = (float)pa[ch];
                const float tb = (float)pb[ch];
                const float tc = (float)qa[ch];
                const float td = (float)qb[ch];
                const float top = ta + (tb - ta) * wx;
                const float bot = tc + (td - tc) * wx;
                int v = (int)(top + (bot - top) * wy + 0.5f);   // 非负, 故 +0.5 就是四舍五入
                if (v < 0)   v = 0;
                if (v > 255) v = 255;
                out[ch] = (int8_t)(v - 128);
            }
            out += 3;
        }
    }
}

// ---------------------------------------------------------------------------
// 仿射重采样: 沿**牌面自己的两个轴**取样 (横滚校正)。
//
// 坐标: (u,v) 是牌面坐标, u 沿字行、v 垂直, 单位都是**帧像素**:
//     frame = (ox,oy) + u*(co,si) + v*(-si,co)
// co/si 就是横滚角的 cos/sin。 半像素约定与 resample_rect_to_i8 一致,
// 所以 co=1,si=0 时两者逐像素相同 —— 竖直的车牌仍然走原来那条路。
//
// 逐像素夹到帧内: 裁剪矩形本身已经 clip 过, 但转过一个角度之后四个角会出去,
// 出界处取边缘像素 (BORDER_REPLICATE), 这是 cv2.warpAffine 的默认退化方式。
//
// 为什么必须做: 倾斜只在 320 空间里看着吓人、在帧里其实不大, 反过来也一样。
//   2026-10-19 第四次上板, 黑B45678 那块牌 slope_320 = -0.41 (22 度), 看着像
//   转了一大截, 但裁剪 280x95 被拉成 320x320, 帧里的真实横滚只有 -7.9 度。
//   可是 ② 看到的**就是** 320 空间那个 22 度 —— 字框的轴对齐外接矩形从
//   26 宽涨到 ~54 宽, 已经远超 anchors 的最大宽 27.7, 于是整行框全崩。
// ---------------------------------------------------------------------------
static void resample_aff_to_i8(const uint8_t* src, int fw, int fh,
                               float ox, float oy, float co, float si,
                               float uw, float uh,
                               int8_t* dst, int dw, int dh)
{
    const float su = uw / (float)dw;
    const float sv = uh / (float)dh;
    const float max_x = (float)(fw - 1);
    const float max_y = (float)(fh - 1);

    for (int dy = 0; dy < dh; dy++) {
        const float v = ((float)dy + 0.5f) * sv - 0.5f;
        int8_t* out = dst + (size_t)dy * (size_t)dw * 3u;

        for (int dx = 0; dx < dw; dx++) {
            const float u = ((float)dx + 0.5f) * su - 0.5f;

            float fx = ox + u * co - v * si;
            float fy = oy + u * si + v * co;
            if (fx < 0.0f)       fx = 0.0f;
            if (fx > max_x)      fx = max_x;
            if (fy < 0.0f)       fy = 0.0f;
            if (fy > max_y)      fy = max_y;

            const int   xa = (int)fx;
            const int   ya = (int)fy;
            const int   xb = (xa < fw - 1) ? (xa + 1) : xa;
            const int   yb = (ya < fh - 1) ? (ya + 1) : ya;
            const float wx = fx - (float)xa;
            const float wy = fy - (float)ya;
            const uint8_t* ra = src + ((size_t)ya * (size_t)fw + (size_t)xa) * 3u;
            const uint8_t* rb = src + ((size_t)yb * (size_t)fw + (size_t)xa) * 3u;
            const uint8_t* pa = ra;
            const uint8_t* pb = ra + (size_t)(xb - xa) * 3u;
            const uint8_t* qa = rb;
            const uint8_t* qb = rb + (size_t)(xb - xa) * 3u;

            for (int ch = 0; ch < 3; ch++) {
                const float top = (float)pa[ch] + ((float)pb[ch] - (float)pa[ch]) * wx;
                const float bot = (float)qa[ch] + ((float)qb[ch] - (float)qa[ch]) * wx;
                int t = (int)(top + (bot - top) * wy + 0.5f);
                if (t < 0)   t = 0;
                if (t > 255) t = 255;
                out[ch] = (int8_t)(t - 128);
            }
            out += 3;
        }
    }
}

// ---------------------------------------------------------------------------
// 一次裁剪的坐标: 轴对齐矩形 + 可选的取样轴旋转。
//
// rot = 0 时 ox/oy/co/si 全部不用, 所有取值都走原来的整数路径 (逐像素等于
// 冻结基线)。 rot = 1 时 (u,v) 是牌面坐标, 与轴对齐下的 (x,y) 一一对应:
//     u <=> 裁剪矩形内相对横坐标, v <=> 相对纵坐标
// 所以 ② 的框 (320 空间) 换算成 u/v 时用的还是 cw/320、ch/320 这两个比例。
//
// 唯一的差别在**裁剪图边界**: 轴对齐时它是矩形 [0,cw]x[0,ch]; 旋转之后它仍然
// 是 u/v 平面上的同一个矩形, 所以 clip 的写法完全可以照抄 —— 这也是为什么
// charhead_cut_patch 里那段 floor/ceil/clip 一行都没改, 只是最后取样时换了轴。
// ---------------------------------------------------------------------------
struct CropXform {
    int   rot;                        // 0 = 轴对齐, 1 = 沿牌面轴取样
    int   rx0, ry0, rx1, ry1;         // 轴对齐裁剪矩形 (帧坐标); 叠加框/日志仍用它
    float ox, oy, co, si;             // 取样轴原点与方向 (帧空间)
    int   uw, uh;                     // 取样区域宽高 (牌面像素) = rx1-rx0 / ry1-ry0
};

// 整块裁剪 -> dw x dh 的 int8 输入张量。
static void cx_apply(const CropXform& X, const uint8_t* src, int fw, int fh,
                     int8_t* dst, int dw, int dh)
{
    if (!X.rot)
        resample_rect_to_i8(src, fw, fh, X.rx0, X.ry0, X.rx1, X.ry1, dst, dw, dh);
    else
        resample_aff_to_i8(src, fw, fh, X.ox, X.oy, X.co, X.si,
                           (float)X.uw, (float)X.uh, dst, dw, dh);
}

// ---------------------------------------------------------------------------
// 选字符框: 复刻 training/two_stage_e2e.py 的 select_idx(geo=False, maxchars=7)。
//
// boxes[] 进来时已按**分数**降序 (nms 排好的)。 先取 class_id>0 的前 16 个
// (Python 的 16 上限), 再截到前 7 个, 最后按 x1 升序 —— 因为 7 < 16, 那个
// 16 永远不生效, 等价于"按分数取前 7 个"。
//
// **顺序不能换**: 先按分数截断, 再按 x 排。 反过来的话, 留下的会是"最靠左的
// 7 个", 而那些位置上的低分框正是旁边的字漏检时冒出来的噪声。
//
// geo=False 是故意的: yolo_plate_geo_set 那个几何分组是给**整图**① 的幻觉框
// 用的, 而现在这些框已经是从一块车牌里裁出来的 ② 的输出了, 前提不一样。
// 本函数不读那个开关, 但最后拼串用的是 yolo_plate_read(), 它**会**读 —— 所以
// main.c 里那个开关保持关闭, 这也是头文件里点名的那条。
// ---------------------------------------------------------------------------
static int select_chars_7(const YoloBox* boxes, int n, YoloBox* out)
{
    int idx[YOLO_PLATE_MAXBOX];
    int m = 0;
    for (int i = 0; i < n && m < YOLO_PLATE_MAXBOX; i++) {
        if (boxes[i].class_id > 0) idx[m++] = i;
    }
    if (m > YOLO_CHAR_MAX) m = YOLO_CHAR_MAX;

    for (int i = 1; i < m; i++) {                  // insertion sort by x1
        const int   key = idx[i];
        const float kx  = boxes[key].x1;
        int j = i - 1;
        while (j >= 0 && boxes[idx[j]].x1 > kx) { idx[j + 1] = idx[j]; j--; }
        idx[j + 1] = key;
    }
    for (int i = 0; i < m; i++) out[i] = boxes[idx[i]];
    return m;
}

// ---------------------------------------------------------------------------
// 7 字牌的中线格点: 把 ② 的字符框中心吸回牌面结构上。
//
// 为什么需要 (2026-10-19 上板, 同一个 crop、静止画面、chg 2):
//
//   第 3 位的框在两个位置之间跳, 而**类别跟着框跳**:
//       142,96 170,223 (中心 156)   -> '8', margin 47..54
//       128,98 161,224 (中心 144.5) -> '2'/'5'/'C', margin 0..5
//   同一个字, 两个框相差 11 px, 一个读对、一个每轮掷硬币。 旁边第 4 位
//   158..195 (宽 37, 比 pitch 宽 25%, 中心偏左 6 px) 的 margin 只有 5..12。
//
//   病根是牌面上的**隔离点**: 第 2、3 位之间比别处多一个点 (用户指出的
//   印刷结构), ② 有时会把框勾到点 + 空档上, 整体左移。 这不是模型读不准,
//   是抠图内容错了 —— 所以改框比改模型便宜得多。
//
// 牌面结构:  位 0 省份汉字 | 位 1 字母 | 点 | 位 2..6 序号
//   中心满足  c_i = a + p * (i + f * [i >= 2])
//
// 只拟合 (a, p) 两个自由参数: 7 个点、一个坏框拉不歪。 三参数版本 (f 也放开)
// 实测在坏框那一轮 f 从 +0.27 翻到 -0.05, 反过来把末位推出 -11 px —— 那比
// 不吸更坏。 f 固定成训练标签上量出来的 0.357 (见宏定义处的统计)。
//
// **中心、宽度分开处理。 宽度是无条件归一的; 中心只在整行明显歪时才投影。**
//
// 2026-10-19 第二次上板把主次排清楚了 —— **宽度才是主因, 中心是次要的**:
//   宽度 29 px 的那一轮: 位 5 读 'G', m 41
//   宽度 48 px 的那一轮: 位 5 读 '8', m 3
// 同样的位置、同样的中心 (242 附近), 只差框宽。 48 px 是 pitch 的 1.6 倍,
// 25% pad 之后 ③ 看到的是 2 倍宽的一格 —— 字在 patch 里被缩小, 判决就飘了。
// 这和 PC 上查到的结论是同一条: **坏框只有"太宽"这一种**。
//
// 所以宽度**不看中心残差**, 只要这一行位次可信就统一归一到中位数。 正常框
// (26..32, pitch ≈ 30) 本来就贴着中位数, 几乎不动; 只有 1.6 倍那种被拉回来。
//
// 中心的判据必须是**整行**的, 不能逐位设门限: 实测第 6 位好轮残差 +3.5、
// 坏轮 +4.8, 而 0.15*pitch = 4.4 恰好卡在中间, 逐位门限会一轮吸一轮不吸,
// 框就凭空跳 5 px, 等于自己制造新的抖动。 整行判据:
//   行内最大残差 <= 0.20*pitch  -> 中心本来就准, 一个像素都不动
//   行内最大残差 >  0.20*pitch  -> 7 个中心一起投影到格点上
// 投影是拟合结果的连续函数, 不会在门限上跳。 实测好轮最大残差 4.1/29.4=0.14,
// 坏轮 9.9/29.4=0.34, 两边都不贴门限。
//
// 宽度目标 **不用**印刷比 0.79: 检测框自带边距, 和字面宽度不是一回事; 硬套
// 0.79 会把每个正常框缩掉 20%, 而 25% pad 是叠在这之上抠 patch 的 —— 等于
// 整体改变 ③ 看到的图。 用这 7 个框自己的中位数, 再夹到 [0.85, 1.10]*pitch。
//
// 只对 n==7 生效 —— 6 字/8 字位次对不上这套结构, 猜比不动更坏。
//
// 2026-10-19 第二次上板 (重新上电后) 补的一条: **位次判错位时不要整行放弃**。
// 那几轮的 ② 在省份字上出了两个重叠框 (IoU 0.14, 类无关 NMS 0.30 两个都留),
// 行内残差 19 px = 0.64*pitch, 以前直接 return 0 -> 宽度也没归一 -> 框宽
// 26/36/25/32/30/28/27, ③ 的 margin 全在 0..10, 串全错。
// 现在先丢一个框重拟合 (残差降到 0.18*pitch), 再按新格点把 **7 个**框全部重定位。
// 关键点: patch 是在重定位后的位置上抠的, 所以"多出来的那个框"被推到它该在的
// 槽上以后, 抠出来的就是那个槽的字 —— 丢谁不影响结果, 只影响格点估计。
#define YOLO_LATTICE_ON      1
// YOLO_LATTICE_F (隔离点间隔 0.357) 定义在**文件靠前**的取景自适应那一段 ——
// 那里量 pitch 的时候就要除 6.357, 比这里早用。
#define YOLO_LATTICE_GATE    0.20f   // 行内最大残差超过这个比例才投影中心
#define YOLO_LATTICE_BAD     0.15f   // 残差超过 0.15*pitch 的位记进 sn (仅诊断)
#define YOLO_LATTICE_MAXRES  0.45f   // 超过近半个字距 -> 位次错位 (多检/漏检), 放弃
#define YOLO_LATTICE_WMIN    0.85f
#define YOLO_LATTICE_WMAX    1.10f
#define YOLO_LATTICE_PROJ    0x80000000u   // sn 的最高位 = 本轮投影了中心

// bit0..6 = 残差超过 0.15*pitch 的位; bit31 = 本轮投影了中心 (否则只是"有点偏")
static uint32_t s_ch3_snap = 0u;

// 返回 1 = 这 7 个框像一条正常的牌面 (位次可信, 可以按位限定类别);
//          包括"丢一个框重拟合后救回来"的情况 —— 格点对, 位次就可信。
// 返回 0 = 不是 7 字, 或者丢一个还是对不齐 —— 下游不要按 pos 猜类别。
static int snap_char_centers_7(YoloBox* b, int n)
{
    s_ch3_snap = 0u;
#if YOLO_LATTICE_ON
    if (n != 7) return 0;

    float xs[7], cs[7], ws[7];
    float sx = 0.0f, sc = 0.0f, sxx = 0.0f, sxc = 0.0f;
    for (int i = 0; i < 7; i++) {
        xs[i] = (float)i + ((i >= 2) ? YOLO_LATTICE_F : 0.0f);
        cs[i] = (b[i].x1 + b[i].x2) * 0.5f;
        ws[i] = b[i].x2 - b[i].x1;
        sx += xs[i]; sc += cs[i]; sxx += xs[i] * xs[i]; sxc += xs[i] * cs[i];
    }
    const float den = 7.0f * sxx - sx * sx;
    if (den <= 1e-6f) return 0;
    const float p = (7.0f * sxc - sx * sc) / den;
    const float a = (sc - p * sx) / 7.0f;
    if (p <= 1.0f) return 0;           // 退化的框 (全挤在一起), 不动

    float rmax = 0.0f;
    for (int i = 0; i < 7; i++) {
        const float r = fabsf(cs[i] - (a + p * xs[i]));
        if (r > rmax) rmax = r;
    }

    float pf = p, af = a;
    int   robust = 0;                  // 1 = 整行拟合不通过, 靠丢一个框救回来的

    if (rmax > YOLO_LATTICE_MAXRES * p) {
        // 位次自检没通过时, 先试**丢掉残差最大的那一个框**重拟合一次。
        // 第二次上板最常见的失败就是这样: 省份字被检成两个重叠框
        //   (74,88 100,226) + (92,80 128,223)
        // 两个都留下 -> 行内残差 19 px = 0.64*pitch -> 以前整行直接放弃,
        // 连宽度归一都不做, 7 个框宽 26/36/25/32/30/28/27 参差不齐, ③ 的
        // margin 全掉到 0..10。 丢一个重新拟合就干净了 (残差 0.18*pitch)。
        //
        // 丢的是"最不像格点的那个", 不一定是"多出来的那个" —— 这不要紧:
        // 下面 **7 个框全部**按格点重新定位, patch 是在新位置上抠的, 内容由
        // 格点决定, 不由它原来的检测位置决定。 只要格点对, 每一格抠到的字就对。
        int wi = 0; float wr = -1.0f;
        for (int i = 0; i < 7; i++) {
            const float r = fabsf(cs[i] - (a + p * xs[i]));
            if (r > wr) { wr = r; wi = i; }
        }
        const float sx2  = sx  - xs[wi];
        const float sxx2 = sxx - xs[wi] * xs[wi];
        const float sc2  = sc  - cs[wi];
        const float sxc2 = sxc - xs[wi] * cs[wi];
        const float den2 = 6.0f * sxx2 - sx2 * sx2;
        int ok6 = 0;
        if (den2 > 1e-6f) {
            pf = (6.0f * sxc2 - sx2 * sc2) / den2;
            af = (sc2 - pf * sx2) / 6.0f;
            if (pf > 1.0f) {
                float rm2 = 0.0f;
                for (int i = 0; i < 7; i++) {
                    if (i == wi) continue;
                    const float r = fabsf(cs[i] - (af + pf * xs[i]));
                    if (r > rm2) rm2 = r;
                }
                // 只剩 6 个点, 门槛收紧到 0.30 —— 松了就等于用一个坏格点
                // 强推 7 个位置, 那比不吸更坏。
                if (rm2 <= 0.30f * pf) ok6 = 1;
            }
        }
        if (!ok6) return 0;            // 丢一个还是不齐: 真·错位, 不套结构
        robust = 1;
    }

    // sn 的逐位标记按**最终**格点算 (救回来的那轮 p 变了)。
    s_ch3_snap = 0u;
    for (int i = 0; i < 7; i++) {
        if (fabsf(cs[i] - (af + pf * xs[i])) > YOLO_LATTICE_BAD * pf)
            s_ch3_snap |= (1u << i);
    }

    // ---------------------------- 宽度归一 (无条件) ----------------------------
    // 不跟中心门限走，也不跟"位次可信"走 —— 只要 n==7 就做。
    // 实测: 位次被判错位的那几轮，7 个框宽是 26/36/25/32/30/28/27，③ 的
    // margin 0..10; 同一块牌位次干净的那几轮归一后 margin 10..49。
    // 中位数本身对 1 个野框免疫, 归一化不会把好行改坏。
    float t[7];
    for (int i = 0; i < 7; i++) t[i] = ws[i];
    for (int i = 1; i < 7; i++) {               // 插入排序, 取中位数
        const float k = t[i];
        int j = i - 1;
        while (j >= 0 && t[j] > k) { t[j + 1] = t[j]; j--; }
        t[j + 1] = k;
    }
    float wt = t[3];
    if (wt < YOLO_LATTICE_WMIN * pf) wt = YOLO_LATTICE_WMIN * pf;
    if (wt > YOLO_LATTICE_WMAX * pf) wt = YOLO_LATTICE_WMAX * pf;

    // 宽度先归一到**当前中心**上; 中心要不要动由下面决定。
    const float half = wt * 0.5f;
    for (int i = 0; i < 7; i++) {
        b[i].x1 = cs[i] - half;
        b[i].x2 = cs[i] + half;
    }

    // ---------------------------- 中心投影 (整行判据) --------------------------
    if (!robust && rmax <= YOLO_LATTICE_GATE * pf) return 1;   // 中心本来就准, 不动

    for (int i = 0; i < 7; i++) {
        const float want = af + pf * xs[i];
        b[i].x1 = want - half;
        b[i].x2 = want + half;
    }
    s_ch3_snap |= YOLO_LATTICE_PROJ;
    return 1;
#else
    (void)b; (void)n;
    return 0;
#endif
}

// ---------------------------------------------------------------------------
// n == 6 时, 用牌面格点把漏掉的那一位补回来。
//
// 现象 (2026-10-19 第三次上板, 粤R888G8, 15 轮里 12 轮 n=6):
//   串是 粤R8888 / 粤R888沪 / 粤R888湘 —— 末位要么没了, 要么读成省字。
//   最后那个框宽 34..54 (正常 26), 中心 241, 而格点上它该在 230 (位5) 或
//   259 (位6) —— 是**末两位粘连成一个框**, 不是 ③ 读错。
//   同一块牌在别的轮次 (n=7) 又完全正常, 说明是检测的边界状态。
//
// 关键点: patch 是按**框的位置**从冻结帧里抠的, 抠到什么内容由位置决定,
// 不由检测结果决定。 所以只要能估出格点, 补出来的槽抠到的就是那个字。
//
// 只处理 n==6, 而且要过两道闸 (残差都相对 pitch):
//   A: 6 个框直接套 7 槽 (缺 1 槽),        残差 <= 0.15
//   B: 丢 1 个框, 5 个点套 7 槽 (缺 2 槽), 残差 <= 0.08  (点更少, 门槛更紧)
// 真·6 字牌 (字距全等) 在 A 上残差约 0.26、在 B 上约 0.13, 两道都过不去 ——
// 这就是"不把 6 字牌硬掰成 7 字"的保险。 另加一条 p 的合理性闸: 拟合出的
// pitch 必须落在中位间隔的 0.7~1.4 倍之间, 否则 5 个点能拟合出任何东西。
//
// 补出来的 7 个框**全部**按格点重定位, 不是只补缺的那个 —— 粘连的那个框
// 位置本来就不对, 一起摆正才对齐。
#define YOLO_LATTICE_A6   0.15f
#define YOLO_LATTICE_B6   0.08f
// 相对判据 —— **这条才是"不把 6 字牌掰成 7 字"的主保险**, 绝对门槛挡不住:
// 7 槽里的 2..6 是等距的, 所以任何 6 个等距的框都能完美套进某 5 个槽。
//   离线对拍 (training/_row6_check.py):
//     板上真实失败 (位5粘连+位6丢失)  r7 0.015 / r_uniform 0.112  -> 收
//     干净地缺最后一位                r7 0.000 / r_uniform 0.148  -> 收
//     干净地缺第一位 / 缺中间一位      r7 0.000 / 0.162 / 0.336    -> 收
//     真 6 字牌 (等距)                 r_uniform 0.000            -> 拒
//     真 6 字牌 +-1 / +-2 px 噪声      r_uniform 0.042 / 0.093    -> 拒
#define YOLO_LATTICE_REL    0.40f   // r7 必须 <= 0.40 * r_uniform
#define YOLO_LATTICE_RMIN   0.10f   // 且等距模型本身要明显不成立
#define YOLO_CH6_AKEYS    11

static int s_ch6_n     = -1;   // -1 = 本轮不是 6 框 (日志用)
static int s_ch6_round = -1;   // 上一次真的分析过 6 框的轮次; 和当前轮次不等就是陈旧数据
static int s_ch6_kind  = 0;    // 0 = 没补, 1 = 走 A, 2 = 走 B
static int s_ch6_drop  = -1;   // B: 丢掉的框下标; A: -1
static int s_ch6_px10  = 0;    // 拟合出的 pitch x10
static int s_ch6_rx100 = 0;    // 最大残差 / pitch x100
static int s_ch6_c[6]  = {0, 0, 0, 0, 0, 0};   // 补位**之前**的 6 个中心

// 把 n 个中心按 map[] 指定的槽位做最小二乘 (a, p), 返回 max 残差 / p。
// map[i] = 第 i 个观测框用的槽位下标。
static float fit_slots(const float* xs, const float* c, const int* map, int n,
                       float* a_out, float* p_out)
{
    float sx = 0.0f, sc = 0.0f, sxx = 0.0f, sxc = 0.0f;
    for (int i = 0; i < n; i++) {
        const float x = xs[map[i]];
        sx += x; sc += c[i]; sxx += x * x; sxc += x * c[i];
    }
    const float den = (float)n * sxx - sx * sx;
    if (den <= 1e-6f) return 1e9f;
    const float p = ((float)n * sxc - sx * sc) / den;
    const float a = (sc - p * sx) / (float)n;
    if (p <= 1.0f) return 1e9f;
    float rmax = 0.0f;
    for (int i = 0; i < n; i++) {
        const float r = fabsf(c[i] - (a + p * xs[map[i]]));
        if (r > rmax) rmax = r;
    }
    *a_out = a;
    *p_out = p;
    return rmax / p;
}

static int popcount7(int m)
{
    int k = 0;
    for (int i = 0; i < 7; i++) if (m & (1 << i)) k++;
    return k;
}

// 返回这 7 个框的个数 (6 = 没补, 7 = 补上了)。 b[] 容量 >= 7。
static int rebuild_row_7(YoloBox* b, int n)
{
#if YOLO_LATTICE_ON
    s_ch6_n = -1;
    s_ch6_kind = 0;
    s_ch6_drop = -1;
    s_ch6_px10 = 0;
    s_ch6_rx100 = 0;
    if (n != 6) return n;

    float c[6], w[6], y1[6], y2[6];
    for (int i = 0; i < 6; i++) {
        c[i]  = (b[i].x1 + b[i].x2) * 0.5f;
        w[i]  = b[i].x2 - b[i].x1;
        y1[i] = b[i].y1;
        y2[i] = b[i].y2;
        s_ch6_c[i] = (int)(c[i] + 0.5f);
    }
    s_ch6_n = 6;
    s_ch6_round = s_cas_round;

    float xs[7];
    for (int i = 0; i < 7; i++) xs[i] = (float)i + ((i >= 2) ? YOLO_LATTICE_F : 0.0f);

    float gs[5];
    for (int i = 0; i < 5; i++) gs[i] = c[i + 1] - c[i];
    for (int i = 1; i < 5; i++) {              // 插入排序取中位间隔
        const float k = gs[i];
        int j = i - 1;
        while (j >= 0 && gs[j] > k) { gs[j + 1] = gs[j]; j--; }
        gs[j + 1] = k;
    }
    const float gm = gs[2];
    if (gm < 4.0f) return n;                    // 框全挤在一起, 不是一排字

    // ---- 闸 A: 6 个框 -> 7 槽里缺 1 个 ----
    float ba = 0.0f, bp = 0.0f, br = 1e9f;
    int   bmask = 0;
    for (int mask = 1; mask < 128; mask++) {
        if (popcount7(mask) != 6) continue;
        int map[6], k = 0;
        for (int s = 0; s < 7; s++) if (mask & (1 << s)) map[k++] = s;
        float a, p;
        const float r = fit_slots(xs, c, map, 6, &a, &p);
        if (r < br) { br = r; ba = a; bp = p; bmask = mask; }
    }
    s_ch6_px10  = (int)(bp * 10.0f + 0.5f);
    s_ch6_rx100 = (br < 9.0f) ? (int)(br * 100.0f + 0.5f) : 999;
    if (br <= YOLO_LATTICE_A6 && bp > 0.7f * gm && bp < 1.4f * gm) {
        s_ch6_kind = 1;
    } else {
        // ---- 闸 B: 丢 1 个框, 5 个点 -> 7 槽里缺 2 个 ----
        float ca = 0.0f, cp = 0.0f, cr = 1e9f;
        int   cmask = 0, cdrop = -1;
        for (int d = 0; d < 6; d++) {
            float cd[5];
            int ci = 0;
            for (int i = 0; i < 6; i++) if (i != d) cd[ci++] = c[i];
            for (int mask = 1; mask < 128; mask++) {
                if (popcount7(mask) != 5) continue;
                int map[5], k = 0;
                for (int s = 0; s < 7; s++) if (mask & (1 << s)) map[k++] = s;
                float a, p;
                const float r = fit_slots(xs, cd, map, 5, &a, &p);
                if (r < cr) { cr = r; ca = a; cp = p; cmask = mask; cdrop = d; }
            }
        }
        s_ch6_px10  = (int)(cp * 10.0f + 0.5f);
        s_ch6_rx100 = (cr < 9.0f) ? (int)(cr * 100.0f + 0.5f) : 999;
        if (cr > YOLO_LATTICE_B6 || cp <= 0.7f * gm || cp >= 1.4f * gm) return n;

        ba = ca; bp = cp; br = cr; bmask = cmask;
        s_ch6_kind = 2;
        s_ch6_drop = cdrop;
    }
    (void)bmask;

    // ---- 相对判据: 等距 6 槽模型必须明显不成立, 且 7 槽要明显更好 ----
    // 绝对残差门槛单独用不够: 7 槽里 2..6 本来就等距, 一块**真 6 字牌**
    // 能完美套进那 5 个槽 (离线对拍: r 0.000)。 所以这里先算等距模型的
    // 残差 r_uniform, 要求它 >= 0.10 (这个排不是等距的), 且 r7 <= 0.40*r_u。
    {
        static const float xu[6] = {0.0f, 1.0f, 2.0f, 3.0f, 4.0f, 5.0f};
        static const int   mu[6] = {0, 1, 2, 3, 4, 5};
        float ua, up;
        const float ru = fit_slots(xu, c, mu, 6, &ua, &up);
        if (!(ru >= YOLO_LATTICE_RMIN && ru < 1.0f && br <= YOLO_LATTICE_REL * ru)) {
            s_ch6_kind = 0;
            return n;
        }
    }

    // 补出来的首末位必须还在裁剪里 (外推 2 格时最容易飞)
    if (ba + bp * xs[0] < -8.0f || ba + bp * xs[6] > 328.0f) {
        s_ch6_kind = 0;
        return n;
    }

    // 宽度: 6 个框的中位数 (粘连的那个是野值, 中位数免疫)
    float ts[6];
    for (int i = 0; i < 6; i++) ts[i] = w[i];
    for (int i = 1; i < 6; i++) {
        const float k = ts[i];
        int j = i - 1;
        while (j >= 0 && ts[j] > k) { ts[j + 1] = ts[j]; j--; }
        ts[j + 1] = k;
    }
    float wt = (ts[2] + ts[3]) * 0.5f;
    if (wt < YOLO_LATTICE_WMIN * bp) wt = YOLO_LATTICE_WMIN * bp;
    if (wt > YOLO_LATTICE_WMAX * bp) wt = YOLO_LATTICE_WMAX * bp;
    const float half = wt * 0.5f;

    // 纵向: 中位数, 7 个字在同一行上
    float ty1[6], ty2[6];
    for (int i = 0; i < 6; i++) { ty1[i] = y1[i]; ty2[i] = y2[i]; }
    for (int i = 1; i < 6; i++) {
        const float k = ty1[i];
        int j = i - 1;
        while (j >= 0 && ty1[j] > k) { ty1[j + 1] = ty1[j]; j--; }
        ty1[j + 1] = k;
    }
    for (int i = 1; i < 6; i++) {
        const float k = ty2[i];
        int j = i - 1;
        while (j >= 0 && ty2[j] > k) { ty2[j + 1] = ty2[j]; j--; }
        ty2[j + 1] = k;
    }
    const float my1 = (ty1[2] + ty1[3]) * 0.5f;
    const float my2 = (ty2[2] + ty2[3]) * 0.5f;

    for (int i = 0; i < 7; i++) {
        const float cx = ba + bp * xs[i];
        b[i].x1 = cx - half;
        b[i].x2 = cx + half;
        b[i].y1 = my1;
        b[i].y2 = my2;
        b[i].class_id = 1;          // ③ 会覆盖; ③ 没起来时至少是"非 0"
        b[i].score = 0.5f;
    }
    return 7;
#else
    (void)b;
    s_ch6_n = -1;
    return n;
#endif
}

// ---------------------------------------------------------------------------
// ③ 逐字分类 (charhead): 32x64 小图 -> 70 类。
//
// 输入规格是从 charhead-int8.tflite 里读出来的, 不是推的:
//   in  [1, 64, 32, 3] int8, scale 1/255, zero_point -128
//       **H=64, W=32** —— 竖长条。 训练那边的 size_wh = [32, 64] 是 (W, H),
//       和这里是同一个东西的两种写法; 按字面把它当成"64 宽 32 高"是最容易犯的
//       一个错, 而且不会崩, 只会让字全认错。
//   out [1, 70] int8, scale 0.138210 (>0), zero_point 18
//       scale 为正, 所以 argmax(int8) == argmax(float), 不必反量化。
//
// patch 的抠法逐行复刻 training/cascade_ceiling.py:69-82 的 cut_patch:
// 外扩 pad=0.25 (charhead checkpoint 里记的那个 pad), 左上 floor、右下 ceil、
// 各自 clip 到裁剪图内, 再 cv2.resize(INTER_LINEAR) 到 (32, 64)。
//
// **抠的是原生分辨率的裁剪图, 不是 ② 那张 320x320。** Python 那边
// (int8_emulate.py:303) 是 cut_patch(cc, bp, ...), cc 就是裁剪图的原始像素,
// 而 320x320 是 cc 缩小之后的样子 —— 从 320 上抠等于多缩了一次, 字越小人越糊。
// 板子上裁剪图没有单独的副本, 它就是冻结帧上的 [rx0,ry0,rx1,ry1) 那一块, 所以
// 这里把 ② 的框映回帧坐标再直接重采样。 与 Python 逐像素等价: 裁剪是纯切片
// (crop_by_plate 就是 im[y0:y1, x0:x1]), 没有插值, 所以先裁后缩和先缩后裁在
// 这一步是一致的。 这样也不必去碰 ② 的输入张量 —— 它还活着, 但那是 320 空间的。
//
// 坐标换算与 int8_emulate.py:293 相同: s2x = cw/320, s2y = ch/320, cw/ch 是
// 裁剪图的原生宽高。 框可能越出裁剪图 (② 的框不受裁剪图边界约束), 所以两边都要
// 像 Python 那样 clip, 而不是假定它在里面。
// ---------------------------------------------------------------------------
static void charhead_cut_patch(const uint8_t* frame888, int fw, int fh,
                               const CropXform& X, const YoloBox* b, int8_t* dst)
{
    const int cw = X.uw;
    const int ch = X.uh;

    const float s2x = (float)cw / (float)YOLO_IN_W;
    const float s2y = (float)ch / (float)YOLO_IN_H;

    const float x0 = b->x1 * s2x, y0 = b->y1 * s2y;   // 320 空间 -> 裁剪图原生像素
    const float x1 = b->x2 * s2x, y1 = b->y2 * s2y;

    const float mx = (x1 - x0) * YOLO_CHAR_PAD;
    const float my = (y1 - y0) * YOLO_CHAR_PAD;

    int X0 = (int)floorf(x0 - mx);
    int Y0 = (int)floorf(y0 - my);
    if (X0 < 0)      X0 = 0;
    if (X0 > cw - 1) X0 = cw - 1;          // cw >= 1 由 crop_rect_from_plate 保证
    if (Y0 < 0)      Y0 = 0;
    if (Y0 > ch - 1) Y0 = ch - 1;

    int X1 = (int)ceilf(x1 + mx);
    int Y1 = (int)ceilf(y1 + my);
    if (X1 < X0 + 1) X1 = X0 + 1;
    if (X1 > cw)     X1 = cw;
    if (Y1 < Y0 + 1) Y1 = Y0 + 1;
    if (Y1 > ch)     Y1 = ch;

    // 映回冻结帧坐标后依然是 [x0, x1) 开区间; 到这里它必然整块落在帧内
    // (裁剪矩形本身已经 clip 到帧内), 所以 resample_rect_to_i8 的前置条件成立。
    if (!X.rot) {
        resample_rect_to_i8(frame888, fw, fh,
                            X.rx0 + X0, X.ry0 + Y0, X.rx0 + X1, X.ry0 + Y1,
                            dst, YOLO_CHAR_IN_W, YOLO_CHAR_IN_H);
        return;
    }

    // 旋转通路: 上面算出来的 (X0,Y0)-(X1,Y1) 本来就是**裁剪图自己的坐标**,
    // 而裁剪图在旋转通路里就是 u/v 平面的 [0,cw]x[0,ch] —— 所以这段 clip
    // 一行都不用改, 只是最后取值时沿牌面轴走。 原点平移到 (X0,Y0) 之后的
    // 帧坐标 = O + X0*d + Y0*e。
    resample_aff_to_i8(frame888, fw, fh,
                       X.ox + (float)X0 * X.co - (float)Y0 * X.si,
                       X.oy + (float)X0 * X.si + (float)Y0 * X.co,
                       X.co, X.si, (float)(X1 - X0), (float)(Y1 - Y0),
                       dst, YOLO_CHAR_IN_W, YOLO_CHAR_IN_H);
}

// 一次 ③ 推理 + argmax, 返回类别下标 (0..69); 没初始化或 Invoke 失败返回 -1。
// 一次一张 (batch 1): Python 是一批喂进去的, 但 BN 已经折进卷积, 逐张与成批
// 逐元素相同 —— 成批在这里只省几次调用开销, 而每张才 6 KB, 不值得为它多写一层。
//
// `pos` / `layout7` 是**按位限定类别** (7 字牌才有固定位次):
//   位 0 = 省份汉字      -> class 35..69 (PROV_GBK)
//   位 1 = 字母          -> class 11..34 (CHARS 里 1..10 是数字)
//   位 2..6 = 数字或字母 -> class 1..34
// 这些范围以外的类不可能出现在这一位上, 直接从 argmax 的候选里删掉: 不花
// 算力, 也不会把"合法但分更低"的类顶上去 —— 只是在原候选里取最高的合法类。
// n != 7 时位次对不上结构 (缺一位就会全体左移), 这时按原样全 70 类比较。
// 注意 margin 因此变成**限定后**的 top1-top2。
static int charhead_classify(const int8_t* patch, int pos, int layout7)
{
    if (s_interp3 == nullptr || s_in3 == nullptr || s_out3 == nullptr) return -1;

    const int n = YOLO_CHAR_IN_W * YOLO_CHAR_IN_H * 3;
    int8_t* d = s_in3->data.int8;
    for (int i = 0; i < n; i++) d[i] = patch[i];

    if (s_interp3->Invoke() != kTfLiteOk) return -1;

    int lo = 0, hi = YOLO_CHAR_CLS - 1;
    if (layout7 != 0) {
        if (pos == 0)      { lo = 35; hi = 69; }
        else if (pos == 1) { lo = 11; hi = 34; }
        else               { lo = 1;  hi = 34; }
    }

    const int8_t* o = s_out3->data.int8;
    int best = lo;
    int second = -128;        // int8 的最小值, 保证真实存在两类以上时被覆盖
    for (int i = lo + 1; i <= hi; i++) {
        if (o[i] > o[best]) { second = o[best]; best = i; }
        else if (o[i] > second) { second = o[i]; }
    }
    s_ch3_last_margin = (int)o[best] - second;
    return best;              // scale > 0 => int8 上比大小就是比实数
}

// ---------------------------------------------------------------------------
// ② 的模型: 先拷进 SDRAM 副本再解析, 拷贝那一遍把 D-Cache 关掉
//
// 上板 HARD FAULT 的现场用 fromelf 反汇编 Objects/Printf.axf 钉死到了一条指令:
//     ca88  LDR  r0,[r4,#0]     ; r4 = Model*, r0 = 根表里的 soffset
//     ca8a  SUBS r1,r4,r0       ; r1 = vtable
//     ca8c  LDRH r0,[r1,#0]     ; vtable 尺寸
//     ca94  LDRH r1,[r1,#8]     ; VT_SUBGRAPHS 的字段偏移
//     ca9e  LDR  r2,[r4,r1]     ; r2 = *(u32*)(model + fieldoff)
//     caa0  ADD  r1,r1,r4       ; r1 = model + fieldoff
//     caa4  LDR  r1,[r1,r2]     ; <<< BFAR 0xEB0CB54C
//     caa8  LSLS r1,r1,#3       ; * sizeof(SubgraphAllocations)
// 就是 micro_allocator.cpp:651 的 `sizeof(...) * model->subgraphs()->size()`。
//
// 现场那个 fieldoff 读成了 0xEA2C。 上一版一度想从寄存器反推它 (R1 - Model*),
// 但 Model* 本身取决于上一版链接出来的地址, 那个算术不能当证据 —— 下面这条才是。
// 文件里 blob 16 = vtable+8 应当是 **0x0014 = 20** (根表 table size
// 才 32, 合法字段偏移不可能到 59948)。 而 0xEA2C 在文件里是 **blob 48** 那个字
// (subgraphs 的 uoffset 0x0003EA2C) 的低半字 —— blob 48 = blob 16 + 32。
// 反过来, 能验证的 **32 位读** 全部和文件一致: blob 0 的 root offset = 28,
// blob 56 的 version = 3, blob 0xEA48 的 0xD606F9F4 ✓ (BFAR 也算得过来:
// 0x1505BB58 + 0xD606F9F4 = 0xEB0CB54C, 和现场一模一样)。 解析是在那个 16 位
// LDRH 上崩的, 但按后来量出来的形状, 它所在的那一整行 32 字节都是错的, 只是解析
// 没读到那几个字节。 旁证: ca8e 的 `CMP r0,#9; BCC` 没跳 (PC 才会走到 caa4),
// 说明 blob 8 那个 halfword 读回来 >= 9, 和文件里的 0x0014 相符 —— 同一时刻, 它
// 前面那一行是对的。
//
// 板上量出来的形状 (比反汇编那一步硬; 离线反解出来的, 见 tflite/_dbg_shift.py):
//
//   * 板子眼里那 431,360 字节和文件差在**唯一一行**: rel 0x10..0x2F
//     (绝对 0x1504D120..0x1504D13F) 装的是**文件 +16 处的内容**, 其余 431,328
//     字节逐字节相等。 形状是"这一条 32 字节行被从 +16 处填了", 不是某几个字节
//     翻了。 解析因此把 schema version 读成 199989017, 干净地 return false。
//   * 那一行正是**本段里第一条 32 字节对齐的行**: Printf.map 里
//     `ER_MODEL_RO (Exec base: 0x1504d110, Size: 0x00069500)`, 段里只有 ②,
//     段基址 = 数组基址 = 0x1504D110 —— 对齐 16 而不是 32。 对照 ① 的 flash 拷贝
//     基址 0x150DDDA0 (RW_AXI_SRAM 的 Load base) 是 32 对齐。
//   * 镜像本身是对的: inc/model_data_crop.h 的数组 = crop-int8.tflite 逐字节相同;
//     Objects/Printf.axf 和 bin/Printf.bin 里 flash 0x1504D110 那 431,360 字节
//     也 = .tflite 逐字节相同 (tflite/_dbg_image.py)。
//   * 不是陈旧缓存行: SCB_EnableDCache() 打开之前先整片 invalidate
//     (src/main.c 那段注释), 复位前留下的行活不到这里。
//   * 不是读宽度: 32/16/8 位三种宽度扫同一块 flash, 加按字节拷进 SDRAM 再读回,
//     四个 CRC 全等于 FDD8557B (上一版那四个 fW/fH/fB/rB 量的就是这个; 全等 ->
//     假设否掉, 所以这一版把按宽度读的三个 helper 删了)。
//
// 剩下两种可能, 这一版当场对拍分开: A 遍 D-Cache 开着按字节读 flash (走缓存行
// 填充那条路), B 遍 SCB_DisableDCache() 之后再读同一批地址 (每次单次访问, 没有
// 行填充), 两遍逐字节比对, 差异报在 cache-on / cache-off 两个 CRC 上:
//   crcOff = want, crcOn != want -> CPU 的读通路 (缓存行填充这一类)。 解析用的是
//                                   B 遍写下的那份副本, 于是可用。
//   crcOn = crcOff = want        -> 这次没复现。
//   crcOn = crcOff != want       -> flash 里的内容就不对: 全片擦除, 重下同一镜像,
//                                   代码不用再动。 这时 "crop cache diff" 给出的
//                                   偏移若不再是 0x10, 说明坏的地方也变了。
//   crcOn != crcOff 但都不是 want -> 两种读法各有各的错, 把 diff 那两行发出来。
//
// **这一版同时把 g_model_crop 改成 32 字节对齐** (inc/model_data_crop.h 的
// aligned(32), tflite/export_c_array.py 同步生成)。 两处一起动的代价是: 若这次
// 两个 CRC 都等于 want, 分不清是"对齐"治好的还是"关着缓存拷贝"治好的。 接受这个
// 代价 —— 两个改动都该留在最终版本里 (模型段 32 字节对齐本该是规矩; 拷贝那一段也
// 不该赌"同一颗核读自己写下的缓存"), 而且 diff 那几行让"坏行搬到哪儿去了"照样
// 看得见: 不管落到哪一种分支, 日志都还读得出下一步。 顺带把 ③ 的位置也摆正了:
// ② 挪到 0x1504D120 之后长 0x69500, ③ 直接跟在后面落在 0x150B6620 (32 对齐)。
//
// 拷完就地解析 (CROP_MODEL_USE_RAM = 0 可以切回 XIP 原地读做对照)。
// 副本落在 MDK-ARM/M7_TCM.sct 的 RW_SDRAM5 (0xC0920000, 0x80000), 就在
// RW_SDRAM3 的 Max 末尾之后, 仍在 MPU region 4 (0xC0800000, 2MB, WB cacheable)
// 里, 到 0xC0A00000 的 RW_SDRAM4 还差 0x16B00。 段名以 .bss. 开头是必须的
// (见 .sct 里那段: 否则 __main 会在 SDRAM 初始化之前去搬它, HardFault 在最前面)。
//
// 关于"关掉 D-Cache 的那一小段安不安全", 写清楚免得以后再推一遍:
// SCB_DisableDCache() 先 clean+invalidate 再关, 所以 A 遍那些脏行会落到 SDRAM,
// B 遍读得到; SCB_EnableDCache() 重新打开之前又整片 invalidate, 所以关着的那段里
// 若有中断动过内存, 也不会留下陈旧行 (缓存关着写下去的东西本来就直接在内存里)。
// 那段窗口里没有 DMA 会往可缓存区写 (相机帧缓冲是 MPU 里非缓存的 region 1, GPU
// 那几块是 Device), 所以不存在"CPU 看不见 DMA 写"的窗口。
// 拷贝循环的指针是 volatile 的, 否则 -O2 会把字节循环折成字拷贝。
// ---------------------------------------------------------------------------
#define CROP_MODEL_USE_RAM    1

// ② 的 431,360 字节的 SDRAM 副本。 UNINIT, 开机不初始化、不拷贝。
// 大小对不上就让编译拦下来 —— 这条硬编码一旦和 g_model_crop 脱节, 症状是静默
// 的读越界, 不该等到板子上才发现。 .sct 里 RW_SDRAM5 的 0x80000 也要跟得上。
static uint8_t s_crop_model_ram[431360]
    __attribute__((section(".bss.crop_model_ram_area"), aligned(16)));
static_assert(sizeof(g_model_crop) == sizeof(s_crop_model_ram),
              "s_crop_model_ram must match g_model_crop exactly");
static_assert(sizeof(s_crop_model_ram) <= 0x00080000u,
              "RW_SDRAM5 in M7_TCM.sct is too small for s_crop_model_ram");

// CRC32 (多项式 0xEDB88320, 初值/终值取反), 和 zlib.crc32() 同值。
static uint32_t crop_crc32_update(uint32_t crc, uint8_t byte)
{
    crc ^= (uint32_t)byte;
    for (int b = 0; b < 8; b++) {
        crc = (crc >> 1) ^ (0xEDB88320u & (uint32_t)(-(int32_t)(crc & 1u)));
    }
    return crc;
}

// 上一版这里还有按 16/32 位宽度读 flash 的两个 helper, 连同按字节读的第三个,
// 四个 CRC 打出来全等 —— 宽度不是变量, 所以删了。 现在要分的是"缓存开着读"和
// "缓存关着读", 两遍都按字节读, 只是中间关了一次 D-Cache。
bool yolo_cascade_init(void)
{
    // ---- 拷进 SDRAM 副本, 顺带把"D-Cache 开着读"和"关着读"当场对拍 ----
    // 判读见上面那段长的。
    {
        const volatile uint8_t* fsrc = (const volatile uint8_t*)g_model_crop;
        volatile uint8_t*       ram  = (volatile uint8_t*)s_crop_model_ram;
        const uint32_t          nbyt = (uint32_t)g_model_crop_size;
        const uint32_t          want = 0xD7DC5BA5u;

        // A 遍: D-Cache 开着按字节读 flash, 顺手把字节写进 SDRAM 副本。
        // 写落在可写回的 SDRAM 上, 下面 SCB_DisableDCache() 会先 clean 下去。
        uint32_t crc = 0xFFFFFFFFu;
        for (uint32_t i = 0; i < nbyt; i++) {
            const uint8_t b = fsrc[i];
            ram[i] = b;
            crc = crop_crc32_update(crc, b);
        }
        const uint32_t crcOn = ~crc;

        // B 遍: 关掉 D-Cache 再读同一批地址。 关之前 CMSIS 先 clean+invalidate,
        // 所以 A 遍那 431 KB 已经落到 SDRAM (缓存关着读 SDRAM 就是读它本身);
        // 关着的那一段里每次读都是一次访问, 不再有缓存行填充。
        SCB_DisableDCache();

        uint32_t diffs = 0u, first = 0u;
        uint8_t  onA[8] = {0}, offB[8] = {0};
        crc = 0xFFFFFFFFu;
        for (uint32_t i = 0; i < nbyt; i++) {
            const uint8_t b = fsrc[i];   // 无缓存读 flash
            const uint8_t a = ram[i];    // 无缓存读 SDRAM = A 遍存下的字节
            if (b != a) {
                if (diffs == 0u) {
                    first = i;
                    // 两侧各留 8 字节。 此刻 ram[first+1..] 还没被 B 遍改过,
                    // 读到的就是 A 遍的字节。
                    for (uint32_t j = 0; j < 8u && (first + j) < nbyt; j++) {
                        onA[j]  = ram[first + j];
                        offB[j] = fsrc[first + j];
                    }
                }
                diffs++;
                ram[i] = b;              // 副本以无缓存读到的那一份为准
            }
            crc = crop_crc32_update(crc, b);
        }
        const uint32_t crcOff = ~crc;

        SCB_EnableDCache();              // 重新打开之前整片 invalidate

        YOLO_TRACE("crop flash %u B at %08X -> ram %08X",
                   (unsigned)nbyt, (unsigned)fsrc, (unsigned)(const void*)s_crop_model_ram);
        // 两个 CRC 都应当 = want。 判读 (和上面那段长的里那段一致):
        //   crcOff=want 而 crcOn!=want -> 缓存行填充那一类的读通路问题; 解析用的是
        //                                B 遍写下的那份副本, 于是可用
        //   crcOn=crcOff=want         -> 这次没复现
        //   crcOn=crcOff!=want        -> flash 里的内容不对: 全片擦除后重下同一镜像
        //   两值不等且都不是 want      -> 把下面 diff 那两行发出来
        YOLO_TRACE("crop crc cache-on %08X cache-off %08X want %08X",
                   (unsigned)crcOn, (unsigned)crcOff, (unsigned)want);
        YOLO_TRACE("crop cache diff %u first 0x%X", (unsigned)diffs, (unsigned)first);
        if (diffs != 0u) {
            // 缓存开着读到的 8 字节 / 缓存关着读到的 8 字节。 上一次那个坏行在
            // rel 0x10..0x2F, 装的是文件 +16 处的内容 —— 这里应当打的就是它。
            YOLO_TRACE("crop badOn %02X %02X %02X %02X %02X %02X %02X %02X",
                       (unsigned)onA[0], (unsigned)onA[1], (unsigned)onA[2], (unsigned)onA[3],
                       (unsigned)onA[4], (unsigned)onA[5], (unsigned)onA[6], (unsigned)onA[7]);
            YOLO_TRACE("crop badOff %02X %02X %02X %02X %02X %02X %02X %02X",
                       (unsigned)offB[0], (unsigned)offB[1], (unsigned)offB[2], (unsigned)offB[3],
                       (unsigned)offB[4], (unsigned)offB[5], (unsigned)offB[6], (unsigned)offB[7]);
        }
        // 解析真正会读到的头 32 字节 (从 SDRAM 副本, B 遍写下的那份)。 文件里的
        // 真值: 0000001C 334C4654 00200014 0018001C 00100014 0000000C 00040008
        //       00000014
        {
            const volatile uint32_t* rw = (const volatile uint32_t*)(const void*)ram;
            YOLO_TRACE("crop headS %08X %08X %08X %08X %08X %08X %08X %08X",
                       (unsigned)rw[0], (unsigned)rw[1], (unsigned)rw[2], (unsigned)rw[3],
                       (unsigned)rw[4], (unsigned)rw[5], (unsigned)rw[6], (unsigned)rw[7]);
        }
    }

#if CROP_MODEL_USE_RAM
    YOLO_TRACE0("crop parse: SDRAM copy");
    const tflite::Model* model = tflite::GetModel((const void*)s_crop_model_ram);
#else
    YOLO_TRACE0("crop parse: XIP in place");
    const tflite::Model* model = tflite::GetModel(g_model_crop);
#endif
    if (model == nullptr) {
        YOLO_TRACE0("crop init FAIL: GetModel() null - g_model_crop bad");
        return false;
    }
    if (model->version() != TFLITE_SCHEMA_VERSION) {
        YOLO_TRACE("crop init FAIL: schema %u, pack wants %u",
                   (unsigned)model->version(), (unsigned)TFLITE_SCHEMA_VERSION);
        return false;
    }

    // 12 个算子, 与 ① 完全同一张清单 (同架构 -> 同算子集)。 一律原生注册:
    // 这一段**没有** s_conv_impl / s_dw_impl, 是这里唯一与 yolo_plate_init()
    // 形似而实不同的地方, 原因见上面那段长的。 16 项的容量对 12 个算子够用,
    // 并且复用了 ① 留下的余量 —— 但两者是各自独立的对象, 不共享下标。
    static tflite::MicroMutableOpResolver<16> resolver2;
    if (resolver2.AddConv2D(tflite::Register_CONV_2D()) != kTfLiteOk) {
        YOLO_TRACE0("crop init FAIL: AddConv2D");
        return false;
    }
    if (resolver2.AddDepthwiseConv2D(tflite::Register_DEPTHWISE_CONV_2D()) != kTfLiteOk) {
        YOLO_TRACE0("crop init FAIL: AddDepthwiseConv2D");
        return false;
    }
    if (resolver2.AddMaxPool2D(tflite::Register_MAX_POOL_2D()) != kTfLiteOk) {
        YOLO_TRACE0("crop init FAIL: AddMaxPool2D");
        return false;
    }
    if (resolver2.AddPad(tflite::Register_PAD()) != kTfLiteOk) {
        YOLO_TRACE0("crop init FAIL: AddPad");
        return false;
    }
    if (resolver2.AddConcatenation(tflite::Register_CONCATENATION()) != kTfLiteOk) {
        YOLO_TRACE0("crop init FAIL: AddConcatenation");
        return false;
    }
    if (resolver2.AddTranspose(tflite::Register_TRANSPOSE()) != kTfLiteOk) {
        YOLO_TRACE0("crop init FAIL: AddTranspose");
        return false;
    }
    if (resolver2.AddReshape(tflite::Register_RESHAPE()) != kTfLiteOk) {
        YOLO_TRACE0("crop init FAIL: AddReshape");
        return false;
    }
    if (resolver2.AddGather(tflite::Register_GATHER()) != kTfLiteOk) {
        YOLO_TRACE0("crop init FAIL: AddGather");
        return false;
    }
    if (resolver2.AddLogistic(tflite::Register_LOGISTIC()) != kTfLiteOk) {
        YOLO_TRACE0("crop init FAIL: AddLogistic");
        return false;
    }
    if (resolver2.AddSoftmax(tflite::Register_SOFTMAX()) != kTfLiteOk) {
        YOLO_TRACE0("crop init FAIL: AddSoftmax");
        return false;
    }
    if (resolver2.AddQuantize(tflite::Register_QUANTIZE()) != kTfLiteOk) {
        YOLO_TRACE0("crop init FAIL: AddQuantize");
        return false;
    }
    // 和 ① 一样故意不留一个可选项 —— 这个版本的包 AddResizeNearestNeighbor()
    // 收不了 registration 参数 (见 yolo_plate_init() 里那段注释)。
    if (resolver2.AddResizeNearestNeighbor() != kTfLiteOk) {
        YOLO_TRACE0("crop init FAIL: AddResizeNearestNeighbor");
        return false;
    }

    static tflite::MicroInterpreter static_interp2(model, resolver2, tensor_arena2,
                                                   TENSOR_ARENA2_SIZE);
    s_interp2 = &static_interp2;

    if (s_interp2->AllocateTensors() != kTfLiteOk) {
        YOLO_TRACE0("crop init FAIL: AllocateTensors (reason above)");
        return false;
    }
    // ② 的 arena 用掉多少 —— 和 ① 一样打出来。 这个读数目前**还没有在板子上
    // 量过**: ② 与 ① 逐字节同架构, 所以预期在 ① 的 1,303,080 附近 (差一点是
    // 正常的, 两个模型的中间张量不会完全相同), 但"预期"不是读数。 第一次上板
    // 请把这一行记下来: arena 的大小和 RW_SDRAM2 的大小是同一个数
    // (MDK-ARM/M7_TCM.sct), 超过 2 MB 就得先动那边。
#if BOOT_VERBOSE
    YOLO_TRACE("crop init: arena %u of %u bytes, %u in %u out",
               (unsigned)s_interp2->arena_used_bytes(), (unsigned)TENSOR_ARENA2_SIZE,
               (unsigned)s_interp2->inputs_size(), (unsigned)s_interp2->outputs_size());
#endif

    s_in2 = s_interp2->input(0);
    if (s_in2 == nullptr) {
        YOLO_TRACE0("crop init FAIL: input(0) null");
        return false;
    }
    // 输入必须与 ① 的逐项相同: [1,320,320,3] int8, scale 1/255, zero_point -128。
    // 不同的地方只有一个 —— 它的内容是**裁剪图**, 不是整帧。 这个检查在这里
    // 特别值: ② 是从同一份训练代码导出来的, 输入规格要是不对, 只可能是导出
    // 参数被改错了, 而不是模型本身有别的想法。
    if (s_in2->dims->size != 4 ||
        s_in2->dims->data[0] != 1 ||
        s_in2->dims->data[1] != YOLO_IN_H ||
        s_in2->dims->data[2] != YOLO_IN_W ||
        s_in2->dims->data[3] != 3 ||
        s_in2->type != kTfLiteInt8 ||
        fabsf(s_in2->params.scale - (1.0f / 255.0f)) > 1e-6f ||
        s_in2->params.zero_point != -128) {
        YOLO_TRACE("crop init FAIL: in check, want 1 %d %d 3 i8 zp-128 sc3921",
                   YOLO_IN_H, YOLO_IN_W);
        return false;
    }
    for (int o = 0; o < (int)s_interp2->outputs_size(); o++) {
        TfLiteTensor* t = s_interp2->output(o);
        if (t == nullptr || t->dims->size < 4) {
            YOLO_TRACE("crop init FAIL: output %d dims", o);
            return false;
        }
        const int h = (int)t->dims->data[1];
        const int w = (int)t->dims->data[2];
        const int c = (int)t->dims->data[3];
        const bool ok_hw = (h == YOLO_GRID0 && w == YOLO_GRID0) ||
                           (h == YOLO_GRID1 && w == YOLO_GRID1);
        if (t->type != kTfLiteInt8 || c != YOLO_CHAN || !ok_hw ||
            fabsf(t->params.scale - (1.0f / 255.0f)) > 1e-6f ||
            t->params.zero_point != -128) {
            YOLO_TRACE("crop init FAIL: output %d check (want h w %d or %d, c %d)",
                       o, YOLO_GRID0, YOLO_GRID1, YOLO_CHAN);
            return false;
        }
    }
#if BOOT_VERBOSE
    YOLO_TRACE0("crop init OK");
#endif

    // ③ 起不来**不拦路**: 打一行就走, s_interp3 保持 nullptr, 级联自己降级成
    // ①②-only —— yolo_cascade_run() 里那个 `s_interp3 != nullptr` 的判断就是为这个
    // 写的。 这比"③ 一失败就把整条级联丢掉"重要得多: ② 单独有 25~27%, 而退回单
    // 模型是 0~1%, 差一个数量级, 不该由 ③ 的一个初始化细节一票决定。
    if (!charhead_init()) {
        YOLO_TRACE0("charhead init FAILED - cascade degrades to 2-stage (no 3)");
    }
    return true;
}

// ============================== ③ 的初始化 ==============================
    // 和 ② 同一套做法, 理由也一样: 先把 flash 里的 90,144 字节按字节读出来写进
    // SDRAM 副本, 而且这一段放在**关掉 D-Cache 的窗口**里, 之后解析的是这份副本。
    //
    // 为什么不直接 XIP 原地读: ② 的 431,360 字节在这块板子上被读出过一行 32 字节
    // 的错字节 (内容 = 文件 +16 处), 根因还没定下来 (上面 ② 那段长的里列了四种
    // 可能和这一版用来分开它们的对拍)。 ③ 紧跟在 ② 后面、走同一条读通路, 没有
    // 理由假设它免疫 —— 而 ③ 读错一行的症状是"个别字认错", 那是最难从实景里
    // 看出来的一类错。 代价是 96 KB SDRAM 和一次 90 KB 的拷贝, 在 init 里一次。
// ---------------------------------------------------------------------------
static bool charhead_init(void)
{
    {
        const volatile uint8_t* fsrc = (const volatile uint8_t*)g_model_charhead;
        volatile uint8_t*       ram  = (volatile uint8_t*)s_charhead_model_ram;
        const uint32_t          nbyt = (uint32_t)g_model_charhead_size;

        SCB_DisableDCache();
        for (uint32_t i = 0; i < nbyt; i++) ram[i] = fsrc[i];
        SCB_EnableDCache();

        YOLO_TRACE("charhead flash %u B at %08X -> ram %08X",
                   (unsigned)nbyt, (unsigned)fsrc, (unsigned)(const void*)s_charhead_model_ram);
    }

    const tflite::Model* model3 = tflite::GetModel((const void*)s_charhead_model_ram);
    if (model3 == nullptr) {
        YOLO_TRACE0("charhead init FAIL: GetModel() null - g_model_charhead bad");
        return false;
    }
    if (model3->version() != TFLITE_SCHEMA_VERSION) {
        YOLO_TRACE("charhead init FAIL: schema %u, pack wants %u",
                   (unsigned)model3->version(), (unsigned)TFLITE_SCHEMA_VERSION);
        return false;
    }

    // 4 个算子, 一个都不多 (见文件上面那段: 清单是从 .tflite 读出来的, 而且是
    // 关掉 XNNPACK 委托读的)。 ③ 没有深度可分离层, 也没有 Reshape —— MEAN 出来的
    // [1,1,1,64] 由 FULLY_CONNECTED 自己展平。
    static tflite::MicroMutableOpResolver<4> resolver3;
    if (resolver3.AddConv2D(tflite::Register_CONV_2D()) != kTfLiteOk) {
        YOLO_TRACE0("charhead init FAIL: AddConv2D");
        return false;
    }
    if (resolver3.AddMaxPool2D(tflite::Register_MAX_POOL_2D()) != kTfLiteOk) {
        YOLO_TRACE0("charhead init FAIL: AddMaxPool2D");
        return false;
    }
    if (resolver3.AddMean(tflite::Register_MEAN()) != kTfLiteOk) {
        YOLO_TRACE0("charhead init FAIL: AddMean");
        return false;
    }
    if (resolver3.AddFullyConnected(tflite::Register_FULLY_CONNECTED()) != kTfLiteOk) {
        YOLO_TRACE0("charhead init FAIL: AddFullyConnected");
        return false;
    }

    static tflite::MicroInterpreter static_interp3(model3, resolver3, tensor_arena3,
                                                   TENSOR_ARENA3_SIZE);
    s_interp3 = &static_interp3;

    if (s_interp3->AllocateTensors() != kTfLiteOk) {
        YOLO_TRACE0("charhead init FAIL: AllocateTensors (reason above)");
        return false;
    }
#if BOOT_VERBOSE
    YOLO_TRACE("charhead init: arena %u of %u bytes, %u in %u out",
               (unsigned)s_interp3->arena_used_bytes(), (unsigned)TENSOR_ARENA3_SIZE,
               (unsigned)s_interp3->inputs_size(), (unsigned)s_interp3->outputs_size());
#endif

    s_in3 = s_interp3->input(0);
    if (s_in3 == nullptr) {
        YOLO_TRACE0("charhead init FAIL: input(0) null");
        return false;
    }
    // [1, 64, 32, 3] —— 注意 dims[1] 是 64 (高), dims[2] 是 32 (宽)。 写反了这一
    // 检查会当场拦下来, 而漏掉这个检查的后果是把 patch 转置着喂进去: 不崩,
    // 只是每个字都认错, 从串口上完全看不出为什么。
    if (s_in3->dims->size != 4 ||
        s_in3->dims->data[0] != 1 ||
        s_in3->dims->data[1] != YOLO_CHAR_IN_H ||
        s_in3->dims->data[2] != YOLO_CHAR_IN_W ||
        s_in3->dims->data[3] != 3 ||
        s_in3->type != kTfLiteInt8 ||
        fabsf(s_in3->params.scale - (1.0f / 255.0f)) > 1e-6f ||
        s_in3->params.zero_point != -128) {
        YOLO_TRACE("charhead init FAIL: in check, want 1 %d %d 3 i8 zp-128 sc 1/255 (got zp %d)",
                   YOLO_CHAR_IN_H, YOLO_CHAR_IN_W, s_in3->params.zero_point);
        return false;
    }

    if (s_interp3->outputs_size() != 1) {
        YOLO_TRACE("charhead init FAIL: %u outputs, want 1",
                   (unsigned)s_interp3->outputs_size());
        return false;
    }
    s_out3 = s_interp3->output(0);
    // scale > 0 是 argmax 敢直接在 int8 上做的**前提**, 所以它是个检查项而不是
    // 注释: 负 scale 会把大小关系整个反过来, 而返回的类别看着仍然"像个字"。
    if (s_out3 == nullptr || s_out3->dims->size != 2 ||
        s_out3->dims->data[0] != 1 ||
        s_out3->dims->data[1] != YOLO_CHAR_CLS ||
        s_out3->type != kTfLiteInt8 ||
        !(s_out3->params.scale > 0.0f)) {
        YOLO_TRACE("charhead init FAIL: out check (want 1 x %d int8, scale>0)",
                   YOLO_CHAR_CLS);
        return false;
    }
#if BOOT_VERBOSE
    YOLO_TRACE("charhead init OK (out scale %d e-6, zp %d)",
               (int)(s_out3->params.scale * 1000000.0f), s_out3->params.zero_point);
#endif
    return true;
}

// ② 的解码 + NMS, 假定 Invoke() 已经跑完。 拆出来是因为级联里图是**直接从
// 冻结帧重采样进输入张量**的, 不经过 yolo_crop_detect() 那次 v-128 的整块
// 拷贝 —— 重采样函数自己就写的是 -128 之后的值, 再拷一遍是白拷 307 KB,
// 而且会让"板子上的裁剪"和"喂给 ② 的那张图"之间有第二次机会不一致。
static int crop_decode_heads(YoloBox* boxes, int max_box)
{
    int cnt = 0;
    int seen = 0;             // 过 conf 的总数, NMS 之前, 不截断
    const int n_out = s_interp2->outputs_size();
    for (int o = 0; o < n_out; o++) {
        TfLiteTensor* t = s_interp2->output(o);
        if (t == nullptr || t->type != kTfLiteInt8 || t->dims->size < 4) continue;
        const int h  = (int)t->dims->data[1];
        const int w  = (int)t->dims->data[2];
        const int ch = (int)t->dims->data[3];
        if (ch != YOLO_CHAN) continue;
        int sid = -1;
        if (h == YOLO_GRID0 && w == YOLO_GRID0) sid = 0;
        else if (h == YOLO_GRID1 && w == YOLO_GRID1) sid = 1;
        if (sid < 0) continue;
        // keep_top = 1: ② 按分数留最高的 max_box 个 (PC 链路的口径)
        decode_head(t->data.int8, sid, ANCHORS_CROP[sid], YOLO_CROP_CONF,
                    boxes, cnt, max_box, 1, seen);
    }

    // 过 conf 的总数 (不截断)。 > max_box 就说明这把 max_box 卡住了。
    s_cas_nraw = seen;
    nms(boxes, cnt, YOLO_CROP_NMS);
    return cnt;
}

int yolo_crop_detect(const uint8_t* rgb, YoloBox* boxes, int max_box)
{
    if (s_interp2 == nullptr || s_in2 == nullptr) return -1;
    if (rgb == nullptr || boxes == nullptr || max_box <= 0) return -1;
    if (s_in2->type != kTfLiteInt8) return -1;

    // 与 yolo_plate_detect() 同一句量化: q = v - 128。
    int8_t* dst = s_in2->data.int8;
    const int n = YOLO_IN_W * YOLO_IN_H * 3;
    for (int i = 0; i < n; i++) {
        dst[i] = (int8_t)((int)rgb[i] - 128);
    }

    if (s_interp2->Invoke() != kTfLiteOk) return -2;

    return crop_decode_heads(boxes, max_box);
}

// ---- 复用判据的内容项 ------------------------------------------------------
// 2026-10-19 上板量出来的分布: 静止场景的复用轮 chg = 1..2, 牌被移走/换掉那
// 一轮 chg = 67。 10 落在两簇中间且离两边都远。 这个数**只能**用来"证据式"
// 作废复用 —— 量得出来且超了才重跑 ①; 量不出来 (框太小 / 没有参考) 时退回
// 纯时间判据, 不能因为测不了就把每轮都变成冷态。
#define CHG_REUSE_MAX  10u

// 相机像素框 -> 320x320 检测坐标, 夹进图内。 返回 false 表示框小于采样网格。
static bool chg_box_320(const YoloBox& b, int fw, int fh,
                        int* bx0, int* by0, int* bw, int* bh)
{
    int x0 = (int)((b.x1 * (float)YOLO_IN_W) / (float)fw);
    int y0 = (int)((b.y1 * (float)YOLO_IN_H) / (float)fh);
    int x1 = (int)((b.x2 * (float)YOLO_IN_W) / (float)fw);
    int y1 = (int)((b.y2 * (float)YOLO_IN_H) / (float)fh);
    if (x0 < 0) x0 = 0;
    if (y0 < 0) y0 = 0;
    if (x1 > YOLO_IN_W) x1 = YOLO_IN_W;
    if (y1 > YOLO_IN_H) y1 = YOLO_IN_H;
    if ((x1 - x0) < CHG_GX || (y1 - y0) < CHG_GY) return false;
    *bx0 = x0; *by0 = y0; *bw = x1 - x0; *bh = y1 - y0;
    return true;
}

// take_ref != 0: 在框内取 64x48 参考, 返回 0。
// take_ref == 0: 与参考逐点求三通道平均绝对差, 返回 0..255。
// 两种模式用同一组采样点; 框太小或没有参考时返回 0xFFFFFFFF。
static uint32_t chg_walk(const uint8_t* rgb320, const YoloBox& b,
                         int fw, int fh, int take_ref)
{
    int bx0, by0, bw, bh;
    if (!chg_box_320(b, fw, fh, &bx0, &by0, &bw, &bh)) return 0xFFFFFFFFu;
    uint8_t* rp = s_chg_ref;
    uint32_t sum = 0u;
    for (int gy = 0; gy < CHG_GY; gy++) {
        const int py = by0 + ((2 * gy + 1) * bh) / (2 * CHG_GY);
        for (int gx = 0; gx < CHG_GX; gx++) {
            const int px = bx0 + ((2 * gx + 1) * bw) / (2 * CHG_GX);
            const uint8_t* p = rgb320 + (py * YOLO_IN_W + px) * 3;
            if (take_ref) {
                *rp++ = p[0];
                *rp++ = p[1];
                *rp++ = p[2];
            } else {
                const int d0 = (int)p[0] - (int)rp[0];
                const int d1 = (int)p[1] - (int)rp[1];
                const int d2 = (int)p[2] - (int)rp[2];
                sum += (uint32_t)((d0 < 0) ? -d0 : d0);
                sum += (uint32_t)((d1 < 0) ? -d1 : d1);
                sum += (uint32_t)((d2 < 0) ? -d2 : d2);
                rp += 3;
            }
        }
    }
    return take_ref ? 0u : sum / (uint32_t)(CHG_GX * CHG_GY * 3);
}

int yolo_cascade_run(const uint8_t* rgb320, const uint8_t* frame888,
                     int fw, int fh, yolo_cascade_result* out)
{
    if (out == nullptr) return -1;
    s_cas_round++;
    out->ok = 0; out->reused = 0; out->nchar = 0;
    out->text[0] = '\0'; out->text_len = 0;
    out->plate.x1 = out->plate.y1 = out->plate.x2 = out->plate.y2 = 0.0f;
    out->plate.score = 0.0f; out->plate.class_id = 0;
    for (int i = 0; i < YOLO_CHAR_MAX; i++) {
        out->chars[i] = out->plate;
    }

    if (s_interp2 == nullptr || s_in2 == nullptr) return -1;
    if (rgb320 == nullptr || frame888 == nullptr) return -1;
    if (fw <= 1 || fh <= 1) return -1;

    s_cas_t_plate = s_cas_t_crop = s_cas_t_resample = s_cas_t_cropinf = 0u;
    s_cas_t_char3 = 0u;
    s_cas_n_cls   = 0;
    s_cas_why     = 0;
    s_cas_n2      = 0;
    s_cas_nraw    = 0;
    s_cas_roll_used = 0.0f;   // 早退的轮次打 0 = "这一轮没有转过", 不是上一轮的数
    for (int i = 0; i < YOLO_CHAR_MAX; i++) s_ch3_margin[i] = -1;   // -1 = 没分类到
    // 这两个是"本轮没量到"的默认值: ① 没跑、或者跑完没框出牌时, 打印端
    // 不该看到上一轮的旧数 (没有参考和"差为 0"是两件事)。
    s_chg_last    = 0xFFFFFFFFu;
    s_plate_raw_n = 0;

    // ------------------------- ① 出车牌框 (或复用) -------------------------
    // 判据是**两条**: 时间 (龄期) 和内容 (这一帧在旧框内变了多少)。 原来只有
    // 时间, 而时间不是"画面变没变"的代理: 2026-10-19 那轮日志里牌已经挪走,
    // 系统照样复用旧框, 打出来一个 AQC86 —— 那一轮 chg = 67。 现在超过
    // CHG_REUSE_MAX 就**这一轮**重跑 ① (4.5 s, 与完全不复用等效), 而不是让旧
    // 框去框新画面。 内容项只能作废旧框, 不能延长复用: 量不出来时退回纯时间。
    const int age = (s_reuse_age <= 1) ? 1 : s_reuse_age;   // 1 = 每轮都重跑
    YoloBox plate_cam;

    bool reuse_ok = (s_pl_valid != 0) && (s_pl_age < age);
    bool measured = false;     // 这一轮是否量到了内容差 (决定 chg 打什么)
    if (reuse_ok && (s_chg_valid != 0))
    {
        const uint32_t d = chg_walk(rgb320, s_pl_box, fw, fh, 0);
        if (d != 0xFFFFFFFFu)
        {
            s_chg_last = d;
            measured   = true;
            if (d > CHG_REUSE_MAX) reuse_ok = false;
        }
    }

    if (reuse_ok) {
        plate_cam  = s_pl_box;
        s_pl_age++;
        out->reused = 1;                       // 这一轮没跑 ①, 所以 plate_us 会是 0
    } else {
        const uint32_t t0 = DWT->CYCCNT;
        const int n1 = yolo_plate_detect(rgb320, s_cas_box, YOLO_CROP_MAXBOX);
        s_cas_t_plate = cas_us(t0);
        if (n1 < 0) return n1;                 // ① 自身出错, 不是"没看到牌"

        // 原始候选框留一份。 必须在下面 crop_decode_heads() 之前 —— 那个函数
        // 把 s_cas_box 整块复用作 ② 的输出缓冲, 之后这里就只剩 ② 的框了。
        s_plate_raw_n = (n1 < YOLO_CROP_MAXBOX) ? n1 : YOLO_CROP_MAXBOX;
        for (int i = 0; i < s_plate_raw_n; i++)
        {
            s_plate_raw[i] = s_cas_box[i];
        }

        YoloBox pick;
        if (!pick_plate_area_conf(s_cas_box, n1, &pick)) {
            // 画面里没有车牌 (或者 ① 这一帧什么都没给)。 缓存作废, 下一轮
            // 立刻重跑 ① —— 这就是"冷态", 此时每轮两次大推理, 是对的:
            // 牌刚进画面的时候不能用旧位置去框它。
            s_pl_valid = 0;
            s_pl_age   = 0;
            s_cas_why  = 1;                    // ① 一个牌框都没有
            return 0;
        }
        camera_map_box(&pick, &plate_cam);     // 320x320 -> 相机像素
        if (!plate_shaped_cam(plate_cam)) {
            // 不是一个横着的框 = 不是车牌 (见 plate_shaped_cam)。 和"一个整牌
            // 框都没有"同样处理: 作废缓存、下一轮重跑 ①, 本轮报 (no char)。
            // 不把这一轮硬塞给 ②③ —— 那只会编出一串看着像结果的假字符串。
            s_pl_valid = 0;
            s_pl_age   = 0;
            s_cas_why  = 2;                    // ① 有框, 但不是横的 (形状闸)
            return 0;
        }
        s_pl_box   = plate_cam;                // 缓存**映射之后**的框
        s_pl_valid = 1;
        s_pl_age   = 1;
        out->reused = 0;
    }
    out->plate = plate_cam;

    // ---------------- 框内画面变了多少 (判据的另一半) ----------------------
    // 复用轮: 上面已经量过, s_chg_last 就是那个数 (量不出来时留在 0xFFFFFFFF,
    // 打印端打出来是 -1)。
    // fresh 轮: 这一帧 + 这个框成为新参考。 正常到龄重跑时 chg 打 0; 如果这一轮
    // 是**内容门限**踢下来的, 打印端要看到那个把它踢下来的数 (measured), 所以
    // 这里不覆盖它。
    if (out->reused == 0)
    {
        s_chg_valid = 0;                       // 框换了, 旧参考一律作废
        if (chg_walk(rgb320, plate_cam, fw, fh, 1) == 0u)
        {
            s_chg_valid = 1;
            if (!measured) s_chg_last = 0u;
        }
    }

    // ---------------------------- 算裁剪矩形 ----------------------------
    // 第一轮 (还没量到尺度) 走训练契约: 框 + 每轴 10%。 之后由上一轮 ② 量到的
    // pitch 反过来定外扩比例, 让字在 320 空间里落到训练的中位尺度。
    const uint32_t t1 = DWT->CYCCNT;
    int rx0 = 0, ry0 = 0, rx1 = 0, ry1 = 0;
#if YOLO_VIEW_ADAPT
    const float cmargin = (s_cas_view_margin > 0.0f) ? s_cas_view_margin : YOLO_CROP_MARGIN;
#else
    const float cmargin = YOLO_CROP_MARGIN;
#endif
    crop_rect_from_plate(plate_cam, fw, fh, cmargin, &rx0, &ry0, &rx1, &ry1);
    s_cas_rect[0] = rx0; s_cas_rect[1] = ry0;
    s_cas_rect[2] = rx1; s_cas_rect[3] = ry1;

    // ---- 取样轴: 用上一轮定下来的横滚把字行转正 (见 roll_update) ----
    // 矩形本身仍是轴对齐的那个 —— 外扩比例是按轴对齐框算的, 动的只是
    // **沿哪个方向把这块像素读出来**。 旋转后的取样区域是同一块面积绕中心
    // 转了一个角, 四个角可能出帧, 采样器逐像素 clamp (BORDER_REPLICATE)。
    CropXform xf;
    xf.rx0 = rx0; xf.ry0 = ry0; xf.rx1 = rx1; xf.ry1 = ry1;
    xf.uw  = rx1 - rx0;
    xf.uh  = ry1 - ry0;
    xf.rot = (fabsf(s_cas_roll) >= YOLO_ROLL_MIN) ? 1 : 0;
    {
        const float rcx = (rx0 + rx1) * 0.5f;
        const float rcy = (ry0 + ry1) * 0.5f;
        const float co  = cosf(s_cas_roll);
        const float si  = sinf(s_cas_roll);
        xf.co = co; xf.si = si;
        xf.ox = rcx - 0.5f * (float)xf.uw * co + 0.5f * (float)xf.uh * si;
        xf.oy = rcy - 0.5f * (float)xf.uw * si - 0.5f * (float)xf.uh * co;
    }
    s_cas_roll_used = xf.rot ? s_cas_roll : 0.0f;   // 日志打"真正用上的"
    s_cas_t_crop = cas_us(t1);

    // --------------------- 冻结帧 -> ② 的输入张量 ---------------------
    const uint32_t t2 = DWT->CYCCNT;
    cx_apply(xf, frame888, fw, fh, s_in2->data.int8, YOLO_IN_W, YOLO_IN_H);
    s_cas_t_resample = cas_us(t2);

    // ------------------------------ ② 推理 ------------------------------
    const uint32_t t3 = DWT->CYCCNT;
    if (s_interp2->Invoke() != kTfLiteOk) return -2;
    s_cas_t_cropinf = cas_us(t3);

    // 复用 s_cas_box: ① 的结果已经拷进 plate_cam 了, 这块缓冲这一轮不用再留。
    const int n2 = crop_decode_heads(s_cas_box, YOLO_CROP_MAXBOX);
    s_cas_n2 = (n2 < 0) ? -1 : n2;

    // ------------------------------ 拼串 ------------------------------
    out->nchar = select_chars_7(s_cas_box, n2, out->chars);

    // ---------------------- 量取景, 给下一轮定裁剪 ----------------------
    // 用 7 个框的中心跨度估计 pitch (与 snap 用的是同一个牌面结构)。 只测不改框 ——
    // 这里 ② 的输出还是原样的, 下面 snap 才动它。
    // 7 字才有意义: 6 字/8 字的位次对不上 6.357 这个跨度。
    if (out->nchar == 7)
    {
#if YOLO_VIEW_ADAPT
        view_adapt_update(out->chars, plate_cam.x2 - plate_cam.x1, rx1 - rx0);
#endif
        // 字行的倾斜: 7 个中心对 x 做最小二乘。 注意这是**校正之后**的残余
        // 倾斜 (本轮已经按 s_cas_roll 转过一次了), roll_update 会把它加回
        // 已用角度上 —— 拿残差当角度会来回摆。
        roll_update(out->chars, rx1 - rx0, ry1 - ry0);
    }

    // 7 字牌: 把偏离牌面格点的框中心吸回去 (见 snap_char_centers_7)。
    // 必须在抠 patch 之前 —— ③ 吃的是框, 框错则 margin 归零。
    // 返回值同时决定 ③ 要不要按位限定类别: 位次错位时限定只会把错位锁死。
    //
    // 先补位再吸: n==6 时末两位常常粘成一个框, 靠格点把缺的槽补回来
    // (见 rebuild_row_7)。 补不成就不动, 下游照旧按 6 字处理。
    {
        const int n3 = rebuild_row_7(out->chars, out->nchar);
        if (n3 > out->nchar) {
            out->nchar = n3;
#if YOLO_VIEW_ADAPT
            // 补出来的这一行同样能定尺度。
            view_adapt_update(out->chars, plate_cam.x2 - plate_cam.x1, rx1 - rx0);
#endif
            // 也能定角度: 槽位是格点给的, 中心位置是可信的。
            roll_update(out->chars, rx1 - rx0, ry1 - ry0);
        }
    }
#if YOLO_VIEW_ADAPT
    // 每轮都往目标收敛半步 —— **不能**绑在 n==7 / 补位成功上 (见 view_adapt_update)。
    // 这一轮没量到新 pitch 也照样调: 上一次的目标仍然是有效的修正方向。
    view_adapt_tick();
#endif
    // 角度同理: 没量到新残差就沿用上一次的目标 (见 roll_update)。
    roll_tick();
    const int layout7 = snap_char_centers_7(out->chars, out->nchar);

    // ---------------------------- ③ 逐字分类 ----------------------------
    // 每个字符框抠一张 32x64, 取 argmax, 把**类别写回框的 class_id**。 这样下面
    // 那段拼串原封不动还是 yolo_plate_read(): GBK 表、class_id>0 的过滤、按 x1
    // 排序、12 字节截断 (YOLO_PLATE_MAXLEN=12, 与 Python assemble(cap=12) 同一个
    // 口径), 一条规则都没有第二份实现 —— 这是板子上的串能和 PC 逐字对上的原因。
    //
    // ③ 没起来 (s_interp3 == nullptr) 或者某一张 Invoke 失败时, class_id 保持
    // ② 的原值, 也就是退化成接 ③ 之前那一版的行为, 而不是给一个空串 —— 这一级的
    // 失败不该把 ② 已经做对的事情抹掉。
    //
    // 顺序: out->chars[] 已按 x1 排好 (select_chars_7 里排的), patch 就按这个
    // 顺序一张一张过。 Python 那边 patch 列表和类别列表也是同一个顺序, 拼串最后
    // 还会再按 x 排一次, 所以两边的配对关系一致。
    s_cas_t_char3 = 0u;
    s_cas_n_cls   = 0;
    if (out->nchar > 0 && s_interp3 != nullptr) {
        const uint32_t t4 = DWT->CYCCNT;
        for (int i = 0; i < out->nchar; i++) {
            charhead_cut_patch(frame888, fw, fh, xf, &out->chars[i], s_ch3_patch);
            const int cid = charhead_classify(s_ch3_patch, i, layout7);
            if (cid >= 0) {
                out->chars[i].class_id = cid;
                s_ch3_margin[i] = s_ch3_last_margin;
                s_cas_n_cls++;
            }
        }
        s_cas_t_char3 = cas_us(t4);
    }

    if (out->nchar > 0) {
        out->text_len = yolo_plate_read(out->chars, out->nchar, out->text,
                                        (int)sizeof(out->text));
    }

    // **框出来的字太少 = 这个框不是车牌**, 下一轮立刻重跑 ①。
    // 只有 n==0 才作废是不够的: ① 框在别的东西上时 ② 照样会给出 2~3 个"字",
    // 2026-10-19 重启后那次就是 88x109 的竖框连吃 9 轮 15/616/1T7/51学。
    // 中国车牌最短也有 7 位, 所以 4 位以下没有任何合法的可能 —— 这条不会误伤
    // 真车牌; 而且它不改变本轮输出, 只决定下一轮跑不跑 ①。
    // 代价: 这种轮次每轮多一次 ① (约 0.8 s), 而那几轮本来也没有可用结果。
    // 用 age 而不是 age+1, 保证下一轮一定重跑。
    if (out->nchar < 4) {
        s_pl_age = age;
    }

    out->ok = 1;
    return out->nchar;
}

int yolo_cascade_view_pitch_x10(void)
{
    return (int)(s_cas_pitch_meas * 10.0f + 0.5f);
}

int yolo_cascade_view_margin_x100(void)
{
    return (int)(s_cas_view_margin * 100.0f + 0.5f);
}

int yolo_cascade_view_slope_x1000(void)
{
    const float v = s_cas_slope_meas * 1000.0f;
    return (int)((v < 0.0f) ? (v - 0.5f) : (v + 0.5f));
}

// 本轮**真正用上**的横滚角度, 单位 0.001 rad (正 = 右边低)。
// 和 slope 的区别: slope 是 320 空间里量到的**残余**倾斜, roll 是已经转过的
// 总角度。 两个都接近 0 才是真的正; 一个是 0、一个很大说明正在收敛。
int yolo_cascade_roll_x1000(void)
{
    const float v = s_cas_roll_used * 1000.0f;
    return (int)((v < 0.0f) ? (v - 0.5f) : (v + 0.5f));
}

// 这一轮 (no char) 是哪一种: 0 正常 / 1 ① 一个牌框都没有 / 2 形状闸拒了。
int yolo_cascade_reason(void)
{
    return s_cas_why;
}

// ② 的原始输出框数 (截到 7 之前)。 大于 nchar 就是这一轮框多了。
int yolo_cascade_n2(void)
{
    return s_cas_n2;
}

// NMS **之前**的候选数。 == YOLO_CROP_MAXBOX(64) 就是光栅序截断卡住了。
int yolo_cascade_nraw(void)
{
    return s_cas_nraw;
}

// n==6 补位这一轮的诊断。 只有本轮 ② 给出 6 个框时才有内容 (返回 11), 否则 0。
//   buf[0] = 6 (框数)          buf[1] = 1 走 A / 2 走 B / 0 没补
//   buf[2] = B 丢掉的框下标    buf[3] = 拟合 pitch x10
//   buf[4] = 最大残差 / pitch x100 (999 = 拟合退化)
//   buf[5..10] = 补位**之前**的 6 个框中心 (320 空间)
int yolo_cascade_ch6_diag(int* buf, int cap)
{
    // s_ch6_round != s_cas_round 说明这一轮在走到补位之前就返回了 (没框/② 没跑),
    // 此时 s_ch6_* 还是**上一轮**的数 —— 打印端会看到连着几行一模一样的 ch6,
    // 误以为是"这轮又掉框了"。 直接返回 0。
    if (buf == nullptr || cap < YOLO_CH6_AKEYS) return 0;
    if (s_ch6_n != 6 || s_ch6_round != s_cas_round) return 0;
    buf[0] = s_ch6_n;
    buf[1] = s_ch6_kind;
    buf[2] = s_ch6_drop;
    buf[3] = s_ch6_px10;
    buf[4] = s_ch6_rx100;
    for (int i = 0; i < 6; i++) buf[5 + i] = s_ch6_c[i];
    return YOLO_CH6_AKEYS;
}

void yolo_cascade_crop_rect(int* x0, int* y0, int* x1, int* y1)
{
    if (x0 != nullptr) *x0 = s_cas_rect[0];
    if (y0 != nullptr) *y0 = s_cas_rect[1];
    if (x1 != nullptr) *x1 = s_cas_rect[2];
    if (y1 != nullptr) *y1 = s_cas_rect[3];
}

void yolo_cascade_stat(uint32_t* plate_us, uint32_t* crop_us,
                       uint32_t* resample_us, uint32_t* crop_infer_us,
                       uint32_t* char_us)
{
    if (plate_us     != nullptr) *plate_us     = s_cas_t_plate;
    if (crop_us      != nullptr) *crop_us      = s_cas_t_crop;
    if (resample_us  != nullptr) *resample_us  = s_cas_t_resample;
    if (crop_infer_us != nullptr) *crop_infer_us = s_cas_t_cropinf;
    if (char_us      != nullptr) *char_us      = s_cas_t_char3;
}

int yolo_cascade_char_cls(void)
{
    return s_cas_n_cls;
}

uint32_t yolo_cascade_change(void)
{
    return s_chg_last;
}

int yolo_cascade_char_margin(int i)
{
    if (i < 0 || i >= YOLO_CHAR_MAX) return -1;
    return s_ch3_margin[i];
}

uint32_t yolo_cascade_char_snap(void)
{
    return s_ch3_snap;
}

int yolo_cascade_plate_raw(YoloBox* dst, int max)
{
    const int n = s_plate_raw_n;

    if ((dst != nullptr) && (max > 0))
    {
        const int c = (n < max) ? n : max;
        for (int i = 0; i < c; i++)
        {
            dst[i] = s_plate_raw[i];
        }
    }
    return n;
}

void yolo_cascade_reuse_set(int n)
{
    s_reuse_age = (n <= 1) ? 1 : n;
}

int yolo_cascade_reuse_get(void)
{
    return s_reuse_age;
}

void yolo_cascade_reset(void)
{
    s_pl_valid = 0;
    s_pl_age   = 0;
}
